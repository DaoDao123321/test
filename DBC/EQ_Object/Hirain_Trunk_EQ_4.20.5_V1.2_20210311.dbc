VERSION "created by canmatrix"

NS_ :

BS_:

BU_: ADAS ADU

BO_ 406 Core_Objects_protocol_2_1: 48 ADAS
 SG_ OBJ_Sync_ID_2_1 : 0|8@1+ (1,0) [0|255] "counter"  ADU
 SG_ OBJ_Relative_Lat_Velocity_2 : 8|11@1+ (0.05,-50) [-50|50] "m_per_s"  ADU
 SG_ OBJ_Relative_Lat_Velocity_V_2 : 19|1@1+ (1,0) [0|1] "bool"  ADU
 SG_ OBJ_Relative_Lat_Velocity_STD_2 : 20|13@1+ (0.01,0) [0|50] "m_per_s"  ADU
 SG_ OBJ_Rel_Lat_Vel_STD_V_2 : 33|1@1+ (1,0) [0|1] "bool"  ADU
 SG_ OBJ_Long_Distance_2 : 34|14@1+ (0.05,-200) [-200|500] "m"  ADU
 SG_ OBJ_Long_Distance_V_2 : 48|1@1+ (1,0) [0|1] "bool"  ADU
 SG_ OBJ_Long_Distance_STD_2 : 49|15@1+ (0.01,0) [0|250] "m"  ADU
 SG_ OBJ_Long_Distance_STD_V_2 : 64|1@1+ (1,0) [0|1] "bool"  ADU
 SG_ OBJ_Lat_Distance_2 : 65|12@1+ (0.05,-100) [-100|100] "m"  ADU
 SG_ OBJ_Lat_Distance_V_2 : 77|1@1+ (1,0) [0|1] "bool"  ADU
 SG_ OBJ_Lat_Distance_STD_2 : 78|14@1+ (0.01,0) [0|100] "m"  ADU
 SG_ OBJ_Lat_Distance_STD_V_2 : 92|1@1+ (1,0) [0|1] "bool"  ADU
 SG_ OBJ_Absolute_Speed_2 : 93|12@1+ (0.05,-65) [-65|65] "m_per_s"  ADU
 SG_ OBJ_Absolute_Speed_V_2 : 105|1@1+ (1,0) [0|1] "bool"  ADU
 SG_ OBJ_Absolute_Speed_STD_2 : 106|13@1+ (0.01,0) [0|65] "m_per_s"  ADU
 SG_ OBJ_Absolute_Speed_STD_V_2 : 119|1@1+ (1,0) [0|1] "bool"  ADU
 SG_ OBJ_Heading_2 : 120|10@1+ (0.01,-3.14) [-3.14|3.14] "rad"  ADU
 SG_ OBJ_Heading_V_2 : 130|1@1+ (1,0) [0|1] "bool"  ADU
 SG_ OBJ_Heading_STD_2 : 131|15@1+ (0.0001,0) [0|3.14] "rad"  ADU
 SG_ OBJ_Heading_STD_V_2 : 146|1@1+ (1,0) [0|1] "bool"  ADU
 SG_ OBJ_Angle_Rate_STD_2 : 147|15@1+ (0.0001,0) [0|2.2318] "RPS"  ADU
 SG_ OBJ_Angle_Rate_STD_V_2 : 162|1@1+ (1,0) [0|1] "bool"  ADU
 SG_ OBJ_Angle_Rate_2 : 163|12@1+ (0.002,-2.234) [-2.234|2.2318] "RPS"  ADU
 SG_ OBJ_Angle_Rate_V_2 : 175|1@1+ (1,0) [0|1] "bool"  ADU
 SG_ OBJ_Angle_Right_2 : 176|14@1+ (0.0002,-1.571) [-1.571|1.571] "rad"  ADU
 SG_ OBJ_Angle_Right_V_2 : 190|1@1+ (1,0) [0|1] "bool"  ADU
 SG_ OBJ_Angle_Right_STD_2 : 191|14@1+ (0.0001,0) [0|1.571] "rad"  ADU
 SG_ OBJ_Angle_Right_STD_V_2 : 205|1@1+ (1,0) [0|1] "bool"  ADU
 SG_ OBJ_Angle_Left_2 : 206|14@1+ (0.0002,-1.571) [-1.571|1.571] "rad"  ADU
 SG_ OBJ_Angle_Left_V_2 : 220|1@1+ (1,0) [0|1] "bool"  ADU
 SG_ OBJ_Angle_Left_STD_2 : 221|14@1+ (0.0001,0) [0|1.571] "rad"  ADU
 SG_ OBJ_Angle_Left_STD_V_2 : 235|1@1+ (1,0) [0|1] "bool"  ADU
 SG_ OBJ_Angle_Side_2 : 236|14@1+ (0.0002,-1.571) [-1.571|1.571] "rad"  ADU
 SG_ OBJ_Angle_Side_V_2 : 250|1@1+ (1,0) [0|1] "bool"  ADU
 SG_ OBJ_Angle_Side_STD_2 : 251|14@1+ (0.0001,0) [0|1.571] "rad"  ADU
 SG_ OBJ_Angle_Side_STD_V_2 : 265|1@1+ (1,0) [0|1] "bool"  ADU
 SG_ OBJ_Angle_Mid_V_2 : 266|1@1+ (1,0) [0|1] "bool"  ADU
 SG_ OBJ_Angle_Mid_2 : 267|14@1+ (0.0002,-1.571) [-1.571|1.571] "rad"  ADU
 SG_ OBJ_Angle_Mid_STD_2 : 281|14@1+ (0.0001,0) [0|1.571] "rad"  ADU
 SG_ OBJ_Angle_Mid_STD_V_2 : 295|1@1+ (1,0) [0|1] "bool"  ADU
 SG_ OBJ_Angle_Bottom_V_2 : 296|1@1+ (1,0) [0|1] "bool"  ADU
 SG_ OBJ_Angle_Bottom_2 : 297|14@1+ (0.0002,-1.571) [-1.571|1.571] "rad"  ADU
 SG_ OBJ_Angle_Bottom_STD_2 : 311|14@1+ (0.0001,0) [0|1.571] "rad"  ADU
 SG_ OBJ_Angle_Bottom_STD_V_2 : 325|1@1+ (1,0) [0|1] "bool"  ADU
 SG_ OBJ_Visibility_Side_V_2 : 326|1@1+ (1,0) [0|1] "bool"  ADU
 SG_ OBJ_Visibility_Side_2 : 327|2@1+ (1,0) [0|2] "ENUM"  ADU
 SG_ OBJ_Is_In_Drivable_Area_2 : 329|1@1+ (1,0) [0|1] "bool"  ADU
 SG_ OBJ_Is_In_Drivable_Area_V_2 : 330|1@1+ (1,0) [0|1] "bool"  ADU
 SG_ OBJ_Is_VeryClose_V_2 : 331|1@1+ (1,0) [0|1] "bool"  ADU
 SG_ OBJ_Is_VeryClose_2 : 332|1@1+ (1,0) [0|1] "bool"  ADU
 SG_ OBJ_Is_EMERGENCY_VCL_2 : 333|1@1+ (1,0) [0|1] "bool"  ADU
 SG_ OBJ_EMERGENCY_LIGHT_COLOR_2 : 334|4@1+ (1,0) [0|15] "BITWIZE"  ADU
 SG_ OBJ_EMERGENCY_V_2 : 338|1@1+ (1,0) [0|1] "bool"  ADU

BO_ 407 Core_Objects_protocol_3_0: 48 ADAS
 SG_ OBJ_Sync_ID_3_0 : 0|8@1+ (1,0) [0|255] "counter"  ADU
 SG_ OBJ_CRC_3 : 8|32@1+ (1,0) [0|4294970000] "NA"  ADU
 SG_ OBJ_ID_3 : 40|8@1+ (1,0) [0|255] "counter"  ADU
 SG_ OBJ_Existence_Probability_3 : 48|8@1+ (0.01,0) [0|1] "NA"  ADU
 SG_ OBJ_Motion_Category_3 : 56|4@1+ (1,0) [0|13] "ENUM"  ADU
 SG_ OBJ_Object_Age_3 : 60|11@1+ (1,0) [0|2047] "frames"  ADU
 SG_ OBJ_Measuring_Status_3 : 71|3@1+ (1,0) [0|7] "BITWIZE"  ADU
 SG_ OBJ_Object_Class_3 : 74|4@1+ (1,0) [0|8] "ENUM"  ADU
 SG_ OBJ_Class_Probability_3 : 78|7@1+ (0.01,0) [0|1] "NA"  ADU
 SG_ OBJ_Motion_Status_3 : 85|3@1+ (1,0) [0|5] "ENUM"  ADU
 SG_ OBJ_Motion_Orientation_3 : 88|4@1+ (1,0) [0|13] "ENUM"  ADU
 SG_ OBJ_Has_Cut_Lane_3 : 92|1@1+ (1,0) [0|1] "bool"  ADU
 SG_ OBJ_Has_Cut_Path_3 : 93|1@1+ (1,0) [0|1] "bool"  ADU
 SG_ OBJ_Brake_Light_3 : 94|1@1+ (1,0) [0|1] "bool"  ADU
 SG_ OBJ_Turn_Indicator_Right_3 : 95|1@1+ (1,0) [0|1] "bool"  ADU
 SG_ OBJ_Turn_Indicator_Left_3 : 96|1@1+ (1,0) [0|1] "bool"  ADU
 SG_ OBJ_Light_Indicator_Validity_3 : 97|1@1+ (1,0) [0|1] "bool"  ADU
 SG_ OBJ_Right_Out_Of_Image_3 : 98|1@1+ (1,0) [0|1] "bool"  ADU
 SG_ OBJ_Left_Out_Of_Image_3 : 99|1@1+ (1,0) [0|1] "bool"  ADU
 SG_ OBJ_Right_Out_Of_Image_V_3 : 100|1@1+ (1,0) [0|1] "bool"  ADU
 SG_ OBJ_Left_Out_Of_Image_V_3 : 101|1@1+ (1,0) [0|1] "bool"  ADU
 SG_ OBJ_Top_Out_Of_Image_3 : 102|1@1+ (1,0) [0|1] "bool"  ADU
 SG_ OBJ_Bottom_Out_Of_Image_3 : 103|1@1+ (1,0) [0|1] "bool"  ADU
 SG_ OBJ_Top_Out_Of_Image_V_3 : 104|1@1+ (1,0) [0|1] "bool"  ADU
 SG_ OBJ_Bottom_Out_Of_Image_V_3 : 105|1@1+ (1,0) [0|1] "bool"  ADU
 SG_ OBJ_Lane_Assignment_3 : 106|3@1+ (1,0) [0|5] "ENUM"  ADU
 SG_ OBJ_Lane_Assignment_V_3 : 109|1@1+ (1,0) [0|1] "bool"  ADU
 SG_ OBJ_Age_Seconds_3 : 110|7@1+ (1,0) [0|100] "s"  ADU
 SG_ OBJ_Age_Seconds_V_3 : 117|1@1+ (1,0) [0|1] "bool"  ADU
 SG_ OBJ_Width_3 : 118|9@1+ (0.01,0) [0.4|2.95] "m"  ADU
 SG_ OBJ_Width_V_3 : 127|1@1+ (1,0) [0|1] "bool"  ADU
 SG_ OBJ_Width_STD_3 : 128|11@1+ (0.001,0) [0|2] "m"  ADU
 SG_ OBJ_Width_STD_V_3 : 139|1@1+ (1,0) [0|1] "bool"  ADU
 SG_ OBJ_Length_3 : 140|9@1+ (0.05,0) [1.2|21] "m"  ADU
 SG_ OBJ_Length_V_3 : 149|1@1+ (1,0) [0|1] "bool"  ADU
 SG_ OBJ_Length_STD_3 : 150|10@1+ (0.01,0) [0|10] "m"  ADU
 SG_ OBJ_Length_STD_V_3 : 160|1@1+ (1,0) [0|1] "bool"  ADU
 SG_ OBJ_Height_3 : 161|9@1+ (0.01,0) [0|2.95] "m"  ADU
 SG_ OBJ_Height_V_3 : 170|1@1+ (1,0) [0|1] "bool"  ADU
 SG_ OBJ_Height_STD_3 : 171|11@1+ (0.001,0) [0|2] "m"  ADU
 SG_ OBJ_Height_STD_V_3 : 182|1@1+ (1,0) [0|1] "bool"  ADU
 SG_ OBJ_Abs_Long_Velocity_3 : 183|12@1+ (0.05,-100) [-100|100] "m_per_s"  ADU
 SG_ OBJ_Abs_Long_Velocity_V_3 : 195|1@1+ (1,0) [0|1] "bool"  ADU
 SG_ OBJ_Abs_Long_Velocity_STD_3 : 196|13@1+ (0.01,0) [0|65] "m_per_s"  ADU
 SG_ OBJ_Abs_Long_Vel_STD_V_3 : 209|1@1+ (1,0) [0|1] "bool"  ADU
 SG_ OBJ_Abs_Lat_Velocity_3 : 210|11@1+ (0.05,-50) [-50|50] "m_per_s"  ADU
 SG_ OBJ_Abs_Lat_Velocity_V_3 : 221|1@1+ (1,0) [0|1] "bool"  ADU
 SG_ OBJ_Abs_Lat_Velocity_STD_3 : 222|13@1+ (0.01,0) [0|50] "m_per_s"  ADU
 SG_ OBJ_Abs_Lat_Vel_STD_V_3 : 235|1@1+ (1,0) [0|1] "bool"  ADU
 SG_ OBJ_Abs_Long_Acc_3 : 236|9@1+ (0.05,-10) [-10|10] "m_per_s2"  ADU
 SG_ OBJ_Abs_Long_Acc_V_3 : 245|1@1+ (1,0) [0|1] "bool"  ADU
 SG_ OBJ_Abs_Long_Acc_STD_3 : 246|10@1+ (0.01,0) [0|7.3] "m_per_s2"  ADU
 SG_ OBJ_Abs_Long_Acc_STD_V_3 : 256|1@1+ (1,0) [0|1] "bool"  ADU
 SG_ OBJ_Abs_Lat_Acc_3 : 257|9@1+ (0.05,-10.3) [-10.3|7.3] "m_per_s2"  ADU
 SG_ OBJ_Abs_Lat_Acc_V_3 : 266|1@1+ (1,0) [0|1] "bool"  ADU
 SG_ OBJ_Abs_Lat_Acc_STD_3 : 267|10@1+ (0.01,0) [0|7.3] "m_per_s2"  ADU
 SG_ OBJ_Abs_Lat_Acc_STD_V_3 : 277|1@1+ (1,0) [0|1] "bool"  ADU
 SG_ OBJ_Abs_Acceleration_3 : 278|9@1+ (0.05,-10.3) [-10.3|7.3] "m_per_s2"  ADU
 SG_ OBJ_Abs_Acceleration_V_3 : 287|1@1+ (1,0) [0|1] "bool"  ADU
 SG_ OBJ_Abs_Acc_STD_3 : 288|10@1+ (0.01,0) [0|7.3] "m_per_s2"  ADU
 SG_ OBJ_Abs_Acc_STD_V_3 : 298|1@1+ (1,0) [0|1] "bool"  ADU
 SG_ OBJ_Inv_TTC_3 : 299|11@1+ (0.01,-8) [-8|8] "INV(s)"  ADU
 SG_ OBJ_Inv_TTC_V_3 : 310|1@1+ (1,0) [0|1] "bool"  ADU
 SG_ OBJ_Inv_TTC_STD_3 : 311|12@1+ (0.001,0) [0|4] "INV(s)"  ADU
 SG_ OBJ_Inv_TTC_STD_V_3 : 323|1@1+ (1,0) [0|1] "bool"  ADU
 SG_ OBJ_Relative_Long_Acc_3 : 324|10@1+ (0.05,-20) [-20|20] "m_per_s2"  ADU
 SG_ OBJ_Relative_Long_Acc_V_3 : 334|1@1+ (1,0) [0|1] "bool"  ADU
 SG_ OBJ_Relative_Long_Acc_STD_3 : 335|10@1+ (0.01,0) [0|7.3] "m_per_s2"  ADU
 SG_ OBJ_Rel_Long_Acc_STD_V_3 : 345|1@1+ (1,0) [0|1] "bool"  ADU
 SG_ OBJ_Relative_Long_Velocity_3 : 346|13@1+ (0.05,-120) [-120|130] "m_per_s"  ADU
 SG_ OBJ_Relative_Long_Velocity_V_3 : 359|1@1+ (1,0) [0|1] "bool"  ADU
 SG_ OBJ_Relative_Long_Vel_STD_3 : 360|14@1+ (0.01,0) [0|130] "m_per_s"  ADU
 SG_ OBJ_Rel_Long_Vel_STD_V_3 : 374|1@1+ (1,0) [0|1] "bool"  ADU

BO_ 408 Core_Objects_protocol_3_1: 48 ADAS
 SG_ OBJ_Sync_ID_3_1 : 0|8@1+ (1,0) [0|255] "counter"  ADU
 SG_ OBJ_Relative_Lat_Velocity_3 : 8|11@1+ (0.05,-50) [-50|50] "m_per_s"  ADU
 SG_ OBJ_Relative_Lat_Velocity_V_3 : 19|1@1+ (1,0) [0|1] "bool"  ADU
 SG_ OBJ_Relative_Lat_Velocity_STD_3 : 20|13@1+ (0.01,0) [0|50] "m_per_s"  ADU
 SG_ OBJ_Rel_Lat_Vel_STD_V_3 : 33|1@1+ (1,0) [0|1] "bool"  ADU
 SG_ OBJ_Long_Distance_3 : 34|14@1+ (0.05,-200) [-200|500] "m"  ADU
 SG_ OBJ_Long_Distance_V_3 : 48|1@1+ (1,0) [0|1] "bool"  ADU
 SG_ OBJ_Long_Distance_STD_3 : 49|15@1+ (0.01,0) [0|250] "m"  ADU
 SG_ OBJ_Long_Distance_STD_V_3 : 64|1@1+ (1,0) [0|1] "bool"  ADU
 SG_ OBJ_Lat_Distance_3 : 65|12@1+ (0.05,-100) [-100|100] "m"  ADU
 SG_ OBJ_Lat_Distance_V_3 : 77|1@1+ (1,0) [0|1] "bool"  ADU
 SG_ OBJ_Lat_Distance_STD_3 : 78|14@1+ (0.01,0) [0|100] "m"  ADU
 SG_ OBJ_Lat_Distance_STD_V_3 : 92|1@1+ (1,0) [0|1] "bool"  ADU
 SG_ OBJ_Absolute_Speed_3 : 93|12@1+ (0.05,-65) [-65|65] "m_per_s"  ADU
 SG_ OBJ_Absolute_Speed_V_3 : 105|1@1+ (1,0) [0|1] "bool"  ADU
 SG_ OBJ_Absolute_Speed_STD_3 : 106|13@1+ (0.01,0) [0|65] "m_per_s"  ADU
 SG_ OBJ_Absolute_Speed_STD_V_3 : 119|1@1+ (1,0) [0|1] "bool"  ADU
 SG_ OBJ_Heading_3 : 120|10@1+ (0.01,-3.14) [-3.14|3.14] "rad"  ADU
 SG_ OBJ_Heading_V_3 : 130|1@1+ (1,0) [0|1] "bool"  ADU
 SG_ OBJ_Heading_STD_3 : 131|15@1+ (0.0001,0) [0|3.14] "rad"  ADU
 SG_ OBJ_Heading_STD_V_3 : 146|1@1+ (1,0) [0|1] "bool"  ADU
 SG_ OBJ_Angle_Rate_STD_3 : 147|15@1+ (0.0001,0) [0|2.2318] "RPS"  ADU
 SG_ OBJ_Angle_Rate_STD_V_3 : 162|1@1+ (1,0) [0|1] "bool"  ADU
 SG_ OBJ_Angle_Rate_3 : 163|12@1+ (0.002,-2.234) [-2.234|2.2318] "RPS"  ADU
 SG_ OBJ_Angle_Rate_V_3 : 175|1@1+ (1,0) [0|1] "bool"  ADU
 SG_ OBJ_Angle_Right_3 : 176|14@1+ (0.0002,-1.571) [-1.571|1.571] "rad"  ADU
 SG_ OBJ_Angle_Right_V_3 : 190|1@1+ (1,0) [0|1] "bool"  ADU
 SG_ OBJ_Angle_Right_STD_3 : 191|14@1+ (0.0001,0) [0|1.571] "rad"  ADU
 SG_ OBJ_Angle_Right_STD_V_3 : 205|1@1+ (1,0) [0|1] "bool"  ADU
 SG_ OBJ_Angle_Left_3 : 206|14@1+ (0.0002,-1.571) [-1.571|1.571] "rad"  ADU
 SG_ OBJ_Angle_Left_V_3 : 220|1@1+ (1,0) [0|1] "bool"  ADU
 SG_ OBJ_Angle_Left_STD_3 : 221|14@1+ (0.0001,0) [0|1.571] "rad"  ADU
 SG_ OBJ_Angle_Left_STD_V_3 : 235|1@1+ (1,0) [0|1] "bool"  ADU
 SG_ OBJ_Angle_Side_3 : 236|14@1+ (0.0002,-1.571) [-1.571|1.571] "rad"  ADU
 SG_ OBJ_Angle_Side_V_3 : 250|1@1+ (1,0) [0|1] "bool"  ADU
 SG_ OBJ_Angle_Side_STD_3 : 251|14@1+ (0.0001,0) [0|1.571] "rad"  ADU
 SG_ OBJ_Angle_Side_STD_V_3 : 265|1@1+ (1,0) [0|1] "bool"  ADU
 SG_ OBJ_Angle_Mid_V_3 : 266|1@1+ (1,0) [0|1] "bool"  ADU
 SG_ OBJ_Angle_Mid_3 : 267|14@1+ (0.0002,-1.571) [-1.571|1.571] "rad"  ADU
 SG_ OBJ_Angle_Mid_STD_3 : 281|14@1+ (0.0001,0) [0|1.571] "rad"  ADU
 SG_ OBJ_Angle_Mid_STD_V_3 : 295|1@1+ (1,0) [0|1] "bool"  ADU
 SG_ OBJ_Angle_Bottom_V_3 : 296|1@1+ (1,0) [0|1] "bool"  ADU
 SG_ OBJ_Angle_Bottom_3 : 297|14@1+ (0.0002,-1.571) [-1.571|1.571] "rad"  ADU
 SG_ OBJ_Angle_Bottom_STD_3 : 311|14@1+ (0.0001,0) [0|1.571] "rad"  ADU
 SG_ OBJ_Angle_Bottom_STD_V_3 : 325|1@1+ (1,0) [0|1] "bool"  ADU
 SG_ OBJ_Visibility_Side_V_3 : 326|1@1+ (1,0) [0|1] "bool"  ADU
 SG_ OBJ_Visibility_Side_3 : 327|2@1+ (1,0) [0|2] "ENUM"  ADU
 SG_ OBJ_Is_In_Drivable_Area_3 : 329|1@1+ (1,0) [0|1] "bool"  ADU
 SG_ OBJ_Is_In_Drivable_Area_V_3 : 330|1@1+ (1,0) [0|1] "bool"  ADU
 SG_ OBJ_Is_VeryClose_V_3 : 331|1@1+ (1,0) [0|1] "bool"  ADU
 SG_ OBJ_Is_VeryClose_3 : 332|1@1+ (1,0) [0|1] "bool"  ADU
 SG_ OBJ_Is_EMERGENCY_VCL_3 : 333|1@1+ (1,0) [0|1] "bool"  ADU
 SG_ OBJ_EMERGENCY_LIGHT_COLOR_3 : 334|4@1+ (1,0) [0|15] "BITWIZE"  ADU
 SG_ OBJ_EMERGENCY_V_3 : 338|1@1+ (1,0) [0|1] "bool"  ADU

BO_ 409 Core_Objects_protocol_4_0: 48 ADAS
 SG_ OBJ_Sync_ID_4_0 : 0|8@1+ (1,0) [0|255] "counter"  ADU
 SG_ OBJ_CRC_4 : 8|32@1+ (1,0) [0|4294970000] "NA"  ADU
 SG_ OBJ_ID_4 : 40|8@1+ (1,0) [0|255] "counter"  ADU
 SG_ OBJ_Existence_Probability_4 : 48|8@1+ (0.01,0) [0|1] "NA"  ADU
 SG_ OBJ_Motion_Category_4 : 56|4@1+ (1,0) [0|13] "ENUM"  ADU
 SG_ OBJ_Object_Age_4 : 60|11@1+ (1,0) [0|2047] "frames"  ADU
 SG_ OBJ_Measuring_Status_4 : 71|3@1+ (1,0) [0|7] "BITWIZE"  ADU
 SG_ OBJ_Object_Class_4 : 74|4@1+ (1,0) [0|8] "ENUM"  ADU
 SG_ OBJ_Class_Probability_4 : 78|7@1+ (0.01,0) [0|1] "NA"  ADU
 SG_ OBJ_Motion_Status_4 : 85|3@1+ (1,0) [0|5] "ENUM"  ADU
 SG_ OBJ_Motion_Orientation_4 : 88|4@1+ (1,0) [0|13] "ENUM"  ADU
 SG_ OBJ_Has_Cut_Lane_4 : 92|1@1+ (1,0) [0|1] "bool"  ADU
 SG_ OBJ_Has_Cut_Path_4 : 93|1@1+ (1,0) [0|1] "bool"  ADU
 SG_ OBJ_Brake_Light_4 : 94|1@1+ (1,0) [0|1] "bool"  ADU
 SG_ OBJ_Turn_Indicator_Right_4 : 95|1@1+ (1,0) [0|1] "bool"  ADU
 SG_ OBJ_Turn_Indicator_Left_4 : 96|1@1+ (1,0) [0|1] "bool"  ADU
 SG_ OBJ_Light_Indicator_Validity_4 : 97|1@1+ (1,0) [0|1] "bool"  ADU
 SG_ OBJ_Right_Out_Of_Image_4 : 98|1@1+ (1,0) [0|1] "bool"  ADU
 SG_ OBJ_Left_Out_Of_Image_4 : 99|1@1+ (1,0) [0|1] "bool"  ADU
 SG_ OBJ_Right_Out_Of_Image_V_4 : 100|1@1+ (1,0) [0|1] "bool"  ADU
 SG_ OBJ_Left_Out_Of_Image_V_4 : 101|1@1+ (1,0) [0|1] "bool"  ADU
 SG_ OBJ_Top_Out_Of_Image_4 : 102|1@1+ (1,0) [0|1] "bool"  ADU
 SG_ OBJ_Bottom_Out_Of_Image_4 : 103|1@1+ (1,0) [0|1] "bool"  ADU
 SG_ OBJ_Top_Out_Of_Image_V_4 : 104|1@1+ (1,0) [0|1] "bool"  ADU
 SG_ OBJ_Bottom_Out_Of_Image_V_4 : 105|1@1+ (1,0) [0|1] "bool"  ADU
 SG_ OBJ_Lane_Assignment_4 : 106|3@1+ (1,0) [0|5] "ENUM"  ADU
 SG_ OBJ_Lane_Assignment_V_4 : 109|1@1+ (1,0) [0|1] "bool"  ADU
 SG_ OBJ_Age_Seconds_4 : 110|7@1+ (1,0) [0|100] "s"  ADU
 SG_ OBJ_Age_Seconds_V_4 : 117|1@1+ (1,0) [0|1] "bool"  ADU
 SG_ OBJ_Width_4 : 118|9@1+ (0.01,0) [0.4|2.95] "m"  ADU
 SG_ OBJ_Width_V_4 : 127|1@1+ (1,0) [0|1] "bool"  ADU
 SG_ OBJ_Width_STD_4 : 128|11@1+ (0.001,0) [0|2] "m"  ADU
 SG_ OBJ_Width_STD_V_4 : 139|1@1+ (1,0) [0|1] "bool"  ADU
 SG_ OBJ_Length_4 : 140|9@1+ (0.05,0) [1.2|21] "m"  ADU
 SG_ OBJ_Length_V_4 : 149|1@1+ (1,0) [0|1] "bool"  ADU
 SG_ OBJ_Length_STD_4 : 150|10@1+ (0.01,0) [0|10] "m"  ADU
 SG_ OBJ_Length_STD_V_4 : 160|1@1+ (1,0) [0|1] "bool"  ADU
 SG_ OBJ_Height_4 : 161|9@1+ (0.01,0) [0|2.95] "m"  ADU
 SG_ OBJ_Height_V_4 : 170|1@1+ (1,0) [0|1] "bool"  ADU
 SG_ OBJ_Height_STD_4 : 171|11@1+ (0.001,0) [0|2] "m"  ADU
 SG_ OBJ_Height_STD_V_4 : 182|1@1+ (1,0) [0|1] "bool"  ADU
 SG_ OBJ_Abs_Long_Velocity_4 : 183|12@1+ (0.05,-100) [-100|100] "m_per_s"  ADU
 SG_ OBJ_Abs_Long_Velocity_V_4 : 195|1@1+ (1,0) [0|1] "bool"  ADU
 SG_ OBJ_Abs_Long_Velocity_STD_4 : 196|13@1+ (0.01,0) [0|65] "m_per_s"  ADU
 SG_ OBJ_Abs_Long_Vel_STD_V_4 : 209|1@1+ (1,0) [0|1] "bool"  ADU
 SG_ OBJ_Abs_Lat_Velocity_4 : 210|11@1+ (0.05,-50) [-50|50] "m_per_s"  ADU
 SG_ OBJ_Abs_Lat_Velocity_V_4 : 221|1@1+ (1,0) [0|1] "bool"  ADU
 SG_ OBJ_Abs_Lat_Velocity_STD_4 : 222|13@1+ (0.01,0) [0|50] "m_per_s"  ADU
 SG_ OBJ_Abs_Lat_Vel_STD_V_4 : 235|1@1+ (1,0) [0|1] "bool"  ADU
 SG_ OBJ_Abs_Long_Acc_4 : 236|9@1+ (0.05,-10) [-10|10] "m_per_s2"  ADU
 SG_ OBJ_Abs_Long_Acc_V_4 : 245|1@1+ (1,0) [0|1] "bool"  ADU
 SG_ OBJ_Abs_Long_Acc_STD_4 : 246|10@1+ (0.01,0) [0|7.3] "m_per_s2"  ADU
 SG_ OBJ_Abs_Long_Acc_STD_V_4 : 256|1@1+ (1,0) [0|1] "bool"  ADU
 SG_ OBJ_Abs_Lat_Acc_4 : 257|9@1+ (0.05,-10.3) [-10.3|7.3] "m_per_s2"  ADU
 SG_ OBJ_Abs_Lat_Acc_V_4 : 266|1@1+ (1,0) [0|1] "bool"  ADU
 SG_ OBJ_Abs_Lat_Acc_STD_4 : 267|10@1+ (0.01,0) [0|7.3] "m_per_s2"  ADU
 SG_ OBJ_Abs_Lat_Acc_STD_V_4 : 277|1@1+ (1,0) [0|1] "bool"  ADU
 SG_ OBJ_Abs_Acceleration_4 : 278|9@1+ (0.05,-10.3) [-10.3|7.3] "m_per_s2"  ADU
 SG_ OBJ_Abs_Acceleration_V_4 : 287|1@1+ (1,0) [0|1] "bool"  ADU
 SG_ OBJ_Abs_Acc_STD_4 : 288|10@1+ (0.01,0) [0|7.3] "m_per_s2"  ADU
 SG_ OBJ_Abs_Acc_STD_V_4 : 298|1@1+ (1,0) [0|1] "bool"  ADU
 SG_ OBJ_Inv_TTC_4 : 299|11@1+ (0.01,-8) [-8|8] "INV(s)"  ADU
 SG_ OBJ_Inv_TTC_V_4 : 310|1@1+ (1,0) [0|1] "bool"  ADU
 SG_ OBJ_Inv_TTC_STD_4 : 311|12@1+ (0.001,0) [0|4] "INV(s)"  ADU
 SG_ OBJ_Inv_TTC_STD_V_4 : 323|1@1+ (1,0) [0|1] "bool"  ADU
 SG_ OBJ_Relative_Long_Acc_4 : 324|10@1+ (0.05,-20) [-20|20] "m_per_s2"  ADU
 SG_ OBJ_Relative_Long_Acc_V_4 : 334|1@1+ (1,0) [0|1] "bool"  ADU
 SG_ OBJ_Relative_Long_Acc_STD_4 : 335|10@1+ (0.01,0) [0|7.3] "m_per_s2"  ADU
 SG_ OBJ_Rel_Long_Acc_STD_V_4 : 345|1@1+ (1,0) [0|1] "bool"  ADU
 SG_ OBJ_Relative_Long_Velocity_4 : 346|13@1+ (0.05,-120) [-120|130] "m_per_s"  ADU
 SG_ OBJ_Relative_Long_Velocity_V_4 : 359|1@1+ (1,0) [0|1] "bool"  ADU
 SG_ OBJ_Relative_Long_Vel_STD_4 : 360|14@1+ (0.01,0) [0|130] "m_per_s"  ADU
 SG_ OBJ_Rel_Long_Vel_STD_V_4 : 374|1@1+ (1,0) [0|1] "bool"  ADU

BO_ 410 Core_Objects_protocol_4_1: 48 ADAS
 SG_ OBJ_Sync_ID_4_1 : 0|8@1+ (1,0) [0|255] "counter"  ADU
 SG_ OBJ_Relative_Lat_Velocity_4 : 8|11@1+ (0.05,-50) [-50|50] "m_per_s"  ADU
 SG_ OBJ_Relative_Lat_Velocity_V_4 : 19|1@1+ (1,0) [0|1] "bool"  ADU
 SG_ OBJ_Relative_Lat_Velocity_STD_4 : 20|13@1+ (0.01,0) [0|50] "m_per_s"  ADU
 SG_ OBJ_Rel_Lat_Vel_STD_V_4 : 33|1@1+ (1,0) [0|1] "bool"  ADU
 SG_ OBJ_Long_Distance_4 : 34|14@1+ (0.05,-200) [-200|500] "m"  ADU
 SG_ OBJ_Long_Distance_V_4 : 48|1@1+ (1,0) [0|1] "bool"  ADU
 SG_ OBJ_Long_Distance_STD_4 : 49|15@1+ (0.01,0) [0|250] "m"  ADU
 SG_ OBJ_Long_Distance_STD_V_4 : 64|1@1+ (1,0) [0|1] "bool"  ADU
 SG_ OBJ_Lat_Distance_4 : 65|12@1+ (0.05,-100) [-100|100] "m"  ADU
 SG_ OBJ_Lat_Distance_V_4 : 77|1@1+ (1,0) [0|1] "bool"  ADU
 SG_ OBJ_Lat_Distance_STD_4 : 78|14@1+ (0.01,0) [0|100] "m"  ADU
 SG_ OBJ_Lat_Distance_STD_V_4 : 92|1@1+ (1,0) [0|1] "bool"  ADU
 SG_ OBJ_Absolute_Speed_4 : 93|12@1+ (0.05,-65) [-65|65] "m_per_s"  ADU
 SG_ OBJ_Absolute_Speed_V_4 : 105|1@1+ (1,0) [0|1] "bool"  ADU
 SG_ OBJ_Absolute_Speed_STD_4 : 106|13@1+ (0.01,0) [0|65] "m_per_s"  ADU
 SG_ OBJ_Absolute_Speed_STD_V_4 : 119|1@1+ (1,0) [0|1] "bool"  ADU
 SG_ OBJ_Heading_4 : 120|10@1+ (0.01,-3.14) [-3.14|3.14] "rad"  ADU
 SG_ OBJ_Heading_V_4 : 130|1@1+ (1,0) [0|1] "bool"  ADU
 SG_ OBJ_Heading_STD_4 : 131|15@1+ (0.0001,0) [0|3.14] "rad"  ADU
 SG_ OBJ_Heading_STD_V_4 : 146|1@1+ (1,0) [0|1] "bool"  ADU
 SG_ OBJ_Angle_Rate_STD_4 : 147|15@1+ (0.0001,0) [0|2.2318] "RPS"  ADU
 SG_ OBJ_Angle_Rate_STD_V_4 : 162|1@1+ (1,0) [0|1] "bool"  ADU
 SG_ OBJ_Angle_Rate_4 : 163|12@1+ (0.002,-2.234) [-2.234|2.2318] "RPS"  ADU
 SG_ OBJ_Angle_Rate_V_4 : 175|1@1+ (1,0) [0|1] "bool"  ADU
 SG_ OBJ_Angle_Right_4 : 176|14@1+ (0.0002,-1.571) [-1.571|1.571] "rad"  ADU
 SG_ OBJ_Angle_Right_V_4 : 190|1@1+ (1,0) [0|1] "bool"  ADU
 SG_ OBJ_Angle_Right_STD_4 : 191|14@1+ (0.0001,0) [0|1.571] "rad"  ADU
 SG_ OBJ_Angle_Right_STD_V_4 : 205|1@1+ (1,0) [0|1] "bool"  ADU
 SG_ OBJ_Angle_Left_4 : 206|14@1+ (0.0002,-1.571) [-1.571|1.571] "rad"  ADU
 SG_ OBJ_Angle_Left_V_4 : 220|1@1+ (1,0) [0|1] "bool"  ADU
 SG_ OBJ_Angle_Left_STD_4 : 221|14@1+ (0.0001,0) [0|1.571] "rad"  ADU
 SG_ OBJ_Angle_Left_STD_V_4 : 235|1@1+ (1,0) [0|1] "bool"  ADU
 SG_ OBJ_Angle_Side_4 : 236|14@1+ (0.0002,-1.571) [-1.571|1.571] "rad"  ADU
 SG_ OBJ_Angle_Side_V_4 : 250|1@1+ (1,0) [0|1] "bool"  ADU
 SG_ OBJ_Angle_Side_STD_4 : 251|14@1+ (0.0001,0) [0|1.571] "rad"  ADU
 SG_ OBJ_Angle_Side_STD_V_4 : 265|1@1+ (1,0) [0|1] "bool"  ADU
 SG_ OBJ_Angle_Mid_V_4 : 266|1@1+ (1,0) [0|1] "bool"  ADU
 SG_ OBJ_Angle_Mid_4 : 267|14@1+ (0.0002,-1.571) [-1.571|1.571] "rad"  ADU
 SG_ OBJ_Angle_Mid_STD_4 : 281|14@1+ (0.0001,0) [0|1.571] "rad"  ADU
 SG_ OBJ_Angle_Mid_STD_V_4 : 295|1@1+ (1,0) [0|1] "bool"  ADU
 SG_ OBJ_Angle_Bottom_V_4 : 296|1@1+ (1,0) [0|1] "bool"  ADU
 SG_ OBJ_Angle_Bottom_4 : 297|14@1+ (0.0002,-1.571) [-1.571|1.571] "rad"  ADU
 SG_ OBJ_Angle_Bottom_STD_4 : 311|14@1+ (0.0001,0) [0|1.571] "rad"  ADU
 SG_ OBJ_Angle_Bottom_STD_V_4 : 325|1@1+ (1,0) [0|1] "bool"  ADU
 SG_ OBJ_Visibility_Side_V_4 : 326|1@1+ (1,0) [0|1] "bool"  ADU
 SG_ OBJ_Visibility_Side_4 : 327|2@1+ (1,0) [0|2] "ENUM"  ADU
 SG_ OBJ_Is_In_Drivable_Area_4 : 329|1@1+ (1,0) [0|1] "bool"  ADU
 SG_ OBJ_Is_In_Drivable_Area_V_4 : 330|1@1+ (1,0) [0|1] "bool"  ADU
 SG_ OBJ_Is_VeryClose_V_4 : 331|1@1+ (1,0) [0|1] "bool"  ADU
 SG_ OBJ_Is_VeryClose_4 : 332|1@1+ (1,0) [0|1] "bool"  ADU
 SG_ OBJ_Is_EMERGENCY_VCL_4 : 333|1@1+ (1,0) [0|1] "bool"  ADU
 SG_ OBJ_EMERGENCY_LIGHT_COLOR_4 : 334|4@1+ (1,0) [0|15] "BITWIZE"  ADU
 SG_ OBJ_EMERGENCY_V_4 : 338|1@1+ (1,0) [0|1] "bool"  ADU

BO_ 411 Core_Objects_protocol_5_0: 48 ADAS
 SG_ OBJ_Sync_ID_5_0 : 0|8@1+ (1,0) [0|255] "counter"  ADU
 SG_ OBJ_CRC_5 : 8|32@1+ (1,0) [0|4294970000] "NA"  ADU
 SG_ OBJ_ID_5 : 40|8@1+ (1,0) [0|255] "counter"  ADU
 SG_ OBJ_Existence_Probability_5 : 48|8@1+ (0.01,0) [0|1] "NA"  ADU
 SG_ OBJ_Motion_Category_5 : 56|4@1+ (1,0) [0|13] "ENUM"  ADU
 SG_ OBJ_Object_Age_5 : 60|11@1+ (1,0) [0|2047] "frames"  ADU
 SG_ OBJ_Measuring_Status_5 : 71|3@1+ (1,0) [0|7] "BITWIZE"  ADU
 SG_ OBJ_Object_Class_5 : 74|4@1+ (1,0) [0|8] "ENUM"  ADU
 SG_ OBJ_Class_Probability_5 : 78|7@1+ (0.01,0) [0|1] "NA"  ADU
 SG_ OBJ_Motion_Status_5 : 85|3@1+ (1,0) [0|5] "ENUM"  ADU
 SG_ OBJ_Motion_Orientation_5 : 88|4@1+ (1,0) [0|13] "ENUM"  ADU
 SG_ OBJ_Has_Cut_Lane_5 : 92|1@1+ (1,0) [0|1] "bool"  ADU
 SG_ OBJ_Has_Cut_Path_5 : 93|1@1+ (1,0) [0|1] "bool"  ADU
 SG_ OBJ_Brake_Light_5 : 94|1@1+ (1,0) [0|1] "bool"  ADU
 SG_ OBJ_Turn_Indicator_Right_5 : 95|1@1+ (1,0) [0|1] "bool"  ADU
 SG_ OBJ_Turn_Indicator_Left_5 : 96|1@1+ (1,0) [0|1] "bool"  ADU
 SG_ OBJ_Light_Indicator_Validity_5 : 97|1@1+ (1,0) [0|1] "bool"  ADU
 SG_ OBJ_Right_Out_Of_Image_5 : 98|1@1+ (1,0) [0|1] "bool"  ADU
 SG_ OBJ_Left_Out_Of_Image_5 : 99|1@1+ (1,0) [0|1] "bool"  ADU
 SG_ OBJ_Right_Out_Of_Image_V_5 : 100|1@1+ (1,0) [0|1] "bool"  ADU
 SG_ OBJ_Left_Out_Of_Image_V_5 : 101|1@1+ (1,0) [0|1] "bool"  ADU
 SG_ OBJ_Top_Out_Of_Image_5 : 102|1@1+ (1,0) [0|1] "bool"  ADU
 SG_ OBJ_Bottom_Out_Of_Image_5 : 103|1@1+ (1,0) [0|1] "bool"  ADU
 SG_ OBJ_Top_Out_Of_Image_V_5 : 104|1@1+ (1,0) [0|1] "bool"  ADU
 SG_ OBJ_Bottom_Out_Of_Image_V_5 : 105|1@1+ (1,0) [0|1] "bool"  ADU
 SG_ OBJ_Lane_Assignment_5 : 106|3@1+ (1,0) [0|5] "ENUM"  ADU
 SG_ OBJ_Lane_Assignment_V_5 : 109|1@1+ (1,0) [0|1] "bool"  ADU
 SG_ OBJ_Age_Seconds_5 : 110|7@1+ (1,0) [0|100] "s"  ADU
 SG_ OBJ_Age_Seconds_V_5 : 117|1@1+ (1,0) [0|1] "bool"  ADU
 SG_ OBJ_Width_5 : 118|9@1+ (0.01,0) [0.4|2.95] "m"  ADU
 SG_ OBJ_Width_V_5 : 127|1@1+ (1,0) [0|1] "bool"  ADU
 SG_ OBJ_Width_STD_5 : 128|11@1+ (0.001,0) [0|2] "m"  ADU
 SG_ OBJ_Width_STD_V_5 : 139|1@1+ (1,0) [0|1] "bool"  ADU
 SG_ OBJ_Length_5 : 140|9@1+ (0.05,0) [1.2|21] "m"  ADU
 SG_ OBJ_Length_V_5 : 149|1@1+ (1,0) [0|1] "bool"  ADU
 SG_ OBJ_Length_STD_5 : 150|10@1+ (0.01,0) [0|10] "m"  ADU
 SG_ OBJ_Length_STD_V_5 : 160|1@1+ (1,0) [0|1] "bool"  ADU
 SG_ OBJ_Height_5 : 161|9@1+ (0.01,0) [0|2.95] "m"  ADU
 SG_ OBJ_Height_V_5 : 170|1@1+ (1,0) [0|1] "bool"  ADU
 SG_ OBJ_Height_STD_5 : 171|11@1+ (0.001,0) [0|2] "m"  ADU
 SG_ OBJ_Height_STD_V_5 : 182|1@1+ (1,0) [0|1] "bool"  ADU
 SG_ OBJ_Abs_Long_Velocity_5 : 183|12@1+ (0.05,-100) [-100|100] "m_per_s"  ADU
 SG_ OBJ_Abs_Long_Velocity_V_5 : 195|1@1+ (1,0) [0|1] "bool"  ADU
 SG_ OBJ_Abs_Long_Velocity_STD_5 : 196|13@1+ (0.01,0) [0|65] "m_per_s"  ADU
 SG_ OBJ_Abs_Long_Vel_STD_V_5 : 209|1@1+ (1,0) [0|1] "bool"  ADU
 SG_ OBJ_Abs_Lat_Velocity_5 : 210|11@1+ (0.05,-50) [-50|50] "m_per_s"  ADU
 SG_ OBJ_Abs_Lat_Velocity_V_5 : 221|1@1+ (1,0) [0|1] "bool"  ADU
 SG_ OBJ_Abs_Lat_Velocity_STD_5 : 222|13@1+ (0.01,0) [0|50] "m_per_s"  ADU
 SG_ OBJ_Abs_Lat_Vel_STD_V_5 : 235|1@1+ (1,0) [0|1] "bool"  ADU
 SG_ OBJ_Abs_Long_Acc_5 : 236|9@1+ (0.05,-10) [-10|10] "m_per_s2"  ADU
 SG_ OBJ_Abs_Long_Acc_V_5 : 245|1@1+ (1,0) [0|1] "bool"  ADU
 SG_ OBJ_Abs_Long_Acc_STD_5 : 246|10@1+ (0.01,0) [0|7.3] "m_per_s2"  ADU
 SG_ OBJ_Abs_Long_Acc_STD_V_5 : 256|1@1+ (1,0) [0|1] "bool"  ADU
 SG_ OBJ_Abs_Lat_Acc_5 : 257|9@1+ (0.05,-10.3) [-10.3|7.3] "m_per_s2"  ADU
 SG_ OBJ_Abs_Lat_Acc_V_5 : 266|1@1+ (1,0) [0|1] "bool"  ADU
 SG_ OBJ_Abs_Lat_Acc_STD_5 : 267|10@1+ (0.01,0) [0|7.3] "m_per_s2"  ADU
 SG_ OBJ_Abs_Lat_Acc_STD_V_5 : 277|1@1+ (1,0) [0|1] "bool"  ADU
 SG_ OBJ_Abs_Acceleration_5 : 278|9@1+ (0.05,-10.3) [-10.3|7.3] "m_per_s2"  ADU
 SG_ OBJ_Abs_Acceleration_V_5 : 287|1@1+ (1,0) [0|1] "bool"  ADU
 SG_ OBJ_Abs_Acc_STD_5 : 288|10@1+ (0.01,0) [0|7.3] "m_per_s2"  ADU
 SG_ OBJ_Abs_Acc_STD_V_5 : 298|1@1+ (1,0) [0|1] "bool"  ADU
 SG_ OBJ_Inv_TTC_5 : 299|11@1+ (0.01,-8) [-8|8] "INV(s)"  ADU
 SG_ OBJ_Inv_TTC_V_5 : 310|1@1+ (1,0) [0|1] "bool"  ADU
 SG_ OBJ_Inv_TTC_STD_5 : 311|12@1+ (0.001,0) [0|4] "INV(s)"  ADU
 SG_ OBJ_Inv_TTC_STD_V_5 : 323|1@1+ (1,0) [0|1] "bool"  ADU
 SG_ OBJ_Relative_Long_Acc_5 : 324|10@1+ (0.05,-20) [-20|20] "m_per_s2"  ADU
 SG_ OBJ_Relative_Long_Acc_V_5 : 334|1@1+ (1,0) [0|1] "bool"  ADU
 SG_ OBJ_Relative_Long_Acc_STD_5 : 335|10@1+ (0.01,0) [0|7.3] "m_per_s2"  ADU
 SG_ OBJ_Rel_Long_Acc_STD_V_5 : 345|1@1+ (1,0) [0|1] "bool"  ADU
 SG_ OBJ_Relative_Long_Velocity_5 : 346|13@1+ (0.05,-120) [-120|130] "m_per_s"  ADU
 SG_ OBJ_Relative_Long_Velocity_V_5 : 359|1@1+ (1,0) [0|1] "bool"  ADU
 SG_ OBJ_Relative_Long_Vel_STD_5 : 360|14@1+ (0.01,0) [0|130] "m_per_s"  ADU
 SG_ OBJ_Rel_Long_Vel_STD_V_5 : 374|1@1+ (1,0) [0|1] "bool"  ADU

BO_ 412 Core_Objects_protocol_5_1: 48 ADAS
 SG_ OBJ_Sync_ID_5_1 : 0|8@1+ (1,0) [0|255] "counter"  ADU
 SG_ OBJ_Relative_Lat_Velocity_5 : 8|11@1+ (0.05,-50) [-50|50] "m_per_s"  ADU
 SG_ OBJ_Relative_Lat_Velocity_V_5 : 19|1@1+ (1,0) [0|1] "bool"  ADU
 SG_ OBJ_Relative_Lat_Velocity_STD_5 : 20|13@1+ (0.01,0) [0|50] "m_per_s"  ADU
 SG_ OBJ_Rel_Lat_Vel_STD_V_5 : 33|1@1+ (1,0) [0|1] "bool"  ADU
 SG_ OBJ_Long_Distance_5 : 34|14@1+ (0.05,-200) [-200|500] "m"  ADU
 SG_ OBJ_Long_Distance_V_5 : 48|1@1+ (1,0) [0|1] "bool"  ADU
 SG_ OBJ_Long_Distance_STD_5 : 49|15@1+ (0.01,0) [0|250] "m"  ADU
 SG_ OBJ_Long_Distance_STD_V_5 : 64|1@1+ (1,0) [0|1] "bool"  ADU
 SG_ OBJ_Lat_Distance_5 : 65|12@1+ (0.05,-100) [-100|100] "m"  ADU
 SG_ OBJ_Lat_Distance_V_5 : 77|1@1+ (1,0) [0|1] "bool"  ADU
 SG_ OBJ_Lat_Distance_STD_5 : 78|14@1+ (0.01,0) [0|100] "m"  ADU
 SG_ OBJ_Lat_Distance_STD_V_5 : 92|1@1+ (1,0) [0|1] "bool"  ADU
 SG_ OBJ_Absolute_Speed_5 : 93|12@1+ (0.05,-65) [-65|65] "m_per_s"  ADU
 SG_ OBJ_Absolute_Speed_V_5 : 105|1@1+ (1,0) [0|1] "bool"  ADU
 SG_ OBJ_Absolute_Speed_STD_5 : 106|13@1+ (0.01,0) [0|65] "m_per_s"  ADU
 SG_ OBJ_Absolute_Speed_STD_V_5 : 119|1@1+ (1,0) [0|1] "bool"  ADU
 SG_ OBJ_Heading_5 : 120|10@1+ (0.01,-3.14) [-3.14|3.14] "rad"  ADU
 SG_ OBJ_Heading_V_5 : 130|1@1+ (1,0) [0|1] "bool"  ADU
 SG_ OBJ_Heading_STD_5 : 131|15@1+ (0.0001,0) [0|3.14] "rad"  ADU
 SG_ OBJ_Heading_STD_V_5 : 146|1@1+ (1,0) [0|1] "bool"  ADU
 SG_ OBJ_Angle_Rate_STD_5 : 147|15@1+ (0.0001,0) [0|2.2318] "RPS"  ADU
 SG_ OBJ_Angle_Rate_STD_V_5 : 162|1@1+ (1,0) [0|1] "bool"  ADU
 SG_ OBJ_Angle_Rate_5 : 163|12@1+ (0.002,-2.234) [-2.234|2.2318] "RPS"  ADU
 SG_ OBJ_Angle_Rate_V_5 : 175|1@1+ (1,0) [0|1] "bool"  ADU
 SG_ OBJ_Angle_Right_5 : 176|14@1+ (0.0002,-1.571) [-1.571|1.571] "rad"  ADU
 SG_ OBJ_Angle_Right_V_5 : 190|1@1+ (1,0) [0|1] "bool"  ADU
 SG_ OBJ_Angle_Right_STD_5 : 191|14@1+ (0.0001,0) [0|1.571] "rad"  ADU
 SG_ OBJ_Angle_Right_STD_V_5 : 205|1@1+ (1,0) [0|1] "bool"  ADU
 SG_ OBJ_Angle_Left_5 : 206|14@1+ (0.0002,-1.571) [-1.571|1.571] "rad"  ADU
 SG_ OBJ_Angle_Left_V_5 : 220|1@1+ (1,0) [0|1] "bool"  ADU
 SG_ OBJ_Angle_Left_STD_5 : 221|14@1+ (0.0001,0) [0|1.571] "rad"  ADU
 SG_ OBJ_Angle_Left_STD_V_5 : 235|1@1+ (1,0) [0|1] "bool"  ADU
 SG_ OBJ_Angle_Side_5 : 236|14@1+ (0.0002,-1.571) [-1.571|1.571] "rad"  ADU
 SG_ OBJ_Angle_Side_V_5 : 250|1@1+ (1,0) [0|1] "bool"  ADU
 SG_ OBJ_Angle_Side_STD_5 : 251|14@1+ (0.0001,0) [0|1.571] "rad"  ADU
 SG_ OBJ_Angle_Side_STD_V_5 : 265|1@1+ (1,0) [0|1] "bool"  ADU
 SG_ OBJ_Angle_Mid_V_5 : 266|1@1+ (1,0) [0|1] "bool"  ADU
 SG_ OBJ_Angle_Mid_5 : 267|14@1+ (0.0002,-1.571) [-1.571|1.571] "rad"  ADU
 SG_ OBJ_Angle_Mid_STD_5 : 281|14@1+ (0.0001,0) [0|1.571] "rad"  ADU
 SG_ OBJ_Angle_Mid_STD_V_5 : 295|1@1+ (1,0) [0|1] "bool"  ADU
 SG_ OBJ_Angle_Bottom_V_5 : 296|1@1+ (1,0) [0|1] "bool"  ADU
 SG_ OBJ_Angle_Bottom_5 : 297|14@1+ (0.0002,-1.571) [-1.571|1.571] "rad"  ADU
 SG_ OBJ_Angle_Bottom_STD_5 : 311|14@1+ (0.0001,0) [0|1.571] "rad"  ADU
 SG_ OBJ_Angle_Bottom_STD_V_5 : 325|1@1+ (1,0) [0|1] "bool"  ADU
 SG_ OBJ_Visibility_Side_V_5 : 326|1@1+ (1,0) [0|1] "bool"  ADU
 SG_ OBJ_Visibility_Side_5 : 327|2@1+ (1,0) [0|2] "ENUM"  ADU
 SG_ OBJ_Is_In_Drivable_Area_5 : 329|1@1+ (1,0) [0|1] "bool"  ADU
 SG_ OBJ_Is_In_Drivable_Area_V_5 : 330|1@1+ (1,0) [0|1] "bool"  ADU
 SG_ OBJ_Is_VeryClose_V_5 : 331|1@1+ (1,0) [0|1] "bool"  ADU
 SG_ OBJ_Is_VeryClose_5 : 332|1@1+ (1,0) [0|1] "bool"  ADU
 SG_ OBJ_Is_EMERGENCY_VCL_5 : 333|1@1+ (1,0) [0|1] "bool"  ADU
 SG_ OBJ_EMERGENCY_LIGHT_COLOR_5 : 334|4@1+ (1,0) [0|15] "BITWIZE"  ADU
 SG_ OBJ_EMERGENCY_V_5 : 338|1@1+ (1,0) [0|1] "bool"  ADU

BO_ 413 Core_Objects_protocol_6_0: 48 ADAS
 SG_ OBJ_Sync_ID_6_0 : 0|8@1+ (1,0) [0|255] "counter"  ADU
 SG_ OBJ_CRC_6 : 8|32@1+ (1,0) [0|4294970000] "NA"  ADU
 SG_ OBJ_ID_6 : 40|8@1+ (1,0) [0|255] "counter"  ADU
 SG_ OBJ_Existence_Probability_6 : 48|8@1+ (0.01,0) [0|1] "NA"  ADU
 SG_ OBJ_Motion_Category_6 : 56|4@1+ (1,0) [0|13] "ENUM"  ADU
 SG_ OBJ_Object_Age_6 : 60|11@1+ (1,0) [0|2047] "frames"  ADU
 SG_ OBJ_Measuring_Status_6 : 71|3@1+ (1,0) [0|7] "BITWIZE"  ADU
 SG_ OBJ_Object_Class_6 : 74|4@1+ (1,0) [0|8] "ENUM"  ADU
 SG_ OBJ_Class_Probability_6 : 78|7@1+ (0.01,0) [0|1] "NA"  ADU
 SG_ OBJ_Motion_Status_6 : 85|3@1+ (1,0) [0|5] "ENUM"  ADU
 SG_ OBJ_Motion_Orientation_6 : 88|4@1+ (1,0) [0|13] "ENUM"  ADU
 SG_ OBJ_Has_Cut_Lane_6 : 92|1@1+ (1,0) [0|1] "bool"  ADU
 SG_ OBJ_Has_Cut_Path_6 : 93|1@1+ (1,0) [0|1] "bool"  ADU
 SG_ OBJ_Brake_Light_6 : 94|1@1+ (1,0) [0|1] "bool"  ADU
 SG_ OBJ_Turn_Indicator_Right_6 : 95|1@1+ (1,0) [0|1] "bool"  ADU
 SG_ OBJ_Turn_Indicator_Left_6 : 96|1@1+ (1,0) [0|1] "bool"  ADU
 SG_ OBJ_Light_Indicator_Validity_6 : 97|1@1+ (1,0) [0|1] "bool"  ADU
 SG_ OBJ_Right_Out_Of_Image_6 : 98|1@1+ (1,0) [0|1] "bool"  ADU
 SG_ OBJ_Left_Out_Of_Image_6 : 99|1@1+ (1,0) [0|1] "bool"  ADU
 SG_ OBJ_Right_Out_Of_Image_V_6 : 100|1@1+ (1,0) [0|1] "bool"  ADU
 SG_ OBJ_Left_Out_Of_Image_V_6 : 101|1@1+ (1,0) [0|1] "bool"  ADU
 SG_ OBJ_Top_Out_Of_Image_6 : 102|1@1+ (1,0) [0|1] "bool"  ADU
 SG_ OBJ_Bottom_Out_Of_Image_6 : 103|1@1+ (1,0) [0|1] "bool"  ADU
 SG_ OBJ_Top_Out_Of_Image_V_6 : 104|1@1+ (1,0) [0|1] "bool"  ADU
 SG_ OBJ_Bottom_Out_Of_Image_V_6 : 105|1@1+ (1,0) [0|1] "bool"  ADU
 SG_ OBJ_Lane_Assignment_6 : 106|3@1+ (1,0) [0|5] "ENUM"  ADU
 SG_ OBJ_Lane_Assignment_V_6 : 109|1@1+ (1,0) [0|1] "bool"  ADU
 SG_ OBJ_Age_Seconds_6 : 110|7@1+ (1,0) [0|100] "s"  ADU
 SG_ OBJ_Age_Seconds_V_6 : 117|1@1+ (1,0) [0|1] "bool"  ADU
 SG_ OBJ_Width_6 : 118|9@1+ (0.01,0) [0.4|2.95] "m"  ADU
 SG_ OBJ_Width_V_6 : 127|1@1+ (1,0) [0|1] "bool"  ADU
 SG_ OBJ_Width_STD_6 : 128|11@1+ (0.001,0) [0|2] "m"  ADU
 SG_ OBJ_Width_STD_V_6 : 139|1@1+ (1,0) [0|1] "bool"  ADU
 SG_ OBJ_Length_6 : 140|9@1+ (0.05,0) [1.2|21] "m"  ADU
 SG_ OBJ_Length_V_6 : 149|1@1+ (1,0) [0|1] "bool"  ADU
 SG_ OBJ_Length_STD_6 : 150|10@1+ (0.01,0) [0|10] "m"  ADU
 SG_ OBJ_Length_STD_V_6 : 160|1@1+ (1,0) [0|1] "bool"  ADU
 SG_ OBJ_Height_6 : 161|9@1+ (0.01,0) [0|2.95] "m"  ADU
 SG_ OBJ_Height_V_6 : 170|1@1+ (1,0) [0|1] "bool"  ADU
 SG_ OBJ_Height_STD_6 : 171|11@1+ (0.001,0) [0|2] "m"  ADU
 SG_ OBJ_Height_STD_V_6 : 182|1@1+ (1,0) [0|1] "bool"  ADU
 SG_ OBJ_Abs_Long_Velocity_6 : 183|12@1+ (0.05,-100) [-100|100] "m_per_s"  ADU
 SG_ OBJ_Abs_Long_Velocity_V_6 : 195|1@1+ (1,0) [0|1] "bool"  ADU
 SG_ OBJ_Abs_Long_Velocity_STD_6 : 196|13@1+ (0.01,0) [0|65] "m_per_s"  ADU
 SG_ OBJ_Abs_Long_Vel_STD_V_6 : 209|1@1+ (1,0) [0|1] "bool"  ADU
 SG_ OBJ_Abs_Lat_Velocity_6 : 210|11@1+ (0.05,-50) [-50|50] "m_per_s"  ADU
 SG_ OBJ_Abs_Lat_Velocity_V_6 : 221|1@1+ (1,0) [0|1] "bool"  ADU
 SG_ OBJ_Abs_Lat_Velocity_STD_6 : 222|13@1+ (0.01,0) [0|50] "m_per_s"  ADU
 SG_ OBJ_Abs_Lat_Vel_STD_V_6 : 235|1@1+ (1,0) [0|1] "bool"  ADU
 SG_ OBJ_Abs_Long_Acc_6 : 236|9@1+ (0.05,-10) [-10|10] "m_per_s2"  ADU
 SG_ OBJ_Abs_Long_Acc_V_6 : 245|1@1+ (1,0) [0|1] "bool"  ADU
 SG_ OBJ_Abs_Long_Acc_STD_6 : 246|10@1+ (0.01,0) [0|7.3] "m_per_s2"  ADU
 SG_ OBJ_Abs_Long_Acc_STD_V_6 : 256|1@1+ (1,0) [0|1] "bool"  ADU
 SG_ OBJ_Abs_Lat_Acc_6 : 257|9@1+ (0.05,-10.3) [-10.3|7.3] "m_per_s2"  ADU
 SG_ OBJ_Abs_Lat_Acc_V_6 : 266|1@1+ (1,0) [0|1] "bool"  ADU
 SG_ OBJ_Abs_Lat_Acc_STD_6 : 267|10@1+ (0.01,0) [0|7.3] "m_per_s2"  ADU
 SG_ OBJ_Abs_Lat_Acc_STD_V_6 : 277|1@1+ (1,0) [0|1] "bool"  ADU
 SG_ OBJ_Abs_Acceleration_6 : 278|9@1+ (0.05,-10.3) [-10.3|7.3] "m_per_s2"  ADU
 SG_ OBJ_Abs_Acceleration_V_6 : 287|1@1+ (1,0) [0|1] "bool"  ADU
 SG_ OBJ_Abs_Acc_STD_6 : 288|10@1+ (0.01,0) [0|7.3] "m_per_s2"  ADU
 SG_ OBJ_Abs_Acc_STD_V_6 : 298|1@1+ (1,0) [0|1] "bool"  ADU
 SG_ OBJ_Inv_TTC_6 : 299|11@1+ (0.01,-8) [-8|8] "INV(s)"  ADU
 SG_ OBJ_Inv_TTC_V_6 : 310|1@1+ (1,0) [0|1] "bool"  ADU
 SG_ OBJ_Inv_TTC_STD_6 : 311|12@1+ (0.001,0) [0|4] "INV(s)"  ADU
 SG_ OBJ_Inv_TTC_STD_V_6 : 323|1@1+ (1,0) [0|1] "bool"  ADU
 SG_ OBJ_Relative_Long_Acc_6 : 324|10@1+ (0.05,-20) [-20|20] "m_per_s2"  ADU
 SG_ OBJ_Relative_Long_Acc_V_6 : 334|1@1+ (1,0) [0|1] "bool"  ADU
 SG_ OBJ_Relative_Long_Acc_STD_6 : 335|10@1+ (0.01,0) [0|7.3] "m_per_s2"  ADU
 SG_ OBJ_Rel_Long_Acc_STD_V_6 : 345|1@1+ (1,0) [0|1] "bool"  ADU
 SG_ OBJ_Relative_Long_Velocity_6 : 346|13@1+ (0.05,-120) [-120|130] "m_per_s"  ADU
 SG_ OBJ_Relative_Long_Velocity_V_6 : 359|1@1+ (1,0) [0|1] "bool"  ADU
 SG_ OBJ_Relative_Long_Vel_STD_6 : 360|14@1+ (0.01,0) [0|130] "m_per_s"  ADU
 SG_ OBJ_Rel_Long_Vel_STD_V_6 : 374|1@1+ (1,0) [0|1] "bool"  ADU

BO_ 414 Core_Objects_protocol_6_1: 48 ADAS
 SG_ OBJ_Sync_ID_6_1 : 0|8@1+ (1,0) [0|255] "counter"  ADU
 SG_ OBJ_Relative_Lat_Velocity_6 : 8|11@1+ (0.05,-50) [-50|50] "m_per_s"  ADU
 SG_ OBJ_Relative_Lat_Velocity_V_6 : 19|1@1+ (1,0) [0|1] "bool"  ADU
 SG_ OBJ_Relative_Lat_Velocity_STD_6 : 20|13@1+ (0.01,0) [0|50] "m_per_s"  ADU
 SG_ OBJ_Rel_Lat_Vel_STD_V_6 : 33|1@1+ (1,0) [0|1] "bool"  ADU
 SG_ OBJ_Long_Distance_6 : 34|14@1+ (0.05,-200) [-200|500] "m"  ADU
 SG_ OBJ_Long_Distance_V_6 : 48|1@1+ (1,0) [0|1] "bool"  ADU
 SG_ OBJ_Long_Distance_STD_6 : 49|15@1+ (0.01,0) [0|250] "m"  ADU
 SG_ OBJ_Long_Distance_STD_V_6 : 64|1@1+ (1,0) [0|1] "bool"  ADU
 SG_ OBJ_Lat_Distance_6 : 65|12@1+ (0.05,-100) [-100|100] "m"  ADU
 SG_ OBJ_Lat_Distance_V_6 : 77|1@1+ (1,0) [0|1] "bool"  ADU
 SG_ OBJ_Lat_Distance_STD_6 : 78|14@1+ (0.01,0) [0|100] "m"  ADU
 SG_ OBJ_Lat_Distance_STD_V_6 : 92|1@1+ (1,0) [0|1] "bool"  ADU
 SG_ OBJ_Absolute_Speed_6 : 93|12@1+ (0.05,-65) [-65|65] "m_per_s"  ADU
 SG_ OBJ_Absolute_Speed_V_6 : 105|1@1+ (1,0) [0|1] "bool"  ADU
 SG_ OBJ_Absolute_Speed_STD_6 : 106|13@1+ (0.01,0) [0|65] "m_per_s"  ADU
 SG_ OBJ_Absolute_Speed_STD_V_6 : 119|1@1+ (1,0) [0|1] "bool"  ADU
 SG_ OBJ_Heading_6 : 120|10@1+ (0.01,-3.14) [-3.14|3.14] "rad"  ADU
 SG_ OBJ_Heading_V_6 : 130|1@1+ (1,0) [0|1] "bool"  ADU
 SG_ OBJ_Heading_STD_6 : 131|15@1+ (0.0001,0) [0|3.14] "rad"  ADU
 SG_ OBJ_Heading_STD_V_6 : 146|1@1+ (1,0) [0|1] "bool"  ADU
 SG_ OBJ_Angle_Rate_STD_6 : 147|15@1+ (0.0001,0) [0|2.2318] "RPS"  ADU
 SG_ OBJ_Angle_Rate_STD_V_6 : 162|1@1+ (1,0) [0|1] "bool"  ADU
 SG_ OBJ_Angle_Rate_6 : 163|12@1+ (0.002,-2.234) [-2.234|2.2318] "RPS"  ADU
 SG_ OBJ_Angle_Rate_V_6 : 175|1@1+ (1,0) [0|1] "bool"  ADU
 SG_ OBJ_Angle_Right_6 : 176|14@1+ (0.0002,-1.571) [-1.571|1.571] "rad"  ADU
 SG_ OBJ_Angle_Right_V_6 : 190|1@1+ (1,0) [0|1] "bool"  ADU
 SG_ OBJ_Angle_Right_STD_6 : 191|14@1+ (0.0001,0) [0|1.571] "rad"  ADU
 SG_ OBJ_Angle_Right_STD_V_6 : 205|1@1+ (1,0) [0|1] "bool"  ADU
 SG_ OBJ_Angle_Left_6 : 206|14@1+ (0.0002,-1.571) [-1.571|1.571] "rad"  ADU
 SG_ OBJ_Angle_Left_V_6 : 220|1@1+ (1,0) [0|1] "bool"  ADU
 SG_ OBJ_Angle_Left_STD_6 : 221|14@1+ (0.0001,0) [0|1.571] "rad"  ADU
 SG_ OBJ_Angle_Left_STD_V_6 : 235|1@1+ (1,0) [0|1] "bool"  ADU
 SG_ OBJ_Angle_Side_6 : 236|14@1+ (0.0002,-1.571) [-1.571|1.571] "rad"  ADU
 SG_ OBJ_Angle_Side_V_6 : 250|1@1+ (1,0) [0|1] "bool"  ADU
 SG_ OBJ_Angle_Side_STD_6 : 251|14@1+ (0.0001,0) [0|1.571] "rad"  ADU
 SG_ OBJ_Angle_Side_STD_V_6 : 265|1@1+ (1,0) [0|1] "bool"  ADU
 SG_ OBJ_Angle_Mid_V_6 : 266|1@1+ (1,0) [0|1] "bool"  ADU
 SG_ OBJ_Angle_Mid_6 : 267|14@1+ (0.0002,-1.571) [-1.571|1.571] "rad"  ADU
 SG_ OBJ_Angle_Mid_STD_6 : 281|14@1+ (0.0001,0) [0|1.571] "rad"  ADU
 SG_ OBJ_Angle_Mid_STD_V_6 : 295|1@1+ (1,0) [0|1] "bool"  ADU
 SG_ OBJ_Angle_Bottom_V_6 : 296|1@1+ (1,0) [0|1] "bool"  ADU
 SG_ OBJ_Angle_Bottom_6 : 297|14@1+ (0.0002,-1.571) [-1.571|1.571] "rad"  ADU
 SG_ OBJ_Angle_Bottom_STD_6 : 311|14@1+ (0.0001,0) [0|1.571] "rad"  ADU
 SG_ OBJ_Angle_Bottom_STD_V_6 : 325|1@1+ (1,0) [0|1] "bool"  ADU
 SG_ OBJ_Visibility_Side_V_6 : 326|1@1+ (1,0) [0|1] "bool"  ADU
 SG_ OBJ_Visibility_Side_6 : 327|2@1+ (1,0) [0|2] "ENUM"  ADU
 SG_ OBJ_Is_In_Drivable_Area_6 : 329|1@1+ (1,0) [0|1] "bool"  ADU
 SG_ OBJ_Is_In_Drivable_Area_V_6 : 330|1@1+ (1,0) [0|1] "bool"  ADU
 SG_ OBJ_Is_VeryClose_V_6 : 331|1@1+ (1,0) [0|1] "bool"  ADU
 SG_ OBJ_Is_VeryClose_6 : 332|1@1+ (1,0) [0|1] "bool"  ADU
 SG_ OBJ_Is_EMERGENCY_VCL_6 : 333|1@1+ (1,0) [0|1] "bool"  ADU
 SG_ OBJ_EMERGENCY_LIGHT_COLOR_6 : 334|4@1+ (1,0) [0|15] "BITWIZE"  ADU
 SG_ OBJ_EMERGENCY_V_6 : 338|1@1+ (1,0) [0|1] "bool"  ADU

BO_ 415 Core_Objects_protocol_7_0: 48 ADAS
 SG_ OBJ_Sync_ID_7_0 : 0|8@1+ (1,0) [0|255] "counter"  ADU
 SG_ OBJ_CRC_7 : 8|32@1+ (1,0) [0|4294970000] "NA"  ADU
 SG_ OBJ_ID_7 : 40|8@1+ (1,0) [0|255] "counter"  ADU
 SG_ OBJ_Existence_Probability_7 : 48|8@1+ (0.01,0) [0|1] "NA"  ADU
 SG_ OBJ_Motion_Category_7 : 56|4@1+ (1,0) [0|13] "ENUM"  ADU
 SG_ OBJ_Object_Age_7 : 60|11@1+ (1,0) [0|2047] "frames"  ADU
 SG_ OBJ_Measuring_Status_7 : 71|3@1+ (1,0) [0|7] "BITWIZE"  ADU
 SG_ OBJ_Object_Class_7 : 74|4@1+ (1,0) [0|8] "ENUM"  ADU
 SG_ OBJ_Class_Probability_7 : 78|7@1+ (0.01,0) [0|1] "NA"  ADU
 SG_ OBJ_Motion_Status_7 : 85|3@1+ (1,0) [0|5] "ENUM"  ADU
 SG_ OBJ_Motion_Orientation_7 : 88|4@1+ (1,0) [0|13] "ENUM"  ADU
 SG_ OBJ_Has_Cut_Lane_7 : 92|1@1+ (1,0) [0|1] "bool"  ADU
 SG_ OBJ_Has_Cut_Path_7 : 93|1@1+ (1,0) [0|1] "bool"  ADU
 SG_ OBJ_Brake_Light_7 : 94|1@1+ (1,0) [0|1] "bool"  ADU
 SG_ OBJ_Turn_Indicator_Right_7 : 95|1@1+ (1,0) [0|1] "bool"  ADU
 SG_ OBJ_Turn_Indicator_Left_7 : 96|1@1+ (1,0) [0|1] "bool"  ADU
 SG_ OBJ_Light_Indicator_Validity_7 : 97|1@1+ (1,0) [0|1] "bool"  ADU
 SG_ OBJ_Right_Out_Of_Image_7 : 98|1@1+ (1,0) [0|1] "bool"  ADU
 SG_ OBJ_Left_Out_Of_Image_7 : 99|1@1+ (1,0) [0|1] "bool"  ADU
 SG_ OBJ_Right_Out_Of_Image_V_7 : 100|1@1+ (1,0) [0|1] "bool"  ADU
 SG_ OBJ_Left_Out_Of_Image_V_7 : 101|1@1+ (1,0) [0|1] "bool"  ADU
 SG_ OBJ_Top_Out_Of_Image_7 : 102|1@1+ (1,0) [0|1] "bool"  ADU
 SG_ OBJ_Bottom_Out_Of_Image_7 : 103|1@1+ (1,0) [0|1] "bool"  ADU
 SG_ OBJ_Top_Out_Of_Image_V_7 : 104|1@1+ (1,0) [0|1] "bool"  ADU
 SG_ OBJ_Bottom_Out_Of_Image_V_7 : 105|1@1+ (1,0) [0|1] "bool"  ADU
 SG_ OBJ_Lane_Assignment_7 : 106|3@1+ (1,0) [0|5] "ENUM"  ADU
 SG_ OBJ_Lane_Assignment_V_7 : 109|1@1+ (1,0) [0|1] "bool"  ADU
 SG_ OBJ_Age_Seconds_7 : 110|7@1+ (1,0) [0|100] "s"  ADU
 SG_ OBJ_Age_Seconds_V_7 : 117|1@1+ (1,0) [0|1] "bool"  ADU
 SG_ OBJ_Width_7 : 118|9@1+ (0.01,0) [0.4|2.95] "m"  ADU
 SG_ OBJ_Width_V_7 : 127|1@1+ (1,0) [0|1] "bool"  ADU
 SG_ OBJ_Width_STD_7 : 128|11@1+ (0.001,0) [0|2] "m"  ADU
 SG_ OBJ_Width_STD_V_7 : 139|1@1+ (1,0) [0|1] "bool"  ADU
 SG_ OBJ_Length_7 : 140|9@1+ (0.05,0) [1.2|21] "m"  ADU
 SG_ OBJ_Length_V_7 : 149|1@1+ (1,0) [0|1] "bool"  ADU
 SG_ OBJ_Length_STD_7 : 150|10@1+ (0.01,0) [0|10] "m"  ADU
 SG_ OBJ_Length_STD_V_7 : 160|1@1+ (1,0) [0|1] "bool"  ADU
 SG_ OBJ_Height_7 : 161|9@1+ (0.01,0) [0|2.95] "m"  ADU
 SG_ OBJ_Height_V_7 : 170|1@1+ (1,0) [0|1] "bool"  ADU
 SG_ OBJ_Height_STD_7 : 171|11@1+ (0.001,0) [0|2] "m"  ADU
 SG_ OBJ_Height_STD_V_7 : 182|1@1+ (1,0) [0|1] "bool"  ADU
 SG_ OBJ_Abs_Long_Velocity_7 : 183|12@1+ (0.05,-100) [-100|100] "m_per_s"  ADU
 SG_ OBJ_Abs_Long_Velocity_V_7 : 195|1@1+ (1,0) [0|1] "bool"  ADU
 SG_ OBJ_Abs_Long_Velocity_STD_7 : 196|13@1+ (0.01,0) [0|65] "m_per_s"  ADU
 SG_ OBJ_Abs_Long_Vel_STD_V_7 : 209|1@1+ (1,0) [0|1] "bool"  ADU
 SG_ OBJ_Abs_Lat_Velocity_7 : 210|11@1+ (0.05,-50) [-50|50] "m_per_s"  ADU
 SG_ OBJ_Abs_Lat_Velocity_V_7 : 221|1@1+ (1,0) [0|1] "bool"  ADU
 SG_ OBJ_Abs_Lat_Velocity_STD_7 : 222|13@1+ (0.01,0) [0|50] "m_per_s"  ADU
 SG_ OBJ_Abs_Lat_Vel_STD_V_7 : 235|1@1+ (1,0) [0|1] "bool"  ADU
 SG_ OBJ_Abs_Long_Acc_7 : 236|9@1+ (0.05,-10) [-10|10] "m_per_s2"  ADU
 SG_ OBJ_Abs_Long_Acc_V_7 : 245|1@1+ (1,0) [0|1] "bool"  ADU
 SG_ OBJ_Abs_Long_Acc_STD_7 : 246|10@1+ (0.01,0) [0|7.3] "m_per_s2"  ADU
 SG_ OBJ_Abs_Long_Acc_STD_V_7 : 256|1@1+ (1,0) [0|1] "bool"  ADU
 SG_ OBJ_Abs_Lat_Acc_7 : 257|9@1+ (0.05,-10.3) [-10.3|7.3] "m_per_s2"  ADU
 SG_ OBJ_Abs_Lat_Acc_V_7 : 266|1@1+ (1,0) [0|1] "bool"  ADU
 SG_ OBJ_Abs_Lat_Acc_STD_7 : 267|10@1+ (0.01,0) [0|7.3] "m_per_s2"  ADU
 SG_ OBJ_Abs_Lat_Acc_STD_V_7 : 277|1@1+ (1,0) [0|1] "bool"  ADU
 SG_ OBJ_Abs_Acceleration_7 : 278|9@1+ (0.05,-10.3) [-10.3|7.3] "m_per_s2"  ADU
 SG_ OBJ_Abs_Acceleration_V_7 : 287|1@1+ (1,0) [0|1] "bool"  ADU
 SG_ OBJ_Abs_Acc_STD_7 : 288|10@1+ (0.01,0) [0|7.3] "m_per_s2"  ADU
 SG_ OBJ_Abs_Acc_STD_V_7 : 298|1@1+ (1,0) [0|1] "bool"  ADU
 SG_ OBJ_Inv_TTC_7 : 299|11@1+ (0.01,-8) [-8|8] "INV(s)"  ADU
 SG_ OBJ_Inv_TTC_V_7 : 310|1@1+ (1,0) [0|1] "bool"  ADU
 SG_ OBJ_Inv_TTC_STD_7 : 311|12@1+ (0.001,0) [0|4] "INV(s)"  ADU
 SG_ OBJ_Inv_TTC_STD_V_7 : 323|1@1+ (1,0) [0|1] "bool"  ADU
 SG_ OBJ_Relative_Long_Acc_7 : 324|10@1+ (0.05,-20) [-20|20] "m_per_s2"  ADU
 SG_ OBJ_Relative_Long_Acc_V_7 : 334|1@1+ (1,0) [0|1] "bool"  ADU
 SG_ OBJ_Relative_Long_Acc_STD_7 : 335|10@1+ (0.01,0) [0|7.3] "m_per_s2"  ADU
 SG_ OBJ_Rel_Long_Acc_STD_V_7 : 345|1@1+ (1,0) [0|1] "bool"  ADU
 SG_ OBJ_Relative_Long_Velocity_7 : 346|13@1+ (0.05,-120) [-120|130] "m_per_s"  ADU
 SG_ OBJ_Relative_Long_Velocity_V_7 : 359|1@1+ (1,0) [0|1] "bool"  ADU
 SG_ OBJ_Relative_Long_Vel_STD_7 : 360|14@1+ (0.01,0) [0|130] "m_per_s"  ADU
 SG_ OBJ_Rel_Long_Vel_STD_V_7 : 374|1@1+ (1,0) [0|1] "bool"  ADU

BO_ 416 Core_Objects_protocol_7_1: 48 ADAS
 SG_ OBJ_Sync_ID_7_1 : 0|8@1+ (1,0) [0|255] "counter"  ADU
 SG_ OBJ_Relative_Lat_Velocity_7 : 8|11@1+ (0.05,-50) [-50|50] "m_per_s"  ADU
 SG_ OBJ_Relative_Lat_Velocity_V_7 : 19|1@1+ (1,0) [0|1] "bool"  ADU
 SG_ OBJ_Relative_Lat_Velocity_STD_7 : 20|13@1+ (0.01,0) [0|50] "m_per_s"  ADU
 SG_ OBJ_Rel_Lat_Vel_STD_V_7 : 33|1@1+ (1,0) [0|1] "bool"  ADU
 SG_ OBJ_Long_Distance_7 : 34|14@1+ (0.05,-200) [-200|500] "m"  ADU
 SG_ OBJ_Long_Distance_V_7 : 48|1@1+ (1,0) [0|1] "bool"  ADU
 SG_ OBJ_Long_Distance_STD_7 : 49|15@1+ (0.01,0) [0|250] "m"  ADU
 SG_ OBJ_Long_Distance_STD_V_7 : 64|1@1+ (1,0) [0|1] "bool"  ADU
 SG_ OBJ_Lat_Distance_7 : 65|12@1+ (0.05,-100) [-100|100] "m"  ADU
 SG_ OBJ_Lat_Distance_V_7 : 77|1@1+ (1,0) [0|1] "bool"  ADU
 SG_ OBJ_Lat_Distance_STD_7 : 78|14@1+ (0.01,0) [0|100] "m"  ADU
 SG_ OBJ_Lat_Distance_STD_V_7 : 92|1@1+ (1,0) [0|1] "bool"  ADU
 SG_ OBJ_Absolute_Speed_7 : 93|12@1+ (0.05,-65) [-65|65] "m_per_s"  ADU
 SG_ OBJ_Absolute_Speed_V_7 : 105|1@1+ (1,0) [0|1] "bool"  ADU
 SG_ OBJ_Absolute_Speed_STD_7 : 106|13@1+ (0.01,0) [0|65] "m_per_s"  ADU
 SG_ OBJ_Absolute_Speed_STD_V_7 : 119|1@1+ (1,0) [0|1] "bool"  ADU
 SG_ OBJ_Heading_7 : 120|10@1+ (0.01,-3.14) [-3.14|3.14] "rad"  ADU
 SG_ OBJ_Heading_V_7 : 130|1@1+ (1,0) [0|1] "bool"  ADU
 SG_ OBJ_Heading_STD_7 : 131|15@1+ (0.0001,0) [0|3.14] "rad"  ADU
 SG_ OBJ_Heading_STD_V_7 : 146|1@1+ (1,0) [0|1] "bool"  ADU
 SG_ OBJ_Angle_Rate_STD_7 : 147|15@1+ (0.0001,0) [0|2.2318] "RPS"  ADU
 SG_ OBJ_Angle_Rate_STD_V_7 : 162|1@1+ (1,0) [0|1] "bool"  ADU
 SG_ OBJ_Angle_Rate_7 : 163|12@1+ (0.002,-2.234) [-2.234|2.2318] "RPS"  ADU
 SG_ OBJ_Angle_Rate_V_7 : 175|1@1+ (1,0) [0|1] "bool"  ADU
 SG_ OBJ_Angle_Right_7 : 176|14@1+ (0.0002,-1.571) [-1.571|1.571] "rad"  ADU
 SG_ OBJ_Angle_Right_V_7 : 190|1@1+ (1,0) [0|1] "bool"  ADU
 SG_ OBJ_Angle_Right_STD_7 : 191|14@1+ (0.0001,0) [0|1.571] "rad"  ADU
 SG_ OBJ_Angle_Right_STD_V_7 : 205|1@1+ (1,0) [0|1] "bool"  ADU
 SG_ OBJ_Angle_Left_7 : 206|14@1+ (0.0002,-1.571) [-1.571|1.571] "rad"  ADU
 SG_ OBJ_Angle_Left_V_7 : 220|1@1+ (1,0) [0|1] "bool"  ADU
 SG_ OBJ_Angle_Left_STD_7 : 221|14@1+ (0.0001,0) [0|1.571] "rad"  ADU
 SG_ OBJ_Angle_Left_STD_V_7 : 235|1@1+ (1,0) [0|1] "bool"  ADU
 SG_ OBJ_Angle_Side_7 : 236|14@1+ (0.0002,-1.571) [-1.571|1.571] "rad"  ADU
 SG_ OBJ_Angle_Side_V_7 : 250|1@1+ (1,0) [0|1] "bool"  ADU
 SG_ OBJ_Angle_Side_STD_7 : 251|14@1+ (0.0001,0) [0|1.571] "rad"  ADU
 SG_ OBJ_Angle_Side_STD_V_7 : 265|1@1+ (1,0) [0|1] "bool"  ADU
 SG_ OBJ_Angle_Mid_V_7 : 266|1@1+ (1,0) [0|1] "bool"  ADU
 SG_ OBJ_Angle_Mid_7 : 267|14@1+ (0.0002,-1.571) [-1.571|1.571] "rad"  ADU
 SG_ OBJ_Angle_Mid_STD_7 : 281|14@1+ (0.0001,0) [0|1.571] "rad"  ADU
 SG_ OBJ_Angle_Mid_STD_V_7 : 295|1@1+ (1,0) [0|1] "bool"  ADU
 SG_ OBJ_Angle_Bottom_V_7 : 296|1@1+ (1,0) [0|1] "bool"  ADU
 SG_ OBJ_Angle_Bottom_7 : 297|14@1+ (0.0002,-1.571) [-1.571|1.571] "rad"  ADU
 SG_ OBJ_Angle_Bottom_STD_7 : 311|14@1+ (0.0001,0) [0|1.571] "rad"  ADU
 SG_ OBJ_Angle_Bottom_STD_V_7 : 325|1@1+ (1,0) [0|1] "bool"  ADU
 SG_ OBJ_Visibility_Side_V_7 : 326|1@1+ (1,0) [0|1] "bool"  ADU
 SG_ OBJ_Visibility_Side_7 : 327|2@1+ (1,0) [0|2] "ENUM"  ADU
 SG_ OBJ_Is_In_Drivable_Area_7 : 329|1@1+ (1,0) [0|1] "bool"  ADU
 SG_ OBJ_Is_In_Drivable_Area_V_7 : 330|1@1+ (1,0) [0|1] "bool"  ADU
 SG_ OBJ_Is_VeryClose_V_7 : 331|1@1+ (1,0) [0|1] "bool"  ADU
 SG_ OBJ_Is_VeryClose_7 : 332|1@1+ (1,0) [0|1] "bool"  ADU
 SG_ OBJ_Is_EMERGENCY_VCL_7 : 333|1@1+ (1,0) [0|1] "bool"  ADU
 SG_ OBJ_EMERGENCY_LIGHT_COLOR_7 : 334|4@1+ (1,0) [0|15] "BITWIZE"  ADU
 SG_ OBJ_EMERGENCY_V_7 : 338|1@1+ (1,0) [0|1] "bool"  ADU

BO_ 417 Core_Objects_protocol_8_0: 48 ADAS
 SG_ OBJ_Sync_ID_8_0 : 0|8@1+ (1,0) [0|255] "counter"  ADU
 SG_ OBJ_CRC_8 : 8|32@1+ (1,0) [0|4294970000] "NA"  ADU
 SG_ OBJ_ID_8 : 40|8@1+ (1,0) [0|255] "counter"  ADU
 SG_ OBJ_Existence_Probability_8 : 48|8@1+ (0.01,0) [0|1] "NA"  ADU
 SG_ OBJ_Motion_Category_8 : 56|4@1+ (1,0) [0|13] "ENUM"  ADU
 SG_ OBJ_Object_Age_8 : 60|11@1+ (1,0) [0|2047] "frames"  ADU
 SG_ OBJ_Measuring_Status_8 : 71|3@1+ (1,0) [0|7] "BITWIZE"  ADU
 SG_ OBJ_Object_Class_8 : 74|4@1+ (1,0) [0|8] "ENUM"  ADU
 SG_ OBJ_Class_Probability_8 : 78|7@1+ (0.01,0) [0|1] "NA"  ADU
 SG_ OBJ_Motion_Status_8 : 85|3@1+ (1,0) [0|5] "ENUM"  ADU
 SG_ OBJ_Motion_Orientation_8 : 88|4@1+ (1,0) [0|13] "ENUM"  ADU
 SG_ OBJ_Has_Cut_Lane_8 : 92|1@1+ (1,0) [0|1] "bool"  ADU
 SG_ OBJ_Has_Cut_Path_8 : 93|1@1+ (1,0) [0|1] "bool"  ADU
 SG_ OBJ_Brake_Light_8 : 94|1@1+ (1,0) [0|1] "bool"  ADU
 SG_ OBJ_Turn_Indicator_Right_8 : 95|1@1+ (1,0) [0|1] "bool"  ADU
 SG_ OBJ_Turn_Indicator_Left_8 : 96|1@1+ (1,0) [0|1] "bool"  ADU
 SG_ OBJ_Light_Indicator_Validity_8 : 97|1@1+ (1,0) [0|1] "bool"  ADU
 SG_ OBJ_Right_Out_Of_Image_8 : 98|1@1+ (1,0) [0|1] "bool"  ADU
 SG_ OBJ_Left_Out_Of_Image_8 : 99|1@1+ (1,0) [0|1] "bool"  ADU
 SG_ OBJ_Right_Out_Of_Image_V_8 : 100|1@1+ (1,0) [0|1] "bool"  ADU
 SG_ OBJ_Left_Out_Of_Image_V_8 : 101|1@1+ (1,0) [0|1] "bool"  ADU
 SG_ OBJ_Top_Out_Of_Image_8 : 102|1@1+ (1,0) [0|1] "bool"  ADU
 SG_ OBJ_Bottom_Out_Of_Image_8 : 103|1@1+ (1,0) [0|1] "bool"  ADU
 SG_ OBJ_Top_Out_Of_Image_V_8 : 104|1@1+ (1,0) [0|1] "bool"  ADU
 SG_ OBJ_Bottom_Out_Of_Image_V_8 : 105|1@1+ (1,0) [0|1] "bool"  ADU
 SG_ OBJ_Lane_Assignment_8 : 106|3@1+ (1,0) [0|5] "ENUM"  ADU
 SG_ OBJ_Lane_Assignment_V_8 : 109|1@1+ (1,0) [0|1] "bool"  ADU
 SG_ OBJ_Age_Seconds_8 : 110|7@1+ (1,0) [0|100] "s"  ADU
 SG_ OBJ_Age_Seconds_V_8 : 117|1@1+ (1,0) [0|1] "bool"  ADU
 SG_ OBJ_Width_8 : 118|9@1+ (0.01,0) [0.4|2.95] "m"  ADU
 SG_ OBJ_Width_V_8 : 127|1@1+ (1,0) [0|1] "bool"  ADU
 SG_ OBJ_Width_STD_8 : 128|11@1+ (0.001,0) [0|2] "m"  ADU
 SG_ OBJ_Width_STD_V_8 : 139|1@1+ (1,0) [0|1] "bool"  ADU
 SG_ OBJ_Length_8 : 140|9@1+ (0.05,0) [1.2|21] "m"  ADU
 SG_ OBJ_Length_V_8 : 149|1@1+ (1,0) [0|1] "bool"  ADU
 SG_ OBJ_Length_STD_8 : 150|10@1+ (0.01,0) [0|10] "m"  ADU
 SG_ OBJ_Length_STD_V_8 : 160|1@1+ (1,0) [0|1] "bool"  ADU
 SG_ OBJ_Height_8 : 161|9@1+ (0.01,0) [0|2.95] "m"  ADU
 SG_ OBJ_Height_V_8 : 170|1@1+ (1,0) [0|1] "bool"  ADU
 SG_ OBJ_Height_STD_8 : 171|11@1+ (0.001,0) [0|2] "m"  ADU
 SG_ OBJ_Height_STD_V_8 : 182|1@1+ (1,0) [0|1] "bool"  ADU
 SG_ OBJ_Abs_Long_Velocity_8 : 183|12@1+ (0.05,-100) [-100|100] "m_per_s"  ADU
 SG_ OBJ_Abs_Long_Velocity_V_8 : 195|1@1+ (1,0) [0|1] "bool"  ADU
 SG_ OBJ_Abs_Long_Velocity_STD_8 : 196|13@1+ (0.01,0) [0|65] "m_per_s"  ADU
 SG_ OBJ_Abs_Long_Vel_STD_V_8 : 209|1@1+ (1,0) [0|1] "bool"  ADU
 SG_ OBJ_Abs_Lat_Velocity_8 : 210|11@1+ (0.05,-50) [-50|50] "m_per_s"  ADU
 SG_ OBJ_Abs_Lat_Velocity_V_8 : 221|1@1+ (1,0) [0|1] "bool"  ADU
 SG_ OBJ_Abs_Lat_Velocity_STD_8 : 222|13@1+ (0.01,0) [0|50] "m_per_s"  ADU
 SG_ OBJ_Abs_Lat_Vel_STD_V_8 : 235|1@1+ (1,0) [0|1] "bool"  ADU
 SG_ OBJ_Abs_Long_Acc_8 : 236|9@1+ (0.05,-10) [-10|10] "m_per_s2"  ADU
 SG_ OBJ_Abs_Long_Acc_V_8 : 245|1@1+ (1,0) [0|1] "bool"  ADU
 SG_ OBJ_Abs_Long_Acc_STD_8 : 246|10@1+ (0.01,0) [0|7.3] "m_per_s2"  ADU
 SG_ OBJ_Abs_Long_Acc_STD_V_8 : 256|1@1+ (1,0) [0|1] "bool"  ADU
 SG_ OBJ_Abs_Lat_Acc_8 : 257|9@1+ (0.05,-10.3) [-10.3|7.3] "m_per_s2"  ADU
 SG_ OBJ_Abs_Lat_Acc_V_8 : 266|1@1+ (1,0) [0|1] "bool"  ADU
 SG_ OBJ_Abs_Lat_Acc_STD_8 : 267|10@1+ (0.01,0) [0|7.3] "m_per_s2"  ADU
 SG_ OBJ_Abs_Lat_Acc_STD_V_8 : 277|1@1+ (1,0) [0|1] "bool"  ADU
 SG_ OBJ_Abs_Acceleration_8 : 278|9@1+ (0.05,-10.3) [-10.3|7.3] "m_per_s2"  ADU
 SG_ OBJ_Abs_Acceleration_V_8 : 287|1@1+ (1,0) [0|1] "bool"  ADU
 SG_ OBJ_Abs_Acc_STD_8 : 288|10@1+ (0.01,0) [0|7.3] "m_per_s2"  ADU
 SG_ OBJ_Abs_Acc_STD_V_8 : 298|1@1+ (1,0) [0|1] "bool"  ADU
 SG_ OBJ_Inv_TTC_8 : 299|11@1+ (0.01,-8) [-8|8] "INV(s)"  ADU
 SG_ OBJ_Inv_TTC_V_8 : 310|1@1+ (1,0) [0|1] "bool"  ADU
 SG_ OBJ_Inv_TTC_STD_8 : 311|12@1+ (0.001,0) [0|4] "INV(s)"  ADU
 SG_ OBJ_Inv_TTC_STD_V_8 : 323|1@1+ (1,0) [0|1] "bool"  ADU
 SG_ OBJ_Relative_Long_Acc_8 : 324|10@1+ (0.05,-20) [-20|20] "m_per_s2"  ADU
 SG_ OBJ_Relative_Long_Acc_V_8 : 334|1@1+ (1,0) [0|1] "bool"  ADU
 SG_ OBJ_Relative_Long_Acc_STD_8 : 335|10@1+ (0.01,0) [0|7.3] "m_per_s2"  ADU
 SG_ OBJ_Rel_Long_Acc_STD_V_8 : 345|1@1+ (1,0) [0|1] "bool"  ADU
 SG_ OBJ_Relative_Long_Velocity_8 : 346|13@1+ (0.05,-120) [-120|130] "m_per_s"  ADU
 SG_ OBJ_Relative_Long_Velocity_V_8 : 359|1@1+ (1,0) [0|1] "bool"  ADU
 SG_ OBJ_Relative_Long_Vel_STD_8 : 360|14@1+ (0.01,0) [0|130] "m_per_s"  ADU
 SG_ OBJ_Rel_Long_Vel_STD_V_8 : 374|1@1+ (1,0) [0|1] "bool"  ADU

BO_ 418 Core_Objects_protocol_8_1: 48 ADAS
 SG_ OBJ_Sync_ID_8_1 : 0|8@1+ (1,0) [0|255] "counter"  ADU
 SG_ OBJ_Relative_Lat_Velocity_8 : 8|11@1+ (0.05,-50) [-50|50] "m_per_s"  ADU
 SG_ OBJ_Relative_Lat_Velocity_V_8 : 19|1@1+ (1,0) [0|1] "bool"  ADU
 SG_ OBJ_Relative_Lat_Velocity_STD_8 : 20|13@1+ (0.01,0) [0|50] "m_per_s"  ADU
 SG_ OBJ_Rel_Lat_Vel_STD_V_8 : 33|1@1+ (1,0) [0|1] "bool"  ADU
 SG_ OBJ_Long_Distance_8 : 34|14@1+ (0.05,-200) [-200|500] "m"  ADU
 SG_ OBJ_Long_Distance_V_8 : 48|1@1+ (1,0) [0|1] "bool"  ADU
 SG_ OBJ_Long_Distance_STD_8 : 49|15@1+ (0.01,0) [0|250] "m"  ADU
 SG_ OBJ_Long_Distance_STD_V_8 : 64|1@1+ (1,0) [0|1] "bool"  ADU
 SG_ OBJ_Lat_Distance_8 : 65|12@1+ (0.05,-100) [-100|100] "m"  ADU
 SG_ OBJ_Lat_Distance_V_8 : 77|1@1+ (1,0) [0|1] "bool"  ADU
 SG_ OBJ_Lat_Distance_STD_8 : 78|14@1+ (0.01,0) [0|100] "m"  ADU
 SG_ OBJ_Lat_Distance_STD_V_8 : 92|1@1+ (1,0) [0|1] "bool"  ADU
 SG_ OBJ_Absolute_Speed_8 : 93|12@1+ (0.05,-65) [-65|65] "m_per_s"  ADU
 SG_ OBJ_Absolute_Speed_V_8 : 105|1@1+ (1,0) [0|1] "bool"  ADU
 SG_ OBJ_Absolute_Speed_STD_8 : 106|13@1+ (0.01,0) [0|65] "m_per_s"  ADU
 SG_ OBJ_Absolute_Speed_STD_V_8 : 119|1@1+ (1,0) [0|1] "bool"  ADU
 SG_ OBJ_Heading_8 : 120|10@1+ (0.01,-3.14) [-3.14|3.14] "rad"  ADU
 SG_ OBJ_Heading_V_8 : 130|1@1+ (1,0) [0|1] "bool"  ADU
 SG_ OBJ_Heading_STD_8 : 131|15@1+ (0.0001,0) [0|3.14] "rad"  ADU
 SG_ OBJ_Heading_STD_V_8 : 146|1@1+ (1,0) [0|1] "bool"  ADU
 SG_ OBJ_Angle_Rate_STD_8 : 147|15@1+ (0.0001,0) [0|2.2318] "RPS"  ADU
 SG_ OBJ_Angle_Rate_STD_V_8 : 162|1@1+ (1,0) [0|1] "bool"  ADU
 SG_ OBJ_Angle_Rate_8 : 163|12@1+ (0.002,-2.234) [-2.234|2.2318] "RPS"  ADU
 SG_ OBJ_Angle_Rate_V_8 : 175|1@1+ (1,0) [0|1] "bool"  ADU
 SG_ OBJ_Angle_Right_8 : 176|14@1+ (0.0002,-1.571) [-1.571|1.571] "rad"  ADU
 SG_ OBJ_Angle_Right_V_8 : 190|1@1+ (1,0) [0|1] "bool"  ADU
 SG_ OBJ_Angle_Right_STD_8 : 191|14@1+ (0.0001,0) [0|1.571] "rad"  ADU
 SG_ OBJ_Angle_Right_STD_V_8 : 205|1@1+ (1,0) [0|1] "bool"  ADU
 SG_ OBJ_Angle_Left_8 : 206|14@1+ (0.0002,-1.571) [-1.571|1.571] "rad"  ADU
 SG_ OBJ_Angle_Left_V_8 : 220|1@1+ (1,0) [0|1] "bool"  ADU
 SG_ OBJ_Angle_Left_STD_8 : 221|14@1+ (0.0001,0) [0|1.571] "rad"  ADU
 SG_ OBJ_Angle_Left_STD_V_8 : 235|1@1+ (1,0) [0|1] "bool"  ADU
 SG_ OBJ_Angle_Side_8 : 236|14@1+ (0.0002,-1.571) [-1.571|1.571] "rad"  ADU
 SG_ OBJ_Angle_Side_V_8 : 250|1@1+ (1,0) [0|1] "bool"  ADU
 SG_ OBJ_Angle_Side_STD_8 : 251|14@1+ (0.0001,0) [0|1.571] "rad"  ADU
 SG_ OBJ_Angle_Side_STD_V_8 : 265|1@1+ (1,0) [0|1] "bool"  ADU
 SG_ OBJ_Angle_Mid_V_8 : 266|1@1+ (1,0) [0|1] "bool"  ADU
 SG_ OBJ_Angle_Mid_8 : 267|14@1+ (0.0002,-1.571) [-1.571|1.571] "rad"  ADU
 SG_ OBJ_Angle_Mid_STD_8 : 281|14@1+ (0.0001,0) [0|1.571] "rad"  ADU
 SG_ OBJ_Angle_Mid_STD_V_8 : 295|1@1+ (1,0) [0|1] "bool"  ADU
 SG_ OBJ_Angle_Bottom_V_8 : 296|1@1+ (1,0) [0|1] "bool"  ADU
 SG_ OBJ_Angle_Bottom_8 : 297|14@1+ (0.0002,-1.571) [-1.571|1.571] "rad"  ADU
 SG_ OBJ_Angle_Bottom_STD_8 : 311|14@1+ (0.0001,0) [0|1.571] "rad"  ADU
 SG_ OBJ_Angle_Bottom_STD_V_8 : 325|1@1+ (1,0) [0|1] "bool"  ADU
 SG_ OBJ_Visibility_Side_V_8 : 326|1@1+ (1,0) [0|1] "bool"  ADU
 SG_ OBJ_Visibility_Side_8 : 327|2@1+ (1,0) [0|2] "ENUM"  ADU
 SG_ OBJ_Is_In_Drivable_Area_8 : 329|1@1+ (1,0) [0|1] "bool"  ADU
 SG_ OBJ_Is_In_Drivable_Area_V_8 : 330|1@1+ (1,0) [0|1] "bool"  ADU
 SG_ OBJ_Is_VeryClose_V_8 : 331|1@1+ (1,0) [0|1] "bool"  ADU
 SG_ OBJ_Is_VeryClose_8 : 332|1@1+ (1,0) [0|1] "bool"  ADU
 SG_ OBJ_Is_EMERGENCY_VCL_8 : 333|1@1+ (1,0) [0|1] "bool"  ADU
 SG_ OBJ_EMERGENCY_LIGHT_COLOR_8 : 334|4@1+ (1,0) [0|15] "BITWIZE"  ADU
 SG_ OBJ_EMERGENCY_V_8 : 338|1@1+ (1,0) [0|1] "bool"  ADU

CM_ SG_ 406 OBJ_Sync_ID_2_1 "The ID of the Sync message, used to synchronize between signals in the system. Every new frame promotes the sync ID by one.";
CM_ SG_ 406 OBJ_Relative_Lat_Velocity_2 "The relative lateral speed between the target and ego vehicle.";
CM_ SG_ 406 OBJ_Relative_Lat_Velocity_V_2 "Validator for the relative lateral speed.";
CM_ SG_ 406 OBJ_Relative_Lat_Velocity_STD_2 "STD of the relative lateral speed.";
CM_ SG_ 406 OBJ_Rel_Lat_Vel_STD_V_2 "Validator for the STD of the relative lateral speed.";
CM_ SG_ 406 OBJ_Long_Distance_2 "The longtitudinal distance from the object to middle of the rear bumper (middle of the RL and RR corners) of the target.";
CM_ SG_ 406 OBJ_Long_Distance_V_2 "Validator of the longtitudinal distance field";
CM_ SG_ 406 OBJ_Long_Distance_STD_2 "STD of the  longtitudinal distance.";
CM_ SG_ 406 OBJ_Long_Distance_STD_V_2 "Validator for the STD of the  longtitudinal distance.";
CM_ SG_ 406 OBJ_Lat_Distance_2 "Lateral distance to the middle of the RL and RR corners.";
CM_ SG_ 406 OBJ_Lat_Distance_V_2 "Validator for the lateral distance of the object.";
CM_ SG_ 406 OBJ_Lat_Distance_STD_2 "STD of the lateral distance of the object.";
CM_ SG_ 406 OBJ_Lat_Distance_STD_V_2 "Validator for the STD of the lateral distance of the object.";
CM_ SG_ 406 OBJ_Absolute_Speed_2 "The absolute ground speed in the targets' heading direction.";
CM_ SG_ 406 OBJ_Absolute_Speed_V_2 "Validator for the absolute ground speed.";
CM_ SG_ 406 OBJ_Absolute_Speed_STD_2 "STD of the absolute ground speed.";
CM_ SG_ 406 OBJ_Absolute_Speed_STD_V_2 "Validator for the STD of the absolute ground speed.";
CM_ SG_ 406 OBJ_Heading_2 "The angle beetweenthe host longitudinal axis and target's heading (clockwise, e.g. PI/2 is a target crossing from left to right).";
CM_ SG_ 406 OBJ_Heading_V_2 "Validator for the object heading.";
CM_ SG_ 406 OBJ_Heading_STD_2 "STD of the object heading.";
CM_ SG_ 406 OBJ_Heading_STD_V_2 "Validator for the STD of the object heading.";
CM_ SG_ 406 OBJ_Angle_Rate_STD_2 "Standard deviation of the angular speed. (radians)";
CM_ SG_ 406 OBJ_Angle_Rate_STD_V_2 "Validator for the STD of the angular speed.";
CM_ SG_ 406 OBJ_Angle_Rate_2 "The momentary angular speed of the object. (radians)";
CM_ SG_ 406 OBJ_Angle_Rate_V_2 "Validator for the angular speed.";
CM_ SG_ 406 OBJ_Angle_Right_2 "The angle between the host longitudinal axis and the right side of the front / rear of the target (the visible one). The positive side is to the host's right.";
CM_ SG_ 406 OBJ_Angle_Right_V_2 "Validator for angleRight";
CM_ SG_ 406 OBJ_Angle_Right_STD_2 "Standard deviation of angleRight";
CM_ SG_ 406 OBJ_Angle_Right_STD_V_2 "Validator for the standard deviation of angleRight.";
CM_ SG_ 406 OBJ_Angle_Left_2 "The angle between the host longitudinal axis and the left side of the front / rear of the target (the visible one). The positive side is to the host's right.";
CM_ SG_ 406 OBJ_Angle_Left_V_2 "Validator for angleLeft.";
CM_ SG_ 406 OBJ_Angle_Left_STD_2 "Standard deviation of angleLeft.";
CM_ SG_ 406 OBJ_Angle_Left_STD_V_2 "Validator for the standard deviation of angleLeft.";
CM_ SG_ 406 OBJ_Angle_Side_2 "The angle between the host longitudinal axis and the far visible edge - the visible edge of the front / rear of the target that is not visible. Currently supported for vehicles only.";
CM_ SG_ 406 OBJ_Angle_Side_V_2 "Validator for angleSide.";
CM_ SG_ 406 OBJ_Angle_Side_STD_2 "Standard deviation of angleSide.";
CM_ SG_ 406 OBJ_Angle_Side_STD_V_2 "Validator for the STD of angleSide.";
CM_ SG_ 406 OBJ_Angle_Mid_V_2 "Validator for angleMid.";
CM_ SG_ 406 OBJ_Angle_Mid_2 "The angle between the host longitudinal axis and the middle of the front / rear of the target (the visible one). The positive side is to the host's right.";
CM_ SG_ 406 OBJ_Angle_Mid_STD_2 "Standard deviation of angleMid.";
CM_ SG_ 406 OBJ_Angle_Mid_STD_V_2 "Validator for the STD of angleMid.";
CM_ SG_ 406 OBJ_Angle_Bottom_V_2 "Validator for OBJAngle_Bottom.";
CM_ SG_ 406 OBJ_Angle_Bottom_2 "The angle between the longitudinal axis and the Bottom of the front / rear of the target (the visible one). The positive side is to the host's bottom";
CM_ SG_ 406 OBJ_Angle_Bottom_STD_2 "STD for OBJAngle_Bottom.";
CM_ SG_ 406 OBJ_Angle_Bottom_STD_V_2 "Validator for OBJAngle_Bottom_STD.";
CM_ SG_ 406 OBJ_Visibility_Side_V_2 "Currently Supported for VD only";
CM_ SG_ 406 OBJ_Visibility_Side_2 "From what car  side is the object visible";
CM_ SG_ 406 OBJ_Is_In_Drivable_Area_2 "Indicates whether the target is in a driveable area.";
CM_ SG_ 406 OBJ_Is_In_Drivable_Area_V_2 "Validator for OBJ_Is_In_Drivable_Area.";
CM_ SG_ 406 OBJ_Is_VeryClose_V_2 "Validator for OBJ_Is_VeryClose.";
CM_ SG_ 406 OBJ_Is_VeryClose_2 "Indicates whether the target is very close to the host such that it is hard to measure its distance. Currently relevant for peds only";
CM_ SG_ 406 OBJ_Is_EMERGENCY_VCL_2 "Is Object an Emergency Vehicle";
CM_ SG_ 406 OBJ_EMERGENCY_LIGHT_COLOR_2 "Emergency Color";
CM_ SG_ 406 OBJ_EMERGENCY_V_2 "Are OBJ_Is_EMERGENCY_VCL and OBJ_EMERGENCY_LIGHT_COLOR Valid";
CM_ SG_ 407 OBJ_Sync_ID_3_0 "The ID of the Sync message, used to synchronize between signals in the system. Every new frame promotes the sync ID by one.";
CM_ SG_ 407 OBJ_CRC_3 "Calculated over all element signals. From the signal after the CRC until the first signal in the next elements OBJ_CRC_N+1  not including";
CM_ SG_ 407 OBJ_ID_3 "The detected object ID. Range is 1-255, while 0 indicates that the field in unfilled.";
CM_ SG_ 407 OBJ_Existence_Probability_3 "The existence probability of the vehicle";
CM_ SG_ 407 OBJ_Motion_Category_3 "Relevant for VD only. Full description of values can be found at the ACC guide.";
CM_ SG_ 407 OBJ_Object_Age_3 "The number of frames in which the object was recognized.";
CM_ SG_ 407 OBJ_Measuring_Status_3 "Measurment status. Old vs New marks if this is the first frame in which the object is reported. Predicted vs Measured marks if the report is raw or has been predicted forward in time using the measured dynamics and ego motion.";
CM_ SG_ 407 OBJ_Object_Class_3 "Indicates the object type. Uncertain is outputted in case the probability that a vehicle is a truck is very similar to the probability that it is a car.";
CM_ SG_ 407 OBJ_Class_Probability_3 "The probability of this type classification.";
CM_ SG_ 407 OBJ_Motion_Status_3 "MOVING - the object is moving STATIONARY - the object was never seen moving STOPPED -  the object was moving and has stopped MOVING_SLOWLY - the object is moving very slowly";
CM_ SG_ 407 OBJ_Motion_Orientation_3 "The direction of the targets heading compared to the host.";
CM_ SG_ 407 OBJ_Has_Cut_Lane_3 "Indicates whether the object cut the host's (right or left) lane. In case there are no lanes, indicates whether the objects is at most 1 meters away from the host.";
CM_ SG_ 407 OBJ_Has_Cut_Path_3 "Indicates whether the object is in the host's path.";
CM_ SG_ 407 OBJ_Brake_Light_3 "Indication for brake lights";
CM_ SG_ 407 OBJ_Turn_Indicator_Right_3 "Indication for blinking right light.";
CM_ SG_ 407 OBJ_Turn_Indicator_Left_3 "Indication for blinking left light";
CM_ SG_ 407 OBJ_Light_Indicator_Validity_3 "Validator for light indicators";
CM_ SG_ 407 OBJ_Right_Out_Of_Image_3 "Indicates whether the measurment are predicted out of the right side of the image bounderies.";
CM_ SG_ 407 OBJ_Left_Out_Of_Image_3 "Indicates whether if measurment are predicted out of  the left side of the image bounderies";
CM_ SG_ 407 OBJ_Right_Out_Of_Image_V_3 "validator";
CM_ SG_ 407 OBJ_Left_Out_Of_Image_V_3 "validator";
CM_ SG_ 407 OBJ_Top_Out_Of_Image_3 "Indicates whether if measurment are predicted out of  the top of the image bounderies";
CM_ SG_ 407 OBJ_Bottom_Out_Of_Image_3 "Indicates whether if measurment are predicted out of  the bottom of the image bounderies";
CM_ SG_ 407 OBJ_Top_Out_Of_Image_V_3 "validator";
CM_ SG_ 407 OBJ_Bottom_Out_Of_Image_V_3 "validator";
CM_ SG_ 407 OBJ_Lane_Assignment_3 "The object's lane relative to the host lane.";
CM_ SG_ 407 OBJ_Lane_Assignment_V_3 "Validator for lane assignment";
CM_ SG_ 407 OBJ_Age_Seconds_3 "Time in seconds in which the object was recognized.";
CM_ SG_ 407 OBJ_Age_Seconds_V_3 "Validator for object age";
CM_ SG_ 407 OBJ_Width_3 "The width of the target vehicle in the world (not to be mistaken with the width of the visible part of the vehicle).";
CM_ SG_ 407 OBJ_Width_V_3 "Validator for object width";
CM_ SG_ 407 OBJ_Width_STD_3 "Standard deviation for object width";
CM_ SG_ 407 OBJ_Width_STD_V_3 "Validator for the standard deviation of object width";
CM_ SG_ 407 OBJ_Length_3 "The length of the vehicle in the world. For crossing bicycles it gives the viewed length of the bicycle.";
CM_ SG_ 407 OBJ_Length_V_3 "Validator for object length.";
CM_ SG_ 407 OBJ_Length_STD_3 "Standard deviation for object length.";
CM_ SG_ 407 OBJ_Length_STD_V_3 "Validator for the standard deviation of object length.";
CM_ SG_ 407 OBJ_Height_3 "The height of the object in the world.";
CM_ SG_ 407 OBJ_Height_V_3 "Validator for object height.";
CM_ SG_ 407 OBJ_Height_STD_3 "Standard deviation for object height.";
CM_ SG_ 407 OBJ_Height_STD_V_3 "Validator for the standard deviation of object height.";
CM_ SG_ 407 OBJ_Abs_Long_Velocity_3 "Absolute longitudinal velocity.";
CM_ SG_ 407 OBJ_Abs_Long_Velocity_V_3 "Validator for absolute longitudinal velocity.";
CM_ SG_ 407 OBJ_Abs_Long_Velocity_STD_3 "Standard deviation of absolute longitudinal velocity.";
CM_ SG_ 407 OBJ_Abs_Long_Vel_STD_V_3 "Validator for the standard deviation of the absolute longitudinal velocity.";
CM_ SG_ 407 OBJ_Abs_Lat_Velocity_3 "The lateral ground speed of the object.";
CM_ SG_ 407 OBJ_Abs_Lat_Velocity_V_3 "Validator for the lateral ground speed of the object.";
CM_ SG_ 407 OBJ_Abs_Lat_Velocity_STD_3 "STD of the lateral ground speed of the object.";
CM_ SG_ 407 OBJ_Abs_Lat_Vel_STD_V_3 "Validator for the STD of the lateral ground speed of the object.";
CM_ SG_ 407 OBJ_Abs_Long_Acc_3 "The longitudinal ground acceleration of the object.";
CM_ SG_ 407 OBJ_Abs_Long_Acc_V_3 "Validator for the longitudinal ground acceleration of the object.";
CM_ SG_ 407 OBJ_Abs_Long_Acc_STD_3 "STD of the longitudinal ground acceleration of the object.";
CM_ SG_ 407 OBJ_Abs_Long_Acc_STD_V_3 "Validator for the STD of the longitudinal ground acceleration of the object.";
CM_ SG_ 407 OBJ_Abs_Lat_Acc_3 "The lateral ground acceleration of the object.";
CM_ SG_ 407 OBJ_Abs_Lat_Acc_V_3 "Validator for the lateral ground acceleration of the object.";
CM_ SG_ 407 OBJ_Abs_Lat_Acc_STD_3 "STD of the lateral ground acceleration of the object.";
CM_ SG_ 407 OBJ_Abs_Lat_Acc_STD_V_3 "Validator for the STD of the lateral ground acceleration of the object.";
CM_ SG_ 407 OBJ_Abs_Acceleration_3 "The absolute ground acceleration in the target's heading direction.";
CM_ SG_ 407 OBJ_Abs_Acceleration_V_3 "Validator for the absolute ground acceleration.";
CM_ SG_ 407 OBJ_Abs_Acc_STD_3 "STD of the absolute ground acceleration.";
CM_ SG_ 407 OBJ_Abs_Acc_STD_V_3 "Validator for the STD of the absolute ground acceleration.";
CM_ SG_ 407 OBJ_Inv_TTC_3 "Inverse TTC (time to collision).";
CM_ SG_ 407 OBJ_Inv_TTC_STD_3 "STD for inverse TTC .";
CM_ SG_ 407 OBJ_Inv_TTC_STD_V_3 "Validator for the STD for inverse TTC .";
CM_ SG_ 407 OBJ_Relative_Long_Acc_3 "The relative lateral ground acceleration of the object.";
CM_ SG_ 407 OBJ_Relative_Long_Acc_V_3 "Validator for the relative lateral ground acceleration of the object.";
CM_ SG_ 407 OBJ_Relative_Long_Acc_STD_3 "STD of the relative lateral ground acceleration of the object.";
CM_ SG_ 407 OBJ_Rel_Long_Acc_STD_V_3 "Validator for the STD of the relative lateral ground acceleration.";
CM_ SG_ 407 OBJ_Relative_Long_Velocity_3 "The relative longtitudinal speed between the target and ego vehicle.";
CM_ SG_ 407 OBJ_Relative_Long_Velocity_V_3 "Validator for the relative longtitudinal speed.";
CM_ SG_ 407 OBJ_Relative_Long_Vel_STD_3 "STD of the relative longtitudinal speed.";
CM_ SG_ 407 OBJ_Rel_Long_Vel_STD_V_3 "Validator for the STD of the relative longtitudinal speed.";
CM_ SG_ 408 OBJ_Sync_ID_3_1 "The ID of the Sync message, used to synchronize between signals in the system. Every new frame promotes the sync ID by one.";
CM_ SG_ 408 OBJ_Relative_Lat_Velocity_3 "The relative lateral speed between the target and ego vehicle.";
CM_ SG_ 408 OBJ_Relative_Lat_Velocity_V_3 "Validator for the relative lateral speed.";
CM_ SG_ 408 OBJ_Relative_Lat_Velocity_STD_3 "STD of the relative lateral speed.";
CM_ SG_ 408 OBJ_Rel_Lat_Vel_STD_V_3 "Validator for the STD of the relative lateral speed.";
CM_ SG_ 408 OBJ_Long_Distance_3 "The longtitudinal distance from the object to middle of the rear bumper (middle of the RL and RR corners) of the target.";
CM_ SG_ 408 OBJ_Long_Distance_V_3 "Validator of the longtitudinal distance field";
CM_ SG_ 408 OBJ_Long_Distance_STD_3 "STD of the  longtitudinal distance.";
CM_ SG_ 408 OBJ_Long_Distance_STD_V_3 "Validator for the STD of the  longtitudinal distance.";
CM_ SG_ 408 OBJ_Lat_Distance_3 "Lateral distance to the middle of the RL and RR corners.";
CM_ SG_ 408 OBJ_Lat_Distance_V_3 "Validator for the lateral distance of the object.";
CM_ SG_ 408 OBJ_Lat_Distance_STD_3 "STD of the lateral distance of the object.";
CM_ SG_ 408 OBJ_Lat_Distance_STD_V_3 "Validator for the STD of the lateral distance of the object.";
CM_ SG_ 408 OBJ_Absolute_Speed_3 "The absolute ground speed in the targets' heading direction.";
CM_ SG_ 408 OBJ_Absolute_Speed_V_3 "Validator for the absolute ground speed.";
CM_ SG_ 408 OBJ_Absolute_Speed_STD_3 "STD of the absolute ground speed.";
CM_ SG_ 408 OBJ_Absolute_Speed_STD_V_3 "Validator for the STD of the absolute ground speed.";
CM_ SG_ 408 OBJ_Heading_3 "The angle beetweenthe host longitudinal axis and target's heading (clockwise, e.g. PI/2 is a target crossing from left to right).";
CM_ SG_ 408 OBJ_Heading_V_3 "Validator for the object heading.";
CM_ SG_ 408 OBJ_Heading_STD_3 "STD of the object heading.";
CM_ SG_ 408 OBJ_Heading_STD_V_3 "Validator for the STD of the object heading.";
CM_ SG_ 408 OBJ_Angle_Rate_STD_3 "Standard deviation of the angular speed. (radians)";
CM_ SG_ 408 OBJ_Angle_Rate_STD_V_3 "Validator for the STD of the angular speed.";
CM_ SG_ 408 OBJ_Angle_Rate_3 "The momentary angular speed of the object. (radians)";
CM_ SG_ 408 OBJ_Angle_Rate_V_3 "Validator for the angular speed.";
CM_ SG_ 408 OBJ_Angle_Right_3 "The angle between the host longitudinal axis and the right side of the front / rear of the target (the visible one). The positive side is to the host's right.";
CM_ SG_ 408 OBJ_Angle_Right_V_3 "Validator for angleRight";
CM_ SG_ 408 OBJ_Angle_Right_STD_3 "Standard deviation of angleRight";
CM_ SG_ 408 OBJ_Angle_Right_STD_V_3 "Validator for the standard deviation of angleRight.";
CM_ SG_ 408 OBJ_Angle_Left_3 "The angle between the host longitudinal axis and the left side of the front / rear of the target (the visible one). The positive side is to the host's right.";
CM_ SG_ 408 OBJ_Angle_Left_V_3 "Validator for angleLeft.";
CM_ SG_ 408 OBJ_Angle_Left_STD_3 "Standard deviation of angleLeft.";
CM_ SG_ 408 OBJ_Angle_Left_STD_V_3 "Validator for the standard deviation of angleLeft.";
CM_ SG_ 408 OBJ_Angle_Side_3 "The angle between the host longitudinal axis and the far visible edge - the visible edge of the front / rear of the target that is not visible. Currently supported for vehicles only.";
CM_ SG_ 408 OBJ_Angle_Side_V_3 "Validator for angleSide.";
CM_ SG_ 408 OBJ_Angle_Side_STD_3 "Standard deviation of angleSide.";
CM_ SG_ 408 OBJ_Angle_Side_STD_V_3 "Validator for the STD of angleSide.";
CM_ SG_ 408 OBJ_Angle_Mid_V_3 "Validator for angleMid.";
CM_ SG_ 408 OBJ_Angle_Mid_3 "The angle between the host longitudinal axis and the middle of the front / rear of the target (the visible one). The positive side is to the host's right.";
CM_ SG_ 408 OBJ_Angle_Mid_STD_3 "Standard deviation of angleMid.";
CM_ SG_ 408 OBJ_Angle_Mid_STD_V_3 "Validator for the STD of angleMid.";
CM_ SG_ 408 OBJ_Angle_Bottom_V_3 "Validator for OBJAngle_Bottom.";
CM_ SG_ 408 OBJ_Angle_Bottom_3 "The angle between the longitudinal axis and the Bottom of the front / rear of the target (the visible one). The positive side is to the host's bottom";
CM_ SG_ 408 OBJ_Angle_Bottom_STD_3 "STD for OBJAngle_Bottom.";
CM_ SG_ 408 OBJ_Angle_Bottom_STD_V_3 "Validator for OBJAngle_Bottom_STD.";
CM_ SG_ 408 OBJ_Visibility_Side_V_3 "Currently Supported for VD only";
CM_ SG_ 408 OBJ_Visibility_Side_3 "From what car  side is the object visible";
CM_ SG_ 408 OBJ_Is_In_Drivable_Area_3 "Indicates whether the target is in a driveable area.";
CM_ SG_ 408 OBJ_Is_In_Drivable_Area_V_3 "Validator for OBJ_Is_In_Drivable_Area.";
CM_ SG_ 408 OBJ_Is_VeryClose_V_3 "Validator for OBJ_Is_VeryClose.";
CM_ SG_ 408 OBJ_Is_VeryClose_3 "Indicates whether the target is very close to the host such that it is hard to measure its distance. Currently relevant for peds only";
CM_ SG_ 408 OBJ_Is_EMERGENCY_VCL_3 "Is Object an Emergency Vehicle";
CM_ SG_ 408 OBJ_EMERGENCY_LIGHT_COLOR_3 "Emergency Color";
CM_ SG_ 408 OBJ_EMERGENCY_V_3 "Are OBJ_Is_EMERGENCY_VCL and OBJ_EMERGENCY_LIGHT_COLOR Valid";
CM_ SG_ 409 OBJ_Sync_ID_4_0 "The ID of the Sync message, used to synchronize between signals in the system. Every new frame promotes the sync ID by one.";
CM_ SG_ 409 OBJ_CRC_4 "Calculated over all element signals. From the signal after the CRC until the first signal in the next elements OBJ_CRC_N+1  not including";
CM_ SG_ 409 OBJ_ID_4 "The detected object ID. Range is 1-255, while 0 indicates that the field in unfilled.";
CM_ SG_ 409 OBJ_Existence_Probability_4 "The existence probability of the vehicle";
CM_ SG_ 409 OBJ_Motion_Category_4 "Relevant for VD only. Full description of values can be found at the ACC guide.";
CM_ SG_ 409 OBJ_Object_Age_4 "The number of frames in which the object was recognized.";
CM_ SG_ 409 OBJ_Measuring_Status_4 "Measurment status. Old vs New marks if this is the first frame in which the object is reported. Predicted vs Measured marks if the report is raw or has been predicted forward in time using the measured dynamics and ego motion.";
CM_ SG_ 409 OBJ_Object_Class_4 "Indicates the object type. Uncertain is outputted in case the probability that a vehicle is a truck is very similar to the probability that it is a car.";
CM_ SG_ 409 OBJ_Class_Probability_4 "The probability of this type classification.";
CM_ SG_ 409 OBJ_Motion_Status_4 "MOVING - the object is moving STATIONARY - the object was never seen moving STOPPED -  the object was moving and has stopped MOVING_SLOWLY - the object is moving very slowly";
CM_ SG_ 409 OBJ_Motion_Orientation_4 "The direction of the targets heading compared to the host.";
CM_ SG_ 409 OBJ_Has_Cut_Lane_4 "Indicates whether the object cut the host's (right or left) lane. In case there are no lanes, indicates whether the objects is at most 1 meters away from the host.";
CM_ SG_ 409 OBJ_Has_Cut_Path_4 "Indicates whether the object is in the host's path.";
CM_ SG_ 409 OBJ_Brake_Light_4 "Indication for brake lights";
CM_ SG_ 409 OBJ_Turn_Indicator_Right_4 "Indication for blinking right light.";
CM_ SG_ 409 OBJ_Turn_Indicator_Left_4 "Indication for blinking left light";
CM_ SG_ 409 OBJ_Light_Indicator_Validity_4 "Validator for light indicators";
CM_ SG_ 409 OBJ_Right_Out_Of_Image_4 "Indicates whether the measurment are predicted out of the right side of the image bounderies.";
CM_ SG_ 409 OBJ_Left_Out_Of_Image_4 "Indicates whether if measurment are predicted out of  the left side of the image bounderies";
CM_ SG_ 409 OBJ_Right_Out_Of_Image_V_4 "validator";
CM_ SG_ 409 OBJ_Left_Out_Of_Image_V_4 "validator";
CM_ SG_ 409 OBJ_Top_Out_Of_Image_4 "Indicates whether if measurment are predicted out of  the top of the image bounderies";
CM_ SG_ 409 OBJ_Bottom_Out_Of_Image_4 "Indicates whether if measurment are predicted out of  the bottom of the image bounderies";
CM_ SG_ 409 OBJ_Top_Out_Of_Image_V_4 "validator";
CM_ SG_ 409 OBJ_Bottom_Out_Of_Image_V_4 "validator";
CM_ SG_ 409 OBJ_Lane_Assignment_4 "The object's lane relative to the host lane.";
CM_ SG_ 409 OBJ_Lane_Assignment_V_4 "Validator for lane assignment";
CM_ SG_ 409 OBJ_Age_Seconds_4 "Time in seconds in which the object was recognized.";
CM_ SG_ 409 OBJ_Age_Seconds_V_4 "Validator for object age";
CM_ SG_ 409 OBJ_Width_4 "The width of the target vehicle in the world (not to be mistaken with the width of the visible part of the vehicle).";
CM_ SG_ 409 OBJ_Width_V_4 "Validator for object width";
CM_ SG_ 409 OBJ_Width_STD_4 "Standard deviation for object width";
CM_ SG_ 409 OBJ_Width_STD_V_4 "Validator for the standard deviation of object width";
CM_ SG_ 409 OBJ_Length_4 "The length of the vehicle in the world. For crossing bicycles it gives the viewed length of the bicycle.";
CM_ SG_ 409 OBJ_Length_V_4 "Validator for object length.";
CM_ SG_ 409 OBJ_Length_STD_4 "Standard deviation for object length.";
CM_ SG_ 409 OBJ_Length_STD_V_4 "Validator for the standard deviation of object length.";
CM_ SG_ 409 OBJ_Height_4 "The height of the object in the world.";
CM_ SG_ 409 OBJ_Height_V_4 "Validator for object height.";
CM_ SG_ 409 OBJ_Height_STD_4 "Standard deviation for object height.";
CM_ SG_ 409 OBJ_Height_STD_V_4 "Validator for the standard deviation of object height.";
CM_ SG_ 409 OBJ_Abs_Long_Velocity_4 "Absolute longitudinal velocity.";
CM_ SG_ 409 OBJ_Abs_Long_Velocity_V_4 "Validator for absolute longitudinal velocity.";
CM_ SG_ 409 OBJ_Abs_Long_Velocity_STD_4 "Standard deviation of absolute longitudinal velocity.";
CM_ SG_ 409 OBJ_Abs_Long_Vel_STD_V_4 "Validator for the standard deviation of the absolute longitudinal velocity.";
CM_ SG_ 409 OBJ_Abs_Lat_Velocity_4 "The lateral ground speed of the object.";
CM_ SG_ 409 OBJ_Abs_Lat_Velocity_V_4 "Validator for the lateral ground speed of the object.";
CM_ SG_ 409 OBJ_Abs_Lat_Velocity_STD_4 "STD of the lateral ground speed of the object.";
CM_ SG_ 409 OBJ_Abs_Lat_Vel_STD_V_4 "Validator for the STD of the lateral ground speed of the object.";
CM_ SG_ 409 OBJ_Abs_Long_Acc_4 "The longitudinal ground acceleration of the object.";
CM_ SG_ 409 OBJ_Abs_Long_Acc_V_4 "Validator for the longitudinal ground acceleration of the object.";
CM_ SG_ 409 OBJ_Abs_Long_Acc_STD_4 "STD of the longitudinal ground acceleration of the object.";
CM_ SG_ 409 OBJ_Abs_Long_Acc_STD_V_4 "Validator for the STD of the longitudinal ground acceleration of the object.";
CM_ SG_ 409 OBJ_Abs_Lat_Acc_4 "The lateral ground acceleration of the object.";
CM_ SG_ 409 OBJ_Abs_Lat_Acc_V_4 "Validator for the lateral ground acceleration of the object.";
CM_ SG_ 409 OBJ_Abs_Lat_Acc_STD_4 "STD of the lateral ground acceleration of the object.";
CM_ SG_ 409 OBJ_Abs_Lat_Acc_STD_V_4 "Validator for the STD of the lateral ground acceleration of the object.";
CM_ SG_ 409 OBJ_Abs_Acceleration_4 "The absolute ground acceleration in the target's heading direction.";
CM_ SG_ 409 OBJ_Abs_Acceleration_V_4 "Validator for the absolute ground acceleration.";
CM_ SG_ 409 OBJ_Abs_Acc_STD_4 "STD of the absolute ground acceleration.";
CM_ SG_ 409 OBJ_Abs_Acc_STD_V_4 "Validator for the STD of the absolute ground acceleration.";
CM_ SG_ 409 OBJ_Inv_TTC_4 "Inverse TTC (time to collision).";
CM_ SG_ 409 OBJ_Inv_TTC_STD_4 "STD for inverse TTC .";
CM_ SG_ 409 OBJ_Inv_TTC_STD_V_4 "Validator for the STD for inverse TTC .";
CM_ SG_ 409 OBJ_Relative_Long_Acc_4 "The relative lateral ground acceleration of the object.";
CM_ SG_ 409 OBJ_Relative_Long_Acc_V_4 "Validator for the relative lateral ground acceleration of the object.";
CM_ SG_ 409 OBJ_Relative_Long_Acc_STD_4 "STD of the relative lateral ground acceleration of the object.";
CM_ SG_ 409 OBJ_Rel_Long_Acc_STD_V_4 "Validator for the STD of the relative lateral ground acceleration.";
CM_ SG_ 409 OBJ_Relative_Long_Velocity_4 "The relative longtitudinal speed between the target and ego vehicle.";
CM_ SG_ 409 OBJ_Relative_Long_Velocity_V_4 "Validator for the relative longtitudinal speed.";
CM_ SG_ 409 OBJ_Relative_Long_Vel_STD_4 "STD of the relative longtitudinal speed.";
CM_ SG_ 409 OBJ_Rel_Long_Vel_STD_V_4 "Validator for the STD of the relative longtitudinal speed.";
CM_ SG_ 410 OBJ_Sync_ID_4_1 "The ID of the Sync message, used to synchronize between signals in the system. Every new frame promotes the sync ID by one.";
CM_ SG_ 410 OBJ_Relative_Lat_Velocity_4 "The relative lateral speed between the target and ego vehicle.";
CM_ SG_ 410 OBJ_Relative_Lat_Velocity_V_4 "Validator for the relative lateral speed.";
CM_ SG_ 410 OBJ_Relative_Lat_Velocity_STD_4 "STD of the relative lateral speed.";
CM_ SG_ 410 OBJ_Rel_Lat_Vel_STD_V_4 "Validator for the STD of the relative lateral speed.";
CM_ SG_ 410 OBJ_Long_Distance_4 "The longtitudinal distance from the object to middle of the rear bumper (middle of the RL and RR corners) of the target.";
CM_ SG_ 410 OBJ_Long_Distance_V_4 "Validator of the longtitudinal distance field";
CM_ SG_ 410 OBJ_Long_Distance_STD_4 "STD of the  longtitudinal distance.";
CM_ SG_ 410 OBJ_Long_Distance_STD_V_4 "Validator for the STD of the  longtitudinal distance.";
CM_ SG_ 410 OBJ_Lat_Distance_4 "Lateral distance to the middle of the RL and RR corners.";
CM_ SG_ 410 OBJ_Lat_Distance_V_4 "Validator for the lateral distance of the object.";
CM_ SG_ 410 OBJ_Lat_Distance_STD_4 "STD of the lateral distance of the object.";
CM_ SG_ 410 OBJ_Lat_Distance_STD_V_4 "Validator for the STD of the lateral distance of the object.";
CM_ SG_ 410 OBJ_Absolute_Speed_4 "The absolute ground speed in the targets' heading direction.";
CM_ SG_ 410 OBJ_Absolute_Speed_V_4 "Validator for the absolute ground speed.";
CM_ SG_ 410 OBJ_Absolute_Speed_STD_4 "STD of the absolute ground speed.";
CM_ SG_ 410 OBJ_Absolute_Speed_STD_V_4 "Validator for the STD of the absolute ground speed.";
CM_ SG_ 410 OBJ_Heading_4 "The angle beetweenthe host longitudinal axis and target's heading (clockwise, e.g. PI/2 is a target crossing from left to right).";
CM_ SG_ 410 OBJ_Heading_V_4 "Validator for the object heading.";
CM_ SG_ 410 OBJ_Heading_STD_4 "STD of the object heading.";
CM_ SG_ 410 OBJ_Heading_STD_V_4 "Validator for the STD of the object heading.";
CM_ SG_ 410 OBJ_Angle_Rate_STD_4 "Standard deviation of the angular speed. (radians)";
CM_ SG_ 410 OBJ_Angle_Rate_STD_V_4 "Validator for the STD of the angular speed.";
CM_ SG_ 410 OBJ_Angle_Rate_4 "The momentary angular speed of the object. (radians)";
CM_ SG_ 410 OBJ_Angle_Rate_V_4 "Validator for the angular speed.";
CM_ SG_ 410 OBJ_Angle_Right_4 "The angle between the host longitudinal axis and the right side of the front / rear of the target (the visible one). The positive side is to the host's right.";
CM_ SG_ 410 OBJ_Angle_Right_V_4 "Validator for angleRight";
CM_ SG_ 410 OBJ_Angle_Right_STD_4 "Standard deviation of angleRight";
CM_ SG_ 410 OBJ_Angle_Right_STD_V_4 "Validator for the standard deviation of angleRight.";
CM_ SG_ 410 OBJ_Angle_Left_4 "The angle between the host longitudinal axis and the left side of the front / rear of the target (the visible one). The positive side is to the host's right.";
CM_ SG_ 410 OBJ_Angle_Left_V_4 "Validator for angleLeft.";
CM_ SG_ 410 OBJ_Angle_Left_STD_4 "Standard deviation of angleLeft.";
CM_ SG_ 410 OBJ_Angle_Left_STD_V_4 "Validator for the standard deviation of angleLeft.";
CM_ SG_ 410 OBJ_Angle_Side_4 "The angle between the host longitudinal axis and the far visible edge - the visible edge of the front / rear of the target that is not visible. Currently supported for vehicles only.";
CM_ SG_ 410 OBJ_Angle_Side_V_4 "Validator for angleSide.";
CM_ SG_ 410 OBJ_Angle_Side_STD_4 "Standard deviation of angleSide.";
CM_ SG_ 410 OBJ_Angle_Side_STD_V_4 "Validator for the STD of angleSide.";
CM_ SG_ 410 OBJ_Angle_Mid_V_4 "Validator for angleMid.";
CM_ SG_ 410 OBJ_Angle_Mid_4 "The angle between the host longitudinal axis and the middle of the front / rear of the target (the visible one). The positive side is to the host's right.";
CM_ SG_ 410 OBJ_Angle_Mid_STD_4 "Standard deviation of angleMid.";
CM_ SG_ 410 OBJ_Angle_Mid_STD_V_4 "Validator for the STD of angleMid.";
CM_ SG_ 410 OBJ_Angle_Bottom_V_4 "Validator for OBJAngle_Bottom.";
CM_ SG_ 410 OBJ_Angle_Bottom_4 "The angle between the longitudinal axis and the Bottom of the front / rear of the target (the visible one). The positive side is to the host's bottom";
CM_ SG_ 410 OBJ_Angle_Bottom_STD_4 "STD for OBJAngle_Bottom.";
CM_ SG_ 410 OBJ_Angle_Bottom_STD_V_4 "Validator for OBJAngle_Bottom_STD.";
CM_ SG_ 410 OBJ_Visibility_Side_V_4 "Currently Supported for VD only";
CM_ SG_ 410 OBJ_Visibility_Side_4 "From what car  side is the object visible";
CM_ SG_ 410 OBJ_Is_In_Drivable_Area_4 "Indicates whether the target is in a driveable area.";
CM_ SG_ 410 OBJ_Is_In_Drivable_Area_V_4 "Validator for OBJ_Is_In_Drivable_Area.";
CM_ SG_ 410 OBJ_Is_VeryClose_V_4 "Validator for OBJ_Is_VeryClose.";
CM_ SG_ 410 OBJ_Is_VeryClose_4 "Indicates whether the target is very close to the host such that it is hard to measure its distance. Currently relevant for peds only";
CM_ SG_ 410 OBJ_Is_EMERGENCY_VCL_4 "Is Object an Emergency Vehicle";
CM_ SG_ 410 OBJ_EMERGENCY_LIGHT_COLOR_4 "Emergency Color";
CM_ SG_ 410 OBJ_EMERGENCY_V_4 "Are OBJ_Is_EMERGENCY_VCL and OBJ_EMERGENCY_LIGHT_COLOR Valid";
CM_ SG_ 411 OBJ_Sync_ID_5_0 "The ID of the Sync message, used to synchronize between signals in the system. Every new frame promotes the sync ID by one.";
CM_ SG_ 411 OBJ_CRC_5 "Calculated over all element signals. From the signal after the CRC until the first signal in the next elements OBJ_CRC_N+1  not including";
CM_ SG_ 411 OBJ_ID_5 "The detected object ID. Range is 1-255, while 0 indicates that the field in unfilled.";
CM_ SG_ 411 OBJ_Existence_Probability_5 "The existence probability of the vehicle";
CM_ SG_ 411 OBJ_Motion_Category_5 "Relevant for VD only. Full description of values can be found at the ACC guide.";
CM_ SG_ 411 OBJ_Object_Age_5 "The number of frames in which the object was recognized.";
CM_ SG_ 411 OBJ_Measuring_Status_5 "Measurment status. Old vs New marks if this is the first frame in which the object is reported. Predicted vs Measured marks if the report is raw or has been predicted forward in time using the measured dynamics and ego motion.";
CM_ SG_ 411 OBJ_Object_Class_5 "Indicates the object type. Uncertain is outputted in case the probability that a vehicle is a truck is very similar to the probability that it is a car.";
CM_ SG_ 411 OBJ_Class_Probability_5 "The probability of this type classification.";
CM_ SG_ 411 OBJ_Motion_Status_5 "MOVING - the object is moving STATIONARY - the object was never seen moving STOPPED -  the object was moving and has stopped MOVING_SLOWLY - the object is moving very slowly";
CM_ SG_ 411 OBJ_Motion_Orientation_5 "The direction of the targets heading compared to the host.";
CM_ SG_ 411 OBJ_Has_Cut_Lane_5 "Indicates whether the object cut the host's (right or left) lane. In case there are no lanes, indicates whether the objects is at most 1 meters away from the host.";
CM_ SG_ 411 OBJ_Has_Cut_Path_5 "Indicates whether the object is in the host's path.";
CM_ SG_ 411 OBJ_Brake_Light_5 "Indication for brake lights";
CM_ SG_ 411 OBJ_Turn_Indicator_Right_5 "Indication for blinking right light.";
CM_ SG_ 411 OBJ_Turn_Indicator_Left_5 "Indication for blinking left light";
CM_ SG_ 411 OBJ_Light_Indicator_Validity_5 "Validator for light indicators";
CM_ SG_ 411 OBJ_Right_Out_Of_Image_5 "Indicates whether the measurment are predicted out of the right side of the image bounderies.";
CM_ SG_ 411 OBJ_Left_Out_Of_Image_5 "Indicates whether if measurment are predicted out of  the left side of the image bounderies";
CM_ SG_ 411 OBJ_Right_Out_Of_Image_V_5 "validator";
CM_ SG_ 411 OBJ_Left_Out_Of_Image_V_5 "validator";
CM_ SG_ 411 OBJ_Top_Out_Of_Image_5 "Indicates whether if measurment are predicted out of  the top of the image bounderies";
CM_ SG_ 411 OBJ_Bottom_Out_Of_Image_5 "Indicates whether if measurment are predicted out of  the bottom of the image bounderies";
CM_ SG_ 411 OBJ_Top_Out_Of_Image_V_5 "validator";
CM_ SG_ 411 OBJ_Bottom_Out_Of_Image_V_5 "validator";
CM_ SG_ 411 OBJ_Lane_Assignment_5 "The object's lane relative to the host lane.";
CM_ SG_ 411 OBJ_Lane_Assignment_V_5 "Validator for lane assignment";
CM_ SG_ 411 OBJ_Age_Seconds_5 "Time in seconds in which the object was recognized.";
CM_ SG_ 411 OBJ_Age_Seconds_V_5 "Validator for object age";
CM_ SG_ 411 OBJ_Width_5 "The width of the target vehicle in the world (not to be mistaken with the width of the visible part of the vehicle).";
CM_ SG_ 411 OBJ_Width_V_5 "Validator for object width";
CM_ SG_ 411 OBJ_Width_STD_5 "Standard deviation for object width";
CM_ SG_ 411 OBJ_Width_STD_V_5 "Validator for the standard deviation of object width";
CM_ SG_ 411 OBJ_Length_5 "The length of the vehicle in the world. For crossing bicycles it gives the viewed length of the bicycle.";
CM_ SG_ 411 OBJ_Length_V_5 "Validator for object length.";
CM_ SG_ 411 OBJ_Length_STD_5 "Standard deviation for object length.";
CM_ SG_ 411 OBJ_Length_STD_V_5 "Validator for the standard deviation of object length.";
CM_ SG_ 411 OBJ_Height_5 "The height of the object in the world.";
CM_ SG_ 411 OBJ_Height_V_5 "Validator for object height.";
CM_ SG_ 411 OBJ_Height_STD_5 "Standard deviation for object height.";
CM_ SG_ 411 OBJ_Height_STD_V_5 "Validator for the standard deviation of object height.";
CM_ SG_ 411 OBJ_Abs_Long_Velocity_5 "Absolute longitudinal velocity.";
CM_ SG_ 411 OBJ_Abs_Long_Velocity_V_5 "Validator for absolute longitudinal velocity.";
CM_ SG_ 411 OBJ_Abs_Long_Velocity_STD_5 "Standard deviation of absolute longitudinal velocity.";
CM_ SG_ 411 OBJ_Abs_Long_Vel_STD_V_5 "Validator for the standard deviation of the absolute longitudinal velocity.";
CM_ SG_ 411 OBJ_Abs_Lat_Velocity_5 "The lateral ground speed of the object.";
CM_ SG_ 411 OBJ_Abs_Lat_Velocity_V_5 "Validator for the lateral ground speed of the object.";
CM_ SG_ 411 OBJ_Abs_Lat_Velocity_STD_5 "STD of the lateral ground speed of the object.";
CM_ SG_ 411 OBJ_Abs_Lat_Vel_STD_V_5 "Validator for the STD of the lateral ground speed of the object.";
CM_ SG_ 411 OBJ_Abs_Long_Acc_5 "The longitudinal ground acceleration of the object.";
CM_ SG_ 411 OBJ_Abs_Long_Acc_V_5 "Validator for the longitudinal ground acceleration of the object.";
CM_ SG_ 411 OBJ_Abs_Long_Acc_STD_5 "STD of the longitudinal ground acceleration of the object.";
CM_ SG_ 411 OBJ_Abs_Long_Acc_STD_V_5 "Validator for the STD of the longitudinal ground acceleration of the object.";
CM_ SG_ 411 OBJ_Abs_Lat_Acc_5 "The lateral ground acceleration of the object.";
CM_ SG_ 411 OBJ_Abs_Lat_Acc_V_5 "Validator for the lateral ground acceleration of the object.";
CM_ SG_ 411 OBJ_Abs_Lat_Acc_STD_5 "STD of the lateral ground acceleration of the object.";
CM_ SG_ 411 OBJ_Abs_Lat_Acc_STD_V_5 "Validator for the STD of the lateral ground acceleration of the object.";
CM_ SG_ 411 OBJ_Abs_Acceleration_5 "The absolute ground acceleration in the target's heading direction.";
CM_ SG_ 411 OBJ_Abs_Acceleration_V_5 "Validator for the absolute ground acceleration.";
CM_ SG_ 411 OBJ_Abs_Acc_STD_5 "STD of the absolute ground acceleration.";
CM_ SG_ 411 OBJ_Abs_Acc_STD_V_5 "Validator for the STD of the absolute ground acceleration.";
CM_ SG_ 411 OBJ_Inv_TTC_5 "Inverse TTC (time to collision).";
CM_ SG_ 411 OBJ_Inv_TTC_STD_5 "STD for inverse TTC .";
CM_ SG_ 411 OBJ_Inv_TTC_STD_V_5 "Validator for the STD for inverse TTC .";
CM_ SG_ 411 OBJ_Relative_Long_Acc_5 "The relative lateral ground acceleration of the object.";
CM_ SG_ 411 OBJ_Relative_Long_Acc_V_5 "Validator for the relative lateral ground acceleration of the object.";
CM_ SG_ 411 OBJ_Relative_Long_Acc_STD_5 "STD of the relative lateral ground acceleration of the object.";
CM_ SG_ 411 OBJ_Rel_Long_Acc_STD_V_5 "Validator for the STD of the relative lateral ground acceleration.";
CM_ SG_ 411 OBJ_Relative_Long_Velocity_5 "The relative longtitudinal speed between the target and ego vehicle.";
CM_ SG_ 411 OBJ_Relative_Long_Velocity_V_5 "Validator for the relative longtitudinal speed.";
CM_ SG_ 411 OBJ_Relative_Long_Vel_STD_5 "STD of the relative longtitudinal speed.";
CM_ SG_ 411 OBJ_Rel_Long_Vel_STD_V_5 "Validator for the STD of the relative longtitudinal speed.";
CM_ SG_ 412 OBJ_Sync_ID_5_1 "The ID of the Sync message, used to synchronize between signals in the system. Every new frame promotes the sync ID by one.";
CM_ SG_ 412 OBJ_Relative_Lat_Velocity_5 "The relative lateral speed between the target and ego vehicle.";
CM_ SG_ 412 OBJ_Relative_Lat_Velocity_V_5 "Validator for the relative lateral speed.";
CM_ SG_ 412 OBJ_Relative_Lat_Velocity_STD_5 "STD of the relative lateral speed.";
CM_ SG_ 412 OBJ_Rel_Lat_Vel_STD_V_5 "Validator for the STD of the relative lateral speed.";
CM_ SG_ 412 OBJ_Long_Distance_5 "The longtitudinal distance from the object to middle of the rear bumper (middle of the RL and RR corners) of the target.";
CM_ SG_ 412 OBJ_Long_Distance_V_5 "Validator of the longtitudinal distance field";
CM_ SG_ 412 OBJ_Long_Distance_STD_5 "STD of the  longtitudinal distance.";
CM_ SG_ 412 OBJ_Long_Distance_STD_V_5 "Validator for the STD of the  longtitudinal distance.";
CM_ SG_ 412 OBJ_Lat_Distance_5 "Lateral distance to the middle of the RL and RR corners.";
CM_ SG_ 412 OBJ_Lat_Distance_V_5 "Validator for the lateral distance of the object.";
CM_ SG_ 412 OBJ_Lat_Distance_STD_5 "STD of the lateral distance of the object.";
CM_ SG_ 412 OBJ_Lat_Distance_STD_V_5 "Validator for the STD of the lateral distance of the object.";
CM_ SG_ 412 OBJ_Absolute_Speed_5 "The absolute ground speed in the targets' heading direction.";
CM_ SG_ 412 OBJ_Absolute_Speed_V_5 "Validator for the absolute ground speed.";
CM_ SG_ 412 OBJ_Absolute_Speed_STD_5 "STD of the absolute ground speed.";
CM_ SG_ 412 OBJ_Absolute_Speed_STD_V_5 "Validator for the STD of the absolute ground speed.";
CM_ SG_ 412 OBJ_Heading_5 "The angle beetweenthe host longitudinal axis and target's heading (clockwise, e.g. PI/2 is a target crossing from left to right).";
CM_ SG_ 412 OBJ_Heading_V_5 "Validator for the object heading.";
CM_ SG_ 412 OBJ_Heading_STD_5 "STD of the object heading.";
CM_ SG_ 412 OBJ_Heading_STD_V_5 "Validator for the STD of the object heading.";
CM_ SG_ 412 OBJ_Angle_Rate_STD_5 "Standard deviation of the angular speed. (radians)";
CM_ SG_ 412 OBJ_Angle_Rate_STD_V_5 "Validator for the STD of the angular speed.";
CM_ SG_ 412 OBJ_Angle_Rate_5 "The momentary angular speed of the object. (radians)";
CM_ SG_ 412 OBJ_Angle_Rate_V_5 "Validator for the angular speed.";
CM_ SG_ 412 OBJ_Angle_Right_5 "The angle between the host longitudinal axis and the right side of the front / rear of the target (the visible one). The positive side is to the host's right.";
CM_ SG_ 412 OBJ_Angle_Right_V_5 "Validator for angleRight";
CM_ SG_ 412 OBJ_Angle_Right_STD_5 "Standard deviation of angleRight";
CM_ SG_ 412 OBJ_Angle_Right_STD_V_5 "Validator for the standard deviation of angleRight.";
CM_ SG_ 412 OBJ_Angle_Left_5 "The angle between the host longitudinal axis and the left side of the front / rear of the target (the visible one). The positive side is to the host's right.";
CM_ SG_ 412 OBJ_Angle_Left_V_5 "Validator for angleLeft.";
CM_ SG_ 412 OBJ_Angle_Left_STD_5 "Standard deviation of angleLeft.";
CM_ SG_ 412 OBJ_Angle_Left_STD_V_5 "Validator for the standard deviation of angleLeft.";
CM_ SG_ 412 OBJ_Angle_Side_5 "The angle between the host longitudinal axis and the far visible edge - the visible edge of the front / rear of the target that is not visible. Currently supported for vehicles only.";
CM_ SG_ 412 OBJ_Angle_Side_V_5 "Validator for angleSide.";
CM_ SG_ 412 OBJ_Angle_Side_STD_5 "Standard deviation of angleSide.";
CM_ SG_ 412 OBJ_Angle_Side_STD_V_5 "Validator for the STD of angleSide.";
CM_ SG_ 412 OBJ_Angle_Mid_V_5 "Validator for angleMid.";
CM_ SG_ 412 OBJ_Angle_Mid_5 "The angle between the host longitudinal axis and the middle of the front / rear of the target (the visible one). The positive side is to the host's right.";
CM_ SG_ 412 OBJ_Angle_Mid_STD_5 "Standard deviation of angleMid.";
CM_ SG_ 412 OBJ_Angle_Mid_STD_V_5 "Validator for the STD of angleMid.";
CM_ SG_ 412 OBJ_Angle_Bottom_V_5 "Validator for OBJAngle_Bottom.";
CM_ SG_ 412 OBJ_Angle_Bottom_5 "The angle between the longitudinal axis and the Bottom of the front / rear of the target (the visible one). The positive side is to the host's bottom";
CM_ SG_ 412 OBJ_Angle_Bottom_STD_5 "STD for OBJAngle_Bottom.";
CM_ SG_ 412 OBJ_Angle_Bottom_STD_V_5 "Validator for OBJAngle_Bottom_STD.";
CM_ SG_ 412 OBJ_Visibility_Side_V_5 "Currently Supported for VD only";
CM_ SG_ 412 OBJ_Visibility_Side_5 "From what car  side is the object visible";
CM_ SG_ 412 OBJ_Is_In_Drivable_Area_5 "Indicates whether the target is in a driveable area.";
CM_ SG_ 412 OBJ_Is_In_Drivable_Area_V_5 "Validator for OBJ_Is_In_Drivable_Area.";
CM_ SG_ 412 OBJ_Is_VeryClose_V_5 "Validator for OBJ_Is_VeryClose.";
CM_ SG_ 412 OBJ_Is_VeryClose_5 "Indicates whether the target is very close to the host such that it is hard to measure its distance. Currently relevant for peds only";
CM_ SG_ 412 OBJ_Is_EMERGENCY_VCL_5 "Is Object an Emergency Vehicle";
CM_ SG_ 412 OBJ_EMERGENCY_LIGHT_COLOR_5 "Emergency Color";
CM_ SG_ 412 OBJ_EMERGENCY_V_5 "Are OBJ_Is_EMERGENCY_VCL and OBJ_EMERGENCY_LIGHT_COLOR Valid";
CM_ SG_ 413 OBJ_Sync_ID_6_0 "The ID of the Sync message, used to synchronize between signals in the system. Every new frame promotes the sync ID by one.";
CM_ SG_ 413 OBJ_CRC_6 "Calculated over all element signals. From the signal after the CRC until the first signal in the next elements OBJ_CRC_N+1  not including";
CM_ SG_ 413 OBJ_ID_6 "The detected object ID. Range is 1-255, while 0 indicates that the field in unfilled.";
CM_ SG_ 413 OBJ_Existence_Probability_6 "The existence probability of the vehicle";
CM_ SG_ 413 OBJ_Motion_Category_6 "Relevant for VD only. Full description of values can be found at the ACC guide.";
CM_ SG_ 413 OBJ_Object_Age_6 "The number of frames in which the object was recognized.";
CM_ SG_ 413 OBJ_Measuring_Status_6 "Measurment status. Old vs New marks if this is the first frame in which the object is reported. Predicted vs Measured marks if the report is raw or has been predicted forward in time using the measured dynamics and ego motion.";
CM_ SG_ 413 OBJ_Object_Class_6 "Indicates the object type. Uncertain is outputted in case the probability that a vehicle is a truck is very similar to the probability that it is a car.";
CM_ SG_ 413 OBJ_Class_Probability_6 "The probability of this type classification.";
CM_ SG_ 413 OBJ_Motion_Status_6 "MOVING - the object is moving STATIONARY - the object was never seen moving STOPPED -  the object was moving and has stopped MOVING_SLOWLY - the object is moving very slowly";
CM_ SG_ 413 OBJ_Motion_Orientation_6 "The direction of the targets heading compared to the host.";
CM_ SG_ 413 OBJ_Has_Cut_Lane_6 "Indicates whether the object cut the host's (right or left) lane. In case there are no lanes, indicates whether the objects is at most 1 meters away from the host.";
CM_ SG_ 413 OBJ_Has_Cut_Path_6 "Indicates whether the object is in the host's path.";
CM_ SG_ 413 OBJ_Brake_Light_6 "Indication for brake lights";
CM_ SG_ 413 OBJ_Turn_Indicator_Right_6 "Indication for blinking right light.";
CM_ SG_ 413 OBJ_Turn_Indicator_Left_6 "Indication for blinking left light";
CM_ SG_ 413 OBJ_Light_Indicator_Validity_6 "Validator for light indicators";
CM_ SG_ 413 OBJ_Right_Out_Of_Image_6 "Indicates whether the measurment are predicted out of the right side of the image bounderies.";
CM_ SG_ 413 OBJ_Left_Out_Of_Image_6 "Indicates whether if measurment are predicted out of  the left side of the image bounderies";
CM_ SG_ 413 OBJ_Right_Out_Of_Image_V_6 "validator";
CM_ SG_ 413 OBJ_Left_Out_Of_Image_V_6 "validator";
CM_ SG_ 413 OBJ_Top_Out_Of_Image_6 "Indicates whether if measurment are predicted out of  the top of the image bounderies";
CM_ SG_ 413 OBJ_Bottom_Out_Of_Image_6 "Indicates whether if measurment are predicted out of  the bottom of the image bounderies";
CM_ SG_ 413 OBJ_Top_Out_Of_Image_V_6 "validator";
CM_ SG_ 413 OBJ_Bottom_Out_Of_Image_V_6 "validator";
CM_ SG_ 413 OBJ_Lane_Assignment_6 "The object's lane relative to the host lane.";
CM_ SG_ 413 OBJ_Lane_Assignment_V_6 "Validator for lane assignment";
CM_ SG_ 413 OBJ_Age_Seconds_6 "Time in seconds in which the object was recognized.";
CM_ SG_ 413 OBJ_Age_Seconds_V_6 "Validator for object age";
CM_ SG_ 413 OBJ_Width_6 "The width of the target vehicle in the world (not to be mistaken with the width of the visible part of the vehicle).";
CM_ SG_ 413 OBJ_Width_V_6 "Validator for object width";
CM_ SG_ 413 OBJ_Width_STD_6 "Standard deviation for object width";
CM_ SG_ 413 OBJ_Width_STD_V_6 "Validator for the standard deviation of object width";
CM_ SG_ 413 OBJ_Length_6 "The length of the vehicle in the world. For crossing bicycles it gives the viewed length of the bicycle.";
CM_ SG_ 413 OBJ_Length_V_6 "Validator for object length.";
CM_ SG_ 413 OBJ_Length_STD_6 "Standard deviation for object length.";
CM_ SG_ 413 OBJ_Length_STD_V_6 "Validator for the standard deviation of object length.";
CM_ SG_ 413 OBJ_Height_6 "The height of the object in the world.";
CM_ SG_ 413 OBJ_Height_V_6 "Validator for object height.";
CM_ SG_ 413 OBJ_Height_STD_6 "Standard deviation for object height.";
CM_ SG_ 413 OBJ_Height_STD_V_6 "Validator for the standard deviation of object height.";
CM_ SG_ 413 OBJ_Abs_Long_Velocity_6 "Absolute longitudinal velocity.";
CM_ SG_ 413 OBJ_Abs_Long_Velocity_V_6 "Validator for absolute longitudinal velocity.";
CM_ SG_ 413 OBJ_Abs_Long_Velocity_STD_6 "Standard deviation of absolute longitudinal velocity.";
CM_ SG_ 413 OBJ_Abs_Long_Vel_STD_V_6 "Validator for the standard deviation of the absolute longitudinal velocity.";
CM_ SG_ 413 OBJ_Abs_Lat_Velocity_6 "The lateral ground speed of the object.";
CM_ SG_ 413 OBJ_Abs_Lat_Velocity_V_6 "Validator for the lateral ground speed of the object.";
CM_ SG_ 413 OBJ_Abs_Lat_Velocity_STD_6 "STD of the lateral ground speed of the object.";
CM_ SG_ 413 OBJ_Abs_Lat_Vel_STD_V_6 "Validator for the STD of the lateral ground speed of the object.";
CM_ SG_ 413 OBJ_Abs_Long_Acc_6 "The longitudinal ground acceleration of the object.";
CM_ SG_ 413 OBJ_Abs_Long_Acc_V_6 "Validator for the longitudinal ground acceleration of the object.";
CM_ SG_ 413 OBJ_Abs_Long_Acc_STD_6 "STD of the longitudinal ground acceleration of the object.";
CM_ SG_ 413 OBJ_Abs_Long_Acc_STD_V_6 "Validator for the STD of the longitudinal ground acceleration of the object.";
CM_ SG_ 413 OBJ_Abs_Lat_Acc_6 "The lateral ground acceleration of the object.";
CM_ SG_ 413 OBJ_Abs_Lat_Acc_V_6 "Validator for the lateral ground acceleration of the object.";
CM_ SG_ 413 OBJ_Abs_Lat_Acc_STD_6 "STD of the lateral ground acceleration of the object.";
CM_ SG_ 413 OBJ_Abs_Lat_Acc_STD_V_6 "Validator for the STD of the lateral ground acceleration of the object.";
CM_ SG_ 413 OBJ_Abs_Acceleration_6 "The absolute ground acceleration in the target's heading direction.";
CM_ SG_ 413 OBJ_Abs_Acceleration_V_6 "Validator for the absolute ground acceleration.";
CM_ SG_ 413 OBJ_Abs_Acc_STD_6 "STD of the absolute ground acceleration.";
CM_ SG_ 413 OBJ_Abs_Acc_STD_V_6 "Validator for the STD of the absolute ground acceleration.";
CM_ SG_ 413 OBJ_Inv_TTC_6 "Inverse TTC (time to collision).";
CM_ SG_ 413 OBJ_Inv_TTC_STD_6 "STD for inverse TTC .";
CM_ SG_ 413 OBJ_Inv_TTC_STD_V_6 "Validator for the STD for inverse TTC .";
CM_ SG_ 413 OBJ_Relative_Long_Acc_6 "The relative lateral ground acceleration of the object.";
CM_ SG_ 413 OBJ_Relative_Long_Acc_V_6 "Validator for the relative lateral ground acceleration of the object.";
CM_ SG_ 413 OBJ_Relative_Long_Acc_STD_6 "STD of the relative lateral ground acceleration of the object.";
CM_ SG_ 413 OBJ_Rel_Long_Acc_STD_V_6 "Validator for the STD of the relative lateral ground acceleration.";
CM_ SG_ 413 OBJ_Relative_Long_Velocity_6 "The relative longtitudinal speed between the target and ego vehicle.";
CM_ SG_ 413 OBJ_Relative_Long_Velocity_V_6 "Validator for the relative longtitudinal speed.";
CM_ SG_ 413 OBJ_Relative_Long_Vel_STD_6 "STD of the relative longtitudinal speed.";
CM_ SG_ 413 OBJ_Rel_Long_Vel_STD_V_6 "Validator for the STD of the relative longtitudinal speed.";
CM_ SG_ 414 OBJ_Sync_ID_6_1 "The ID of the Sync message, used to synchronize between signals in the system. Every new frame promotes the sync ID by one.";
CM_ SG_ 414 OBJ_Relative_Lat_Velocity_6 "The relative lateral speed between the target and ego vehicle.";
CM_ SG_ 414 OBJ_Relative_Lat_Velocity_V_6 "Validator for the relative lateral speed.";
CM_ SG_ 414 OBJ_Relative_Lat_Velocity_STD_6 "STD of the relative lateral speed.";
CM_ SG_ 414 OBJ_Rel_Lat_Vel_STD_V_6 "Validator for the STD of the relative lateral speed.";
CM_ SG_ 414 OBJ_Long_Distance_6 "The longtitudinal distance from the object to middle of the rear bumper (middle of the RL and RR corners) of the target.";
CM_ SG_ 414 OBJ_Long_Distance_V_6 "Validator of the longtitudinal distance field";
CM_ SG_ 414 OBJ_Long_Distance_STD_6 "STD of the  longtitudinal distance.";
CM_ SG_ 414 OBJ_Long_Distance_STD_V_6 "Validator for the STD of the  longtitudinal distance.";
CM_ SG_ 414 OBJ_Lat_Distance_6 "Lateral distance to the middle of the RL and RR corners.";
CM_ SG_ 414 OBJ_Lat_Distance_V_6 "Validator for the lateral distance of the object.";
CM_ SG_ 414 OBJ_Lat_Distance_STD_6 "STD of the lateral distance of the object.";
CM_ SG_ 414 OBJ_Lat_Distance_STD_V_6 "Validator for the STD of the lateral distance of the object.";
CM_ SG_ 414 OBJ_Absolute_Speed_6 "The absolute ground speed in the targets' heading direction.";
CM_ SG_ 414 OBJ_Absolute_Speed_V_6 "Validator for the absolute ground speed.";
CM_ SG_ 414 OBJ_Absolute_Speed_STD_6 "STD of the absolute ground speed.";
CM_ SG_ 414 OBJ_Absolute_Speed_STD_V_6 "Validator for the STD of the absolute ground speed.";
CM_ SG_ 414 OBJ_Heading_6 "The angle beetweenthe host longitudinal axis and target's heading (clockwise, e.g. PI/2 is a target crossing from left to right).";
CM_ SG_ 414 OBJ_Heading_V_6 "Validator for the object heading.";
CM_ SG_ 414 OBJ_Heading_STD_6 "STD of the object heading.";
CM_ SG_ 414 OBJ_Heading_STD_V_6 "Validator for the STD of the object heading.";
CM_ SG_ 414 OBJ_Angle_Rate_STD_6 "Standard deviation of the angular speed. (radians)";
CM_ SG_ 414 OBJ_Angle_Rate_STD_V_6 "Validator for the STD of the angular speed.";
CM_ SG_ 414 OBJ_Angle_Rate_6 "The momentary angular speed of the object. (radians)";
CM_ SG_ 414 OBJ_Angle_Rate_V_6 "Validator for the angular speed.";
CM_ SG_ 414 OBJ_Angle_Right_6 "The angle between the host longitudinal axis and the right side of the front / rear of the target (the visible one). The positive side is to the host's right.";
CM_ SG_ 414 OBJ_Angle_Right_V_6 "Validator for angleRight";
CM_ SG_ 414 OBJ_Angle_Right_STD_6 "Standard deviation of angleRight";
CM_ SG_ 414 OBJ_Angle_Right_STD_V_6 "Validator for the standard deviation of angleRight.";
CM_ SG_ 414 OBJ_Angle_Left_6 "The angle between the host longitudinal axis and the left side of the front / rear of the target (the visible one). The positive side is to the host's right.";
CM_ SG_ 414 OBJ_Angle_Left_V_6 "Validator for angleLeft.";
CM_ SG_ 414 OBJ_Angle_Left_STD_6 "Standard deviation of angleLeft.";
CM_ SG_ 414 OBJ_Angle_Left_STD_V_6 "Validator for the standard deviation of angleLeft.";
CM_ SG_ 414 OBJ_Angle_Side_6 "The angle between the host longitudinal axis and the far visible edge - the visible edge of the front / rear of the target that is not visible. Currently supported for vehicles only.";
CM_ SG_ 414 OBJ_Angle_Side_V_6 "Validator for angleSide.";
CM_ SG_ 414 OBJ_Angle_Side_STD_6 "Standard deviation of angleSide.";
CM_ SG_ 414 OBJ_Angle_Side_STD_V_6 "Validator for the STD of angleSide.";
CM_ SG_ 414 OBJ_Angle_Mid_V_6 "Validator for angleMid.";
CM_ SG_ 414 OBJ_Angle_Mid_6 "The angle between the host longitudinal axis and the middle of the front / rear of the target (the visible one). The positive side is to the host's right.";
CM_ SG_ 414 OBJ_Angle_Mid_STD_6 "Standard deviation of angleMid.";
CM_ SG_ 414 OBJ_Angle_Mid_STD_V_6 "Validator for the STD of angleMid.";
CM_ SG_ 414 OBJ_Angle_Bottom_V_6 "Validator for OBJAngle_Bottom.";
CM_ SG_ 414 OBJ_Angle_Bottom_6 "The angle between the longitudinal axis and the Bottom of the front / rear of the target (the visible one). The positive side is to the host's bottom";
CM_ SG_ 414 OBJ_Angle_Bottom_STD_6 "STD for OBJAngle_Bottom.";
CM_ SG_ 414 OBJ_Angle_Bottom_STD_V_6 "Validator for OBJAngle_Bottom_STD.";
CM_ SG_ 414 OBJ_Visibility_Side_V_6 "Currently Supported for VD only";
CM_ SG_ 414 OBJ_Visibility_Side_6 "From what car  side is the object visible";
CM_ SG_ 414 OBJ_Is_In_Drivable_Area_6 "Indicates whether the target is in a driveable area.";
CM_ SG_ 414 OBJ_Is_In_Drivable_Area_V_6 "Validator for OBJ_Is_In_Drivable_Area.";
CM_ SG_ 414 OBJ_Is_VeryClose_V_6 "Validator for OBJ_Is_VeryClose.";
CM_ SG_ 414 OBJ_Is_VeryClose_6 "Indicates whether the target is very close to the host such that it is hard to measure its distance. Currently relevant for peds only";
CM_ SG_ 414 OBJ_Is_EMERGENCY_VCL_6 "Is Object an Emergency Vehicle";
CM_ SG_ 414 OBJ_EMERGENCY_LIGHT_COLOR_6 "Emergency Color";
CM_ SG_ 414 OBJ_EMERGENCY_V_6 "Are OBJ_Is_EMERGENCY_VCL and OBJ_EMERGENCY_LIGHT_COLOR Valid";
CM_ SG_ 415 OBJ_Sync_ID_7_0 "The ID of the Sync message, used to synchronize between signals in the system. Every new frame promotes the sync ID by one.";
CM_ SG_ 415 OBJ_CRC_7 "Calculated over all element signals. From the signal after the CRC until the first signal in the next elements OBJ_CRC_N+1  not including";
CM_ SG_ 415 OBJ_ID_7 "The detected object ID. Range is 1-255, while 0 indicates that the field in unfilled.";
CM_ SG_ 415 OBJ_Existence_Probability_7 "The existence probability of the vehicle";
CM_ SG_ 415 OBJ_Motion_Category_7 "Relevant for VD only. Full description of values can be found at the ACC guide.";
CM_ SG_ 415 OBJ_Object_Age_7 "The number of frames in which the object was recognized.";
CM_ SG_ 415 OBJ_Measuring_Status_7 "Measurment status. Old vs New marks if this is the first frame in which the object is reported. Predicted vs Measured marks if the report is raw or has been predicted forward in time using the measured dynamics and ego motion.";
CM_ SG_ 415 OBJ_Object_Class_7 "Indicates the object type. Uncertain is outputted in case the probability that a vehicle is a truck is very similar to the probability that it is a car.";
CM_ SG_ 415 OBJ_Class_Probability_7 "The probability of this type classification.";
CM_ SG_ 415 OBJ_Motion_Status_7 "MOVING - the object is moving STATIONARY - the object was never seen moving STOPPED -  the object was moving and has stopped MOVING_SLOWLY - the object is moving very slowly";
CM_ SG_ 415 OBJ_Motion_Orientation_7 "The direction of the targets heading compared to the host.";
CM_ SG_ 415 OBJ_Has_Cut_Lane_7 "Indicates whether the object cut the host's (right or left) lane. In case there are no lanes, indicates whether the objects is at most 1 meters away from the host.";
CM_ SG_ 415 OBJ_Has_Cut_Path_7 "Indicates whether the object is in the host's path.";
CM_ SG_ 415 OBJ_Brake_Light_7 "Indication for brake lights";
CM_ SG_ 415 OBJ_Turn_Indicator_Right_7 "Indication for blinking right light.";
CM_ SG_ 415 OBJ_Turn_Indicator_Left_7 "Indication for blinking left light";
CM_ SG_ 415 OBJ_Light_Indicator_Validity_7 "Validator for light indicators";
CM_ SG_ 415 OBJ_Right_Out_Of_Image_7 "Indicates whether the measurment are predicted out of the right side of the image bounderies.";
CM_ SG_ 415 OBJ_Left_Out_Of_Image_7 "Indicates whether if measurment are predicted out of  the left side of the image bounderies";
CM_ SG_ 415 OBJ_Right_Out_Of_Image_V_7 "validator";
CM_ SG_ 415 OBJ_Left_Out_Of_Image_V_7 "validator";
CM_ SG_ 415 OBJ_Top_Out_Of_Image_7 "Indicates whether if measurment are predicted out of  the top of the image bounderies";
CM_ SG_ 415 OBJ_Bottom_Out_Of_Image_7 "Indicates whether if measurment are predicted out of  the bottom of the image bounderies";
CM_ SG_ 415 OBJ_Top_Out_Of_Image_V_7 "validator";
CM_ SG_ 415 OBJ_Bottom_Out_Of_Image_V_7 "validator";
CM_ SG_ 415 OBJ_Lane_Assignment_7 "The object's lane relative to the host lane.";
CM_ SG_ 415 OBJ_Lane_Assignment_V_7 "Validator for lane assignment";
CM_ SG_ 415 OBJ_Age_Seconds_7 "Time in seconds in which the object was recognized.";
CM_ SG_ 415 OBJ_Age_Seconds_V_7 "Validator for object age";
CM_ SG_ 415 OBJ_Width_7 "The width of the target vehicle in the world (not to be mistaken with the width of the visible part of the vehicle).";
CM_ SG_ 415 OBJ_Width_V_7 "Validator for object width";
CM_ SG_ 415 OBJ_Width_STD_7 "Standard deviation for object width";
CM_ SG_ 415 OBJ_Width_STD_V_7 "Validator for the standard deviation of object width";
CM_ SG_ 415 OBJ_Length_7 "The length of the vehicle in the world. For crossing bicycles it gives the viewed length of the bicycle.";
CM_ SG_ 415 OBJ_Length_V_7 "Validator for object length.";
CM_ SG_ 415 OBJ_Length_STD_7 "Standard deviation for object length.";
CM_ SG_ 415 OBJ_Length_STD_V_7 "Validator for the standard deviation of object length.";
CM_ SG_ 415 OBJ_Height_7 "The height of the object in the world.";
CM_ SG_ 415 OBJ_Height_V_7 "Validator for object height.";
CM_ SG_ 415 OBJ_Height_STD_7 "Standard deviation for object height.";
CM_ SG_ 415 OBJ_Height_STD_V_7 "Validator for the standard deviation of object height.";
CM_ SG_ 415 OBJ_Abs_Long_Velocity_7 "Absolute longitudinal velocity.";
CM_ SG_ 415 OBJ_Abs_Long_Velocity_V_7 "Validator for absolute longitudinal velocity.";
CM_ SG_ 415 OBJ_Abs_Long_Velocity_STD_7 "Standard deviation of absolute longitudinal velocity.";
CM_ SG_ 415 OBJ_Abs_Long_Vel_STD_V_7 "Validator for the standard deviation of the absolute longitudinal velocity.";
CM_ SG_ 415 OBJ_Abs_Lat_Velocity_7 "The lateral ground speed of the object.";
CM_ SG_ 415 OBJ_Abs_Lat_Velocity_V_7 "Validator for the lateral ground speed of the object.";
CM_ SG_ 415 OBJ_Abs_Lat_Velocity_STD_7 "STD of the lateral ground speed of the object.";
CM_ SG_ 415 OBJ_Abs_Lat_Vel_STD_V_7 "Validator for the STD of the lateral ground speed of the object.";
CM_ SG_ 415 OBJ_Abs_Long_Acc_7 "The longitudinal ground acceleration of the object.";
CM_ SG_ 415 OBJ_Abs_Long_Acc_V_7 "Validator for the longitudinal ground acceleration of the object.";
CM_ SG_ 415 OBJ_Abs_Long_Acc_STD_7 "STD of the longitudinal ground acceleration of the object.";
CM_ SG_ 415 OBJ_Abs_Long_Acc_STD_V_7 "Validator for the STD of the longitudinal ground acceleration of the object.";
CM_ SG_ 415 OBJ_Abs_Lat_Acc_7 "The lateral ground acceleration of the object.";
CM_ SG_ 415 OBJ_Abs_Lat_Acc_V_7 "Validator for the lateral ground acceleration of the object.";
CM_ SG_ 415 OBJ_Abs_Lat_Acc_STD_7 "STD of the lateral ground acceleration of the object.";
CM_ SG_ 415 OBJ_Abs_Lat_Acc_STD_V_7 "Validator for the STD of the lateral ground acceleration of the object.";
CM_ SG_ 415 OBJ_Abs_Acceleration_7 "The absolute ground acceleration in the target's heading direction.";
CM_ SG_ 415 OBJ_Abs_Acceleration_V_7 "Validator for the absolute ground acceleration.";
CM_ SG_ 415 OBJ_Abs_Acc_STD_7 "STD of the absolute ground acceleration.";
CM_ SG_ 415 OBJ_Abs_Acc_STD_V_7 "Validator for the STD of the absolute ground acceleration.";
CM_ SG_ 415 OBJ_Inv_TTC_7 "Inverse TTC (time to collision).";
CM_ SG_ 415 OBJ_Inv_TTC_STD_7 "STD for inverse TTC .";
CM_ SG_ 415 OBJ_Inv_TTC_STD_V_7 "Validator for the STD for inverse TTC .";
CM_ SG_ 415 OBJ_Relative_Long_Acc_7 "The relative lateral ground acceleration of the object.";
CM_ SG_ 415 OBJ_Relative_Long_Acc_V_7 "Validator for the relative lateral ground acceleration of the object.";
CM_ SG_ 415 OBJ_Relative_Long_Acc_STD_7 "STD of the relative lateral ground acceleration of the object.";
CM_ SG_ 415 OBJ_Rel_Long_Acc_STD_V_7 "Validator for the STD of the relative lateral ground acceleration.";
CM_ SG_ 415 OBJ_Relative_Long_Velocity_7 "The relative longtitudinal speed between the target and ego vehicle.";
CM_ SG_ 415 OBJ_Relative_Long_Velocity_V_7 "Validator for the relative longtitudinal speed.";
CM_ SG_ 415 OBJ_Relative_Long_Vel_STD_7 "STD of the relative longtitudinal speed.";
CM_ SG_ 415 OBJ_Rel_Long_Vel_STD_V_7 "Validator for the STD of the relative longtitudinal speed.";
CM_ SG_ 416 OBJ_Sync_ID_7_1 "The ID of the Sync message, used to synchronize between signals in the system. Every new frame promotes the sync ID by one.";
CM_ SG_ 416 OBJ_Relative_Lat_Velocity_7 "The relative lateral speed between the target and ego vehicle.";
CM_ SG_ 416 OBJ_Relative_Lat_Velocity_V_7 "Validator for the relative lateral speed.";
CM_ SG_ 416 OBJ_Relative_Lat_Velocity_STD_7 "STD of the relative lateral speed.";
CM_ SG_ 416 OBJ_Rel_Lat_Vel_STD_V_7 "Validator for the STD of the relative lateral speed.";
CM_ SG_ 416 OBJ_Long_Distance_7 "The longtitudinal distance from the object to middle of the rear bumper (middle of the RL and RR corners) of the target.";
CM_ SG_ 416 OBJ_Long_Distance_V_7 "Validator of the longtitudinal distance field";
CM_ SG_ 416 OBJ_Long_Distance_STD_7 "STD of the  longtitudinal distance.";
CM_ SG_ 416 OBJ_Long_Distance_STD_V_7 "Validator for the STD of the  longtitudinal distance.";
CM_ SG_ 416 OBJ_Lat_Distance_7 "Lateral distance to the middle of the RL and RR corners.";
CM_ SG_ 416 OBJ_Lat_Distance_V_7 "Validator for the lateral distance of the object.";
CM_ SG_ 416 OBJ_Lat_Distance_STD_7 "STD of the lateral distance of the object.";
CM_ SG_ 416 OBJ_Lat_Distance_STD_V_7 "Validator for the STD of the lateral distance of the object.";
CM_ SG_ 416 OBJ_Absolute_Speed_7 "The absolute ground speed in the targets' heading direction.";
CM_ SG_ 416 OBJ_Absolute_Speed_V_7 "Validator for the absolute ground speed.";
CM_ SG_ 416 OBJ_Absolute_Speed_STD_7 "STD of the absolute ground speed.";
CM_ SG_ 416 OBJ_Absolute_Speed_STD_V_7 "Validator for the STD of the absolute ground speed.";
CM_ SG_ 416 OBJ_Heading_7 "The angle beetweenthe host longitudinal axis and target's heading (clockwise, e.g. PI/2 is a target crossing from left to right).";
CM_ SG_ 416 OBJ_Heading_V_7 "Validator for the object heading.";
CM_ SG_ 416 OBJ_Heading_STD_7 "STD of the object heading.";
CM_ SG_ 416 OBJ_Heading_STD_V_7 "Validator for the STD of the object heading.";
CM_ SG_ 416 OBJ_Angle_Rate_STD_7 "Standard deviation of the angular speed. (radians)";
CM_ SG_ 416 OBJ_Angle_Rate_STD_V_7 "Validator for the STD of the angular speed.";
CM_ SG_ 416 OBJ_Angle_Rate_7 "The momentary angular speed of the object. (radians)";
CM_ SG_ 416 OBJ_Angle_Rate_V_7 "Validator for the angular speed.";
CM_ SG_ 416 OBJ_Angle_Right_7 "The angle between the host longitudinal axis and the right side of the front / rear of the target (the visible one). The positive side is to the host's right.";
CM_ SG_ 416 OBJ_Angle_Right_V_7 "Validator for angleRight";
CM_ SG_ 416 OBJ_Angle_Right_STD_7 "Standard deviation of angleRight";
CM_ SG_ 416 OBJ_Angle_Right_STD_V_7 "Validator for the standard deviation of angleRight.";
CM_ SG_ 416 OBJ_Angle_Left_7 "The angle between the host longitudinal axis and the left side of the front / rear of the target (the visible one). The positive side is to the host's right.";
CM_ SG_ 416 OBJ_Angle_Left_V_7 "Validator for angleLeft.";
CM_ SG_ 416 OBJ_Angle_Left_STD_7 "Standard deviation of angleLeft.";
CM_ SG_ 416 OBJ_Angle_Left_STD_V_7 "Validator for the standard deviation of angleLeft.";
CM_ SG_ 416 OBJ_Angle_Side_7 "The angle between the host longitudinal axis and the far visible edge - the visible edge of the front / rear of the target that is not visible. Currently supported for vehicles only.";
CM_ SG_ 416 OBJ_Angle_Side_V_7 "Validator for angleSide.";
CM_ SG_ 416 OBJ_Angle_Side_STD_7 "Standard deviation of angleSide.";
CM_ SG_ 416 OBJ_Angle_Side_STD_V_7 "Validator for the STD of angleSide.";
CM_ SG_ 416 OBJ_Angle_Mid_V_7 "Validator for angleMid.";
CM_ SG_ 416 OBJ_Angle_Mid_7 "The angle between the host longitudinal axis and the middle of the front / rear of the target (the visible one). The positive side is to the host's right.";
CM_ SG_ 416 OBJ_Angle_Mid_STD_7 "Standard deviation of angleMid.";
CM_ SG_ 416 OBJ_Angle_Mid_STD_V_7 "Validator for the STD of angleMid.";
CM_ SG_ 416 OBJ_Angle_Bottom_V_7 "Validator for OBJAngle_Bottom.";
CM_ SG_ 416 OBJ_Angle_Bottom_7 "The angle between the longitudinal axis and the Bottom of the front / rear of the target (the visible one). The positive side is to the host's bottom";
CM_ SG_ 416 OBJ_Angle_Bottom_STD_7 "STD for OBJAngle_Bottom.";
CM_ SG_ 416 OBJ_Angle_Bottom_STD_V_7 "Validator for OBJAngle_Bottom_STD.";
CM_ SG_ 416 OBJ_Visibility_Side_V_7 "Currently Supported for VD only";
CM_ SG_ 416 OBJ_Visibility_Side_7 "From what car  side is the object visible";
CM_ SG_ 416 OBJ_Is_In_Drivable_Area_7 "Indicates whether the target is in a driveable area.";
CM_ SG_ 416 OBJ_Is_In_Drivable_Area_V_7 "Validator for OBJ_Is_In_Drivable_Area.";
CM_ SG_ 416 OBJ_Is_VeryClose_V_7 "Validator for OBJ_Is_VeryClose.";
CM_ SG_ 416 OBJ_Is_VeryClose_7 "Indicates whether the target is very close to the host such that it is hard to measure its distance. Currently relevant for peds only";
CM_ SG_ 416 OBJ_Is_EMERGENCY_VCL_7 "Is Object an Emergency Vehicle";
CM_ SG_ 416 OBJ_EMERGENCY_LIGHT_COLOR_7 "Emergency Color";
CM_ SG_ 416 OBJ_EMERGENCY_V_7 "Are OBJ_Is_EMERGENCY_VCL and OBJ_EMERGENCY_LIGHT_COLOR Valid";
CM_ SG_ 417 OBJ_Sync_ID_8_0 "The ID of the Sync message, used to synchronize between signals in the system. Every new frame promotes the sync ID by one.";
CM_ SG_ 417 OBJ_CRC_8 "Calculated over all element signals. From the signal after the CRC until the first signal in the next elements OBJ_CRC_N+1  not including";
CM_ SG_ 417 OBJ_ID_8 "The detected object ID. Range is 1-255, while 0 indicates that the field in unfilled.";
CM_ SG_ 417 OBJ_Existence_Probability_8 "The existence probability of the vehicle";
CM_ SG_ 417 OBJ_Motion_Category_8 "Relevant for VD only. Full description of values can be found at the ACC guide.";
CM_ SG_ 417 OBJ_Object_Age_8 "The number of frames in which the object was recognized.";
CM_ SG_ 417 OBJ_Measuring_Status_8 "Measurment status. Old vs New marks if this is the first frame in which the object is reported. Predicted vs Measured marks if the report is raw or has been predicted forward in time using the measured dynamics and ego motion.";
CM_ SG_ 417 OBJ_Object_Class_8 "Indicates the object type. Uncertain is outputted in case the probability that a vehicle is a truck is very similar to the probability that it is a car.";
CM_ SG_ 417 OBJ_Class_Probability_8 "The probability of this type classification.";
CM_ SG_ 417 OBJ_Motion_Status_8 "MOVING - the object is moving STATIONARY - the object was never seen moving STOPPED -  the object was moving and has stopped MOVING_SLOWLY - the object is moving very slowly";
CM_ SG_ 417 OBJ_Motion_Orientation_8 "The direction of the targets heading compared to the host.";
CM_ SG_ 417 OBJ_Has_Cut_Lane_8 "Indicates whether the object cut the host's (right or left) lane. In case there are no lanes, indicates whether the objects is at most 1 meters away from the host.";
CM_ SG_ 417 OBJ_Has_Cut_Path_8 "Indicates whether the object is in the host's path.";
CM_ SG_ 417 OBJ_Brake_Light_8 "Indication for brake lights";
CM_ SG_ 417 OBJ_Turn_Indicator_Right_8 "Indication for blinking right light.";
CM_ SG_ 417 OBJ_Turn_Indicator_Left_8 "Indication for blinking left light";
CM_ SG_ 417 OBJ_Light_Indicator_Validity_8 "Validator for light indicators";
CM_ SG_ 417 OBJ_Right_Out_Of_Image_8 "Indicates whether the measurment are predicted out of the right side of the image bounderies.";
CM_ SG_ 417 OBJ_Left_Out_Of_Image_8 "Indicates whether if measurment are predicted out of  the left side of the image bounderies";
CM_ SG_ 417 OBJ_Right_Out_Of_Image_V_8 "validator";
CM_ SG_ 417 OBJ_Left_Out_Of_Image_V_8 "validator";
CM_ SG_ 417 OBJ_Top_Out_Of_Image_8 "Indicates whether if measurment are predicted out of  the top of the image bounderies";
CM_ SG_ 417 OBJ_Bottom_Out_Of_Image_8 "Indicates whether if measurment are predicted out of  the bottom of the image bounderies";
CM_ SG_ 417 OBJ_Top_Out_Of_Image_V_8 "validator";
CM_ SG_ 417 OBJ_Bottom_Out_Of_Image_V_8 "validator";
CM_ SG_ 417 OBJ_Lane_Assignment_8 "The object's lane relative to the host lane.";
CM_ SG_ 417 OBJ_Lane_Assignment_V_8 "Validator for lane assignment";
CM_ SG_ 417 OBJ_Age_Seconds_8 "Time in seconds in which the object was recognized.";
CM_ SG_ 417 OBJ_Age_Seconds_V_8 "Validator for object age";
CM_ SG_ 417 OBJ_Width_8 "The width of the target vehicle in the world (not to be mistaken with the width of the visible part of the vehicle).";
CM_ SG_ 417 OBJ_Width_V_8 "Validator for object width";
CM_ SG_ 417 OBJ_Width_STD_8 "Standard deviation for object width";
CM_ SG_ 417 OBJ_Width_STD_V_8 "Validator for the standard deviation of object width";
CM_ SG_ 417 OBJ_Length_8 "The length of the vehicle in the world. For crossing bicycles it gives the viewed length of the bicycle.";
CM_ SG_ 417 OBJ_Length_V_8 "Validator for object length.";
CM_ SG_ 417 OBJ_Length_STD_8 "Standard deviation for object length.";
CM_ SG_ 417 OBJ_Length_STD_V_8 "Validator for the standard deviation of object length.";
CM_ SG_ 417 OBJ_Height_8 "The height of the object in the world.";
CM_ SG_ 417 OBJ_Height_V_8 "Validator for object height.";
CM_ SG_ 417 OBJ_Height_STD_8 "Standard deviation for object height.";
CM_ SG_ 417 OBJ_Height_STD_V_8 "Validator for the standard deviation of object height.";
CM_ SG_ 417 OBJ_Abs_Long_Velocity_8 "Absolute longitudinal velocity.";
CM_ SG_ 417 OBJ_Abs_Long_Velocity_V_8 "Validator for absolute longitudinal velocity.";
CM_ SG_ 417 OBJ_Abs_Long_Velocity_STD_8 "Standard deviation of absolute longitudinal velocity.";
CM_ SG_ 417 OBJ_Abs_Long_Vel_STD_V_8 "Validator for the standard deviation of the absolute longitudinal velocity.";
CM_ SG_ 417 OBJ_Abs_Lat_Velocity_8 "The lateral ground speed of the object.";
CM_ SG_ 417 OBJ_Abs_Lat_Velocity_V_8 "Validator for the lateral ground speed of the object.";
CM_ SG_ 417 OBJ_Abs_Lat_Velocity_STD_8 "STD of the lateral ground speed of the object.";
CM_ SG_ 417 OBJ_Abs_Lat_Vel_STD_V_8 "Validator for the STD of the lateral ground speed of the object.";
CM_ SG_ 417 OBJ_Abs_Long_Acc_8 "The longitudinal ground acceleration of the object.";
CM_ SG_ 417 OBJ_Abs_Long_Acc_V_8 "Validator for the longitudinal ground acceleration of the object.";
CM_ SG_ 417 OBJ_Abs_Long_Acc_STD_8 "STD of the longitudinal ground acceleration of the object.";
CM_ SG_ 417 OBJ_Abs_Long_Acc_STD_V_8 "Validator for the STD of the longitudinal ground acceleration of the object.";
CM_ SG_ 417 OBJ_Abs_Lat_Acc_8 "The lateral ground acceleration of the object.";
CM_ SG_ 417 OBJ_Abs_Lat_Acc_V_8 "Validator for the lateral ground acceleration of the object.";
CM_ SG_ 417 OBJ_Abs_Lat_Acc_STD_8 "STD of the lateral ground acceleration of the object.";
CM_ SG_ 417 OBJ_Abs_Lat_Acc_STD_V_8 "Validator for the STD of the lateral ground acceleration of the object.";
CM_ SG_ 417 OBJ_Abs_Acceleration_8 "The absolute ground acceleration in the target's heading direction.";
CM_ SG_ 417 OBJ_Abs_Acceleration_V_8 "Validator for the absolute ground acceleration.";
CM_ SG_ 417 OBJ_Abs_Acc_STD_8 "STD of the absolute ground acceleration.";
CM_ SG_ 417 OBJ_Abs_Acc_STD_V_8 "Validator for the STD of the absolute ground acceleration.";
CM_ SG_ 417 OBJ_Inv_TTC_8 "Inverse TTC (time to collision).";
CM_ SG_ 417 OBJ_Inv_TTC_STD_8 "STD for inverse TTC .";
CM_ SG_ 417 OBJ_Inv_TTC_STD_V_8 "Validator for the STD for inverse TTC .";
CM_ SG_ 417 OBJ_Relative_Long_Acc_8 "The relative lateral ground acceleration of the object.";
CM_ SG_ 417 OBJ_Relative_Long_Acc_V_8 "Validator for the relative lateral ground acceleration of the object.";
CM_ SG_ 417 OBJ_Relative_Long_Acc_STD_8 "STD of the relative lateral ground acceleration of the object.";
CM_ SG_ 417 OBJ_Rel_Long_Acc_STD_V_8 "Validator for the STD of the relative lateral ground acceleration.";
CM_ SG_ 417 OBJ_Relative_Long_Velocity_8 "The relative longtitudinal speed between the target and ego vehicle.";
CM_ SG_ 417 OBJ_Relative_Long_Velocity_V_8 "Validator for the relative longtitudinal speed.";
CM_ SG_ 417 OBJ_Relative_Long_Vel_STD_8 "STD of the relative longtitudinal speed.";
CM_ SG_ 417 OBJ_Rel_Long_Vel_STD_V_8 "Validator for the STD of the relative longtitudinal speed.";
CM_ SG_ 418 OBJ_Sync_ID_8_1 "The ID of the Sync message, used to synchronize between signals in the system. Every new frame promotes the sync ID by one.";
CM_ SG_ 418 OBJ_Relative_Lat_Velocity_8 "The relative lateral speed between the target and ego vehicle.";
CM_ SG_ 418 OBJ_Relative_Lat_Velocity_V_8 "Validator for the relative lateral speed.";
CM_ SG_ 418 OBJ_Relative_Lat_Velocity_STD_8 "STD of the relative lateral speed.";
CM_ SG_ 418 OBJ_Rel_Lat_Vel_STD_V_8 "Validator for the STD of the relative lateral speed.";
CM_ SG_ 418 OBJ_Long_Distance_8 "The longtitudinal distance from the object to middle of the rear bumper (middle of the RL and RR corners) of the target.";
CM_ SG_ 418 OBJ_Long_Distance_V_8 "Validator of the longtitudinal distance field";
CM_ SG_ 418 OBJ_Long_Distance_STD_8 "STD of the  longtitudinal distance.";
CM_ SG_ 418 OBJ_Long_Distance_STD_V_8 "Validator for the STD of the  longtitudinal distance.";
CM_ SG_ 418 OBJ_Lat_Distance_8 "Lateral distance to the middle of the RL and RR corners.";
CM_ SG_ 418 OBJ_Lat_Distance_V_8 "Validator for the lateral distance of the object.";
CM_ SG_ 418 OBJ_Lat_Distance_STD_8 "STD of the lateral distance of the object.";
CM_ SG_ 418 OBJ_Lat_Distance_STD_V_8 "Validator for the STD of the lateral distance of the object.";
CM_ SG_ 418 OBJ_Absolute_Speed_8 "The absolute ground speed in the targets' heading direction.";
CM_ SG_ 418 OBJ_Absolute_Speed_V_8 "Validator for the absolute ground speed.";
CM_ SG_ 418 OBJ_Absolute_Speed_STD_8 "STD of the absolute ground speed.";
CM_ SG_ 418 OBJ_Absolute_Speed_STD_V_8 "Validator for the STD of the absolute ground speed.";
CM_ SG_ 418 OBJ_Heading_8 "The angle beetweenthe host longitudinal axis and target's heading (clockwise, e.g. PI/2 is a target crossing from left to right).";
CM_ SG_ 418 OBJ_Heading_V_8 "Validator for the object heading.";
CM_ SG_ 418 OBJ_Heading_STD_8 "STD of the object heading.";
CM_ SG_ 418 OBJ_Heading_STD_V_8 "Validator for the STD of the object heading.";
CM_ SG_ 418 OBJ_Angle_Rate_STD_8 "Standard deviation of the angular speed. (radians)";
CM_ SG_ 418 OBJ_Angle_Rate_STD_V_8 "Validator for the STD of the angular speed.";
CM_ SG_ 418 OBJ_Angle_Rate_8 "The momentary angular speed of the object. (radians)";
CM_ SG_ 418 OBJ_Angle_Rate_V_8 "Validator for the angular speed.";
CM_ SG_ 418 OBJ_Angle_Right_8 "The angle between the host longitudinal axis and the right side of the front / rear of the target (the visible one). The positive side is to the host's right.";
CM_ SG_ 418 OBJ_Angle_Right_V_8 "Validator for angleRight";
CM_ SG_ 418 OBJ_Angle_Right_STD_8 "Standard deviation of angleRight";
CM_ SG_ 418 OBJ_Angle_Right_STD_V_8 "Validator for the standard deviation of angleRight.";
CM_ SG_ 418 OBJ_Angle_Left_8 "The angle between the host longitudinal axis and the left side of the front / rear of the target (the visible one). The positive side is to the host's right.";
CM_ SG_ 418 OBJ_Angle_Left_V_8 "Validator for angleLeft.";
CM_ SG_ 418 OBJ_Angle_Left_STD_8 "Standard deviation of angleLeft.";
CM_ SG_ 418 OBJ_Angle_Left_STD_V_8 "Validator for the standard deviation of angleLeft.";
CM_ SG_ 418 OBJ_Angle_Side_8 "The angle between the host longitudinal axis and the far visible edge - the visible edge of the front / rear of the target that is not visible. Currently supported for vehicles only.";
CM_ SG_ 418 OBJ_Angle_Side_V_8 "Validator for angleSide.";
CM_ SG_ 418 OBJ_Angle_Side_STD_8 "Standard deviation of angleSide.";
CM_ SG_ 418 OBJ_Angle_Side_STD_V_8 "Validator for the STD of angleSide.";
CM_ SG_ 418 OBJ_Angle_Mid_V_8 "Validator for angleMid.";
CM_ SG_ 418 OBJ_Angle_Mid_8 "The angle between the host longitudinal axis and the middle of the front / rear of the target (the visible one). The positive side is to the host's right.";
CM_ SG_ 418 OBJ_Angle_Mid_STD_8 "Standard deviation of angleMid.";
CM_ SG_ 418 OBJ_Angle_Mid_STD_V_8 "Validator for the STD of angleMid.";
CM_ SG_ 418 OBJ_Angle_Bottom_V_8 "Validator for OBJAngle_Bottom.";
CM_ SG_ 418 OBJ_Angle_Bottom_8 "The angle between the longitudinal axis and the Bottom of the front / rear of the target (the visible one). The positive side is to the host's bottom";
CM_ SG_ 418 OBJ_Angle_Bottom_STD_8 "STD for OBJAngle_Bottom.";
CM_ SG_ 418 OBJ_Angle_Bottom_STD_V_8 "Validator for OBJAngle_Bottom_STD.";
CM_ SG_ 418 OBJ_Visibility_Side_V_8 "Currently Supported for VD only";
CM_ SG_ 418 OBJ_Visibility_Side_8 "From what car  side is the object visible";
CM_ SG_ 418 OBJ_Is_In_Drivable_Area_8 "Indicates whether the target is in a driveable area.";
CM_ SG_ 418 OBJ_Is_In_Drivable_Area_V_8 "Validator for OBJ_Is_In_Drivable_Area.";
CM_ SG_ 418 OBJ_Is_VeryClose_V_8 "Validator for OBJ_Is_VeryClose.";
CM_ SG_ 418 OBJ_Is_VeryClose_8 "Indicates whether the target is very close to the host such that it is hard to measure its distance. Currently relevant for peds only";
CM_ SG_ 418 OBJ_Is_EMERGENCY_VCL_8 "Is Object an Emergency Vehicle";
CM_ SG_ 418 OBJ_EMERGENCY_LIGHT_COLOR_8 "Emergency Color";
CM_ SG_ 418 OBJ_EMERGENCY_V_8 "Are OBJ_Is_EMERGENCY_VCL and OBJ_EMERGENCY_LIGHT_COLOR Valid";
BA_DEF_ SG_  "GenSigSendType" ENUM  "Cyclic","OnChange","OnWrite","IfActive","OnChangeWithRepetition","OnWriteWithRepetition","IfActiveWithRepetition","CA","CE","Event","NoSigSendType";
BA_DEF_ SG_  "GenSigStartValue" INT 0 0;
BA_DEF_ BO_  "VFrameFormat" ENUM  "StandardCAN","ExtendedCAN","reserved","J1939PG","reserved","reserved","reserved","reserved","reserved","reserved","reserved","reserved","reserved","reserved","StandardCAN_FD","ExtendedCAN_FD";
BA_DEF_ BO_  "FunReqGroup" INT 0 250;
BA_DEF_ BO_  "Receivers" STRING ;
BA_DEF_ BO_  "Transmitters" STRING ;
BA_DEF_ BO_  "DiagReqFun" ENUM  "NO","YES";
BA_DEF_ BO_  "DiagReqPhy" ENUM  "NO","YES";
BA_DEF_ BO_  "DiagResp" ENUM  "NO","YES";
BA_DEF_ BO_  "GenMsgTimeoutValue" INT 0 65535;
BA_DEF_ BO_  "GenMsgSendType" ENUM  "Cyclic","NoMsgSendType","IfActive","Event","CA","CE";
BA_DEF_ BO_  "GenMsgCycleTime" INT 0 10000;
BA_DEF_ BO_  "CANFD_BRS" ENUM  "0","1";
BA_DEF_ BO_  "GenMsgILSupport" ENUM  "No","Yes";
BA_DEF_DEF_  "GenSigSendType" "Cyclic";
BA_DEF_DEF_  "GenSigStartValue" 0;
BA_DEF_DEF_  "VFrameFormat" "ExtendedCAN";
BA_DEF_DEF_  "FunReqGroup" 0;
BA_DEF_DEF_  "Receivers" "Default";
BA_DEF_DEF_  "Transmitters" "Default";
BA_DEF_DEF_  "DiagReqFun" "NO";
BA_DEF_DEF_  "DiagReqPhy" "NO";
BA_DEF_DEF_  "DiagResp" "NO";
BA_DEF_DEF_  "GenMsgTimeoutValue" 200;
BA_DEF_DEF_  "GenMsgSendType" "Cyclic";
BA_DEF_DEF_  "GenMsgCycleTime" 50;
BA_DEF_DEF_  "CANFD_BRS" "1";
BA_DEF_DEF_  "GenMsgILSupport" "Yes";
BA_ "VFrameFormat" BO_ 406 14;
BA_ "VFrameFormat" BO_ 407 14;
BA_ "VFrameFormat" BO_ 408 14;
BA_ "VFrameFormat" BO_ 409 14;
BA_ "VFrameFormat" BO_ 410 14;
BA_ "VFrameFormat" BO_ 411 14;
BA_ "VFrameFormat" BO_ 412 14;
BA_ "VFrameFormat" BO_ 413 14;
BA_ "VFrameFormat" BO_ 414 14;
BA_ "VFrameFormat" BO_ 415 14;
BA_ "VFrameFormat" BO_ 416 14;
BA_ "VFrameFormat" BO_ 417 14;
BA_ "VFrameFormat" BO_ 418 14;
VAL_ 406 OBJ_Relative_Lat_Velocity_V_2 1 "VALID" 0 "INVALID" ;
VAL_ 406 OBJ_Rel_Lat_Vel_STD_V_2 1 "VALID" 0 "INVALID" ;
VAL_ 406 OBJ_Long_Distance_V_2 1 "VALID" 0 "INVALID" ;
VAL_ 406 OBJ_Long_Distance_STD_V_2 1 "VALID" 0 "INVALID" ;
VAL_ 406 OBJ_Lat_Distance_V_2 1 "VALID" 0 "INVALID" ;
VAL_ 406 OBJ_Lat_Distance_STD_V_2 1 "VALID" 0 "INVALID" ;
VAL_ 406 OBJ_Absolute_Speed_V_2 1 "VALID" 0 "INVALID" ;
VAL_ 406 OBJ_Absolute_Speed_STD_V_2 1 "VALID" 0 "INVALID" ;
VAL_ 406 OBJ_Heading_V_2 1 "VALID" 0 "INVALID" ;
VAL_ 406 OBJ_Heading_STD_V_2 1 "VALID" 0 "INVALID" ;
VAL_ 406 OBJ_Angle_Rate_STD_V_2 1 "VALID" 0 "INVALID" ;
VAL_ 406 OBJ_Angle_Rate_V_2 1 "VALID" 0 "INVALID" ;
VAL_ 406 OBJ_Angle_Right_V_2 1 "VALID" 0 "INVALID" ;
VAL_ 406 OBJ_Angle_Right_STD_V_2 1 "VALID" 0 "INVALID" ;
VAL_ 406 OBJ_Angle_Left_V_2 1 "VALID" 0 "INVALID" ;
VAL_ 406 OBJ_Angle_Left_STD_V_2 1 "VALID" 0 "INVALID" ;
VAL_ 406 OBJ_Angle_Side_V_2 1 "VALID" 0 "INVALID" ;
VAL_ 406 OBJ_Angle_Side_STD_V_2 1 "VALID" 0 "INVALID" ;
VAL_ 406 OBJ_Angle_Mid_V_2 1 "VALID" 0 "INVALID" ;
VAL_ 406 OBJ_Angle_Mid_STD_V_2 1 "VALID" 0 "INVALID" ;
VAL_ 406 OBJ_Angle_Bottom_V_2 1 "VALID" 0 "INVALID" ;
VAL_ 406 OBJ_Angle_Bottom_STD_V_2 1 "VALID" 0 "INVALID" ;
VAL_ 406 OBJ_Visibility_Side_V_2 1 "VALID" 0 "INVALID" ;
VAL_ 406 OBJ_Visibility_Side_2 2 "REAR" 1 "FRONT" 0 "NOT_VISIBLE" ;
VAL_ 406 OBJ_Is_In_Drivable_Area_2 1 "TRUE" 0 "FALSE" ;
VAL_ 406 OBJ_Is_In_Drivable_Area_V_2 1 "VALID" 0 "INVALID" ;
VAL_ 406 OBJ_Is_VeryClose_V_2 1 "VALID" 0 "INVALID" ;
VAL_ 406 OBJ_Is_VeryClose_2 1 "TRUE" 0 "FALSE" ;
VAL_ 406 OBJ_Is_EMERGENCY_VCL_2 1 "TRUE" 0 "FALSE" ;
VAL_ 406 OBJ_EMERGENCY_LIGHT_COLOR_2 3 "(1000)ORANGE" 2 "(0100)BLUE" 1 "(0010)RED" 0 "(0001)OTHER" ;
VAL_ 406 OBJ_EMERGENCY_V_2 1 "TRUE" 0 "FALSE" ;
VAL_ 407 OBJ_Motion_Category_3 13 "ONCOMING" 12 "PRECEEDING" 11 "MOVING" 10 "RTAP" 9 "LTAP" 8 "CROSSING" 7 "MOVING_OUT" 6 "MOVING_IN" 5 "CLOSE_CUT_IN" 4 "PASSING_OUT" 3 "PASSING_IN" 2 "PASSING" 1 "UNDEFINED" 0 "UNFILLED" ;
VAL_ 407 OBJ_Measuring_Status_3 2 "(BIT_2)NOT_VALID_OR_VALID" 1 "(BIT_1)PREDICTED_OR_MEASURED" 0 "(BIT_0)OLD_OR_NEW" ;
VAL_ 407 OBJ_Object_Class_3 8 "UNCERTAIN_VCL" 7 "ANIMAL" 6 "GENERAL_OBJECT" 5 "PEDESTRIAN" 4 "BICYCLE" 3 "MOTORBIKE" 2 "TRUCK" 1 "CAR" 0 "UNFILLED" ;
VAL_ 407 OBJ_Motion_Status_3 5 "MOVING_SLOWLY" 4 "STOPPED" 3 "STATIONARY" 2 "MOVING" 1 "UNKNOWN" 0 "INVALID" ;
VAL_ 407 OBJ_Motion_Orientation_3 13 "INVALID" 12 "NORTH" 11 "NORTH_WEST" 9 "WEST" 7 "SOUTH_WEST" 6 "SOUTH" 5 "SOUTH_EAST" 3 "EAST" 1 "NORTH_EAST" 0 "UNKNOWN" ;
VAL_ 407 OBJ_Has_Cut_Lane_3 1 "TRUE" 0 "FALSE" ;
VAL_ 407 OBJ_Has_Cut_Path_3 1 "TRUE" 0 "FALSE" ;
VAL_ 407 OBJ_Brake_Light_3 1 "TRUE" 0 "FALSE" ;
VAL_ 407 OBJ_Turn_Indicator_Right_3 1 "TRUE" 0 "FALSE" ;
VAL_ 407 OBJ_Turn_Indicator_Left_3 1 "TRUE" 0 "FALSE" ;
VAL_ 407 OBJ_Light_Indicator_Validity_3 1 "TRUE" 0 "FALSE" ;
VAL_ 407 OBJ_Right_Out_Of_Image_3 1 "TRUE" 0 "FALSE" ;
VAL_ 407 OBJ_Left_Out_Of_Image_3 1 "TRUE" 0 "FALSE" ;
VAL_ 407 OBJ_Right_Out_Of_Image_V_3 1 "TRUE" 0 "FALSE" ;
VAL_ 407 OBJ_Left_Out_Of_Image_V_3 1 "TRUE" 0 "FALSE" ;
VAL_ 407 OBJ_Top_Out_Of_Image_3 1 "TRUE" 0 "FALSE" ;
VAL_ 407 OBJ_Bottom_Out_Of_Image_3 1 "TRUE" 0 "FALSE" ;
VAL_ 407 OBJ_Top_Out_Of_Image_V_3 1 "VALID" 0 "INVALID" ;
VAL_ 407 OBJ_Bottom_Out_Of_Image_V_3 1 "VALID" 0 "INVALID" ;
VAL_ 407 OBJ_Lane_Assignment_3 5 "RIGHT_RIGHT" 4 "RIGHT" 3 "HOST" 2 "LEFT" 1 "LEFT_LEFT" 0 "UNKNOWN" ;
VAL_ 407 OBJ_Lane_Assignment_V_3 1 "VALID" 0 "INVALID" ;
VAL_ 407 OBJ_Age_Seconds_V_3 1 "VALID" 0 "INVALID" ;
VAL_ 407 OBJ_Width_V_3 1 "VALID" 0 "INVALID" ;
VAL_ 407 OBJ_Width_STD_V_3 1 "VALID" 0 "INVALID" ;
VAL_ 407 OBJ_Length_V_3 1 "VALID" 0 "INVALID" ;
VAL_ 407 OBJ_Length_STD_V_3 1 "VALID" 0 "INVALID" ;
VAL_ 407 OBJ_Height_V_3 1 "VALID" 0 "INVALID" ;
VAL_ 407 OBJ_Height_STD_V_3 1 "VALID" 0 "INVALID" ;
VAL_ 407 OBJ_Abs_Long_Velocity_V_3 1 "VALID" 0 "INVALID" ;
VAL_ 407 OBJ_Abs_Long_Vel_STD_V_3 1 "VALID" 0 "INVALID" ;
VAL_ 407 OBJ_Abs_Lat_Velocity_V_3 1 "VALID" 0 "INVALID" ;
VAL_ 407 OBJ_Abs_Lat_Vel_STD_V_3 1 "VALID" 0 "INVALID" ;
VAL_ 407 OBJ_Abs_Long_Acc_V_3 1 "VALID" 0 "INVALID" ;
VAL_ 407 OBJ_Abs_Long_Acc_STD_V_3 1 "VALID" 0 "INVALID" ;
VAL_ 407 OBJ_Abs_Lat_Acc_V_3 1 "VALID" 0 "INVALID" ;
VAL_ 407 OBJ_Abs_Lat_Acc_STD_V_3 1 "VALID" 0 "INVALID" ;
VAL_ 407 OBJ_Abs_Acceleration_V_3 1 "VALID" 0 "INVALID" ;
VAL_ 407 OBJ_Abs_Acc_STD_V_3 1 "VALID" 0 "INVALID" ;
VAL_ 407 OBJ_Inv_TTC_V_3 1 "VALID" 0 "INVALID" ;
VAL_ 407 OBJ_Inv_TTC_STD_V_3 1 "VALID" 0 "INVALID" ;
VAL_ 407 OBJ_Relative_Long_Acc_V_3 1 "VALID" 0 "INVALID" ;
VAL_ 407 OBJ_Rel_Long_Acc_STD_V_3 1 "VALID" 0 "INVALID" ;
VAL_ 407 OBJ_Relative_Long_Velocity_V_3 1 "VALID" 0 "INVALID" ;
VAL_ 407 OBJ_Rel_Long_Vel_STD_V_3 1 "VALID" 0 "INVALID" ;
VAL_ 408 OBJ_Relative_Lat_Velocity_V_3 1 "VALID" 0 "INVALID" ;
VAL_ 408 OBJ_Rel_Lat_Vel_STD_V_3 1 "VALID" 0 "INVALID" ;
VAL_ 408 OBJ_Long_Distance_V_3 1 "VALID" 0 "INVALID" ;
VAL_ 408 OBJ_Long_Distance_STD_V_3 1 "VALID" 0 "INVALID" ;
VAL_ 408 OBJ_Lat_Distance_V_3 1 "VALID" 0 "INVALID" ;
VAL_ 408 OBJ_Lat_Distance_STD_V_3 1 "VALID" 0 "INVALID" ;
VAL_ 408 OBJ_Absolute_Speed_V_3 1 "VALID" 0 "INVALID" ;
VAL_ 408 OBJ_Absolute_Speed_STD_V_3 1 "VALID" 0 "INVALID" ;
VAL_ 408 OBJ_Heading_V_3 1 "VALID" 0 "INVALID" ;
VAL_ 408 OBJ_Heading_STD_V_3 1 "VALID" 0 "INVALID" ;
VAL_ 408 OBJ_Angle_Rate_STD_V_3 1 "VALID" 0 "INVALID" ;
VAL_ 408 OBJ_Angle_Rate_V_3 1 "VALID" 0 "INVALID" ;
VAL_ 408 OBJ_Angle_Right_V_3 1 "VALID" 0 "INVALID" ;
VAL_ 408 OBJ_Angle_Right_STD_V_3 1 "VALID" 0 "INVALID" ;
VAL_ 408 OBJ_Angle_Left_V_3 1 "VALID" 0 "INVALID" ;
VAL_ 408 OBJ_Angle_Left_STD_V_3 1 "VALID" 0 "INVALID" ;
VAL_ 408 OBJ_Angle_Side_V_3 1 "VALID" 0 "INVALID" ;
VAL_ 408 OBJ_Angle_Side_STD_V_3 1 "VALID" 0 "INVALID" ;
VAL_ 408 OBJ_Angle_Mid_V_3 1 "VALID" 0 "INVALID" ;
VAL_ 408 OBJ_Angle_Mid_STD_V_3 1 "VALID" 0 "INVALID" ;
VAL_ 408 OBJ_Angle_Bottom_V_3 1 "VALID" 0 "INVALID" ;
VAL_ 408 OBJ_Angle_Bottom_STD_V_3 1 "VALID" 0 "INVALID" ;
VAL_ 408 OBJ_Visibility_Side_V_3 1 "VALID" 0 "INVALID" ;
VAL_ 408 OBJ_Visibility_Side_3 2 "REAR" 1 "FRONT" 0 "NOT_VISIBLE" ;
VAL_ 408 OBJ_Is_In_Drivable_Area_3 1 "TRUE" 0 "FALSE" ;
VAL_ 408 OBJ_Is_In_Drivable_Area_V_3 1 "VALID" 0 "INVALID" ;
VAL_ 408 OBJ_Is_VeryClose_V_3 1 "VALID" 0 "INVALID" ;
VAL_ 408 OBJ_Is_VeryClose_3 1 "TRUE" 0 "FALSE" ;
VAL_ 408 OBJ_Is_EMERGENCY_VCL_3 1 "TRUE" 0 "FALSE" ;
VAL_ 408 OBJ_EMERGENCY_LIGHT_COLOR_3 3 "(1000)ORANGE" 2 "(0100)BLUE" 1 "(0010)RED" 0 "(0001)OTHER" ;
VAL_ 408 OBJ_EMERGENCY_V_3 1 "TRUE" 0 "FALSE" ;
VAL_ 409 OBJ_Motion_Category_4 13 "ONCOMING" 12 "PRECEEDING" 11 "MOVING" 10 "RTAP" 9 "LTAP" 8 "CROSSING" 7 "MOVING_OUT" 6 "MOVING_IN" 5 "CLOSE_CUT_IN" 4 "PASSING_OUT" 3 "PASSING_IN" 2 "PASSING" 1 "UNDEFINED" 0 "UNFILLED" ;
VAL_ 409 OBJ_Measuring_Status_4 2 "(BIT_2)NOT_VALID_OR_VALID" 1 "(BIT_1)PREDICTED_OR_MEASURED" 0 "(BIT_0)OLD_OR_NEW" ;
VAL_ 409 OBJ_Object_Class_4 8 "UNCERTAIN_VCL" 7 "ANIMAL" 6 "GENERAL_OBJECT" 5 "PEDESTRIAN" 4 "BICYCLE" 3 "MOTORBIKE" 2 "TRUCK" 1 "CAR" 0 "UNFILLED" ;
VAL_ 409 OBJ_Motion_Status_4 5 "MOVING_SLOWLY" 4 "STOPPED" 3 "STATIONARY" 2 "MOVING" 1 "UNKNOWN" 0 "INVALID" ;
VAL_ 409 OBJ_Motion_Orientation_4 13 "INVALID" 12 "NORTH" 11 "NORTH_WEST" 9 "WEST" 7 "SOUTH_WEST" 6 "SOUTH" 5 "SOUTH_EAST" 3 "EAST" 1 "NORTH_EAST" 0 "UNKNOWN" ;
VAL_ 409 OBJ_Has_Cut_Lane_4 1 "TRUE" 0 "FALSE" ;
VAL_ 409 OBJ_Has_Cut_Path_4 1 "TRUE" 0 "FALSE" ;
VAL_ 409 OBJ_Brake_Light_4 1 "TRUE" 0 "FALSE" ;
VAL_ 409 OBJ_Turn_Indicator_Right_4 1 "TRUE" 0 "FALSE" ;
VAL_ 409 OBJ_Turn_Indicator_Left_4 1 "TRUE" 0 "FALSE" ;
VAL_ 409 OBJ_Light_Indicator_Validity_4 1 "TRUE" 0 "FALSE" ;
VAL_ 409 OBJ_Right_Out_Of_Image_4 1 "TRUE" 0 "FALSE" ;
VAL_ 409 OBJ_Left_Out_Of_Image_4 1 "TRUE" 0 "FALSE" ;
VAL_ 409 OBJ_Right_Out_Of_Image_V_4 1 "TRUE" 0 "FALSE" ;
VAL_ 409 OBJ_Left_Out_Of_Image_V_4 1 "TRUE" 0 "FALSE" ;
VAL_ 409 OBJ_Top_Out_Of_Image_4 1 "TRUE" 0 "FALSE" ;
VAL_ 409 OBJ_Bottom_Out_Of_Image_4 1 "TRUE" 0 "FALSE" ;
VAL_ 409 OBJ_Top_Out_Of_Image_V_4 1 "VALID" 0 "INVALID" ;
VAL_ 409 OBJ_Bottom_Out_Of_Image_V_4 1 "VALID" 0 "INVALID" ;
VAL_ 409 OBJ_Lane_Assignment_4 5 "RIGHT_RIGHT" 4 "RIGHT" 3 "HOST" 2 "LEFT" 1 "LEFT_LEFT" 0 "UNKNOWN" ;
VAL_ 409 OBJ_Lane_Assignment_V_4 1 "VALID" 0 "INVALID" ;
VAL_ 409 OBJ_Age_Seconds_V_4 1 "VALID" 0 "INVALID" ;
VAL_ 409 OBJ_Width_V_4 1 "VALID" 0 "INVALID" ;
VAL_ 409 OBJ_Width_STD_V_4 1 "VALID" 0 "INVALID" ;
VAL_ 409 OBJ_Length_V_4 1 "VALID" 0 "INVALID" ;
VAL_ 409 OBJ_Length_STD_V_4 1 "VALID" 0 "INVALID" ;
VAL_ 409 OBJ_Height_V_4 1 "VALID" 0 "INVALID" ;
VAL_ 409 OBJ_Height_STD_V_4 1 "VALID" 0 "INVALID" ;
VAL_ 409 OBJ_Abs_Long_Velocity_V_4 1 "VALID" 0 "INVALID" ;
VAL_ 409 OBJ_Abs_Long_Vel_STD_V_4 1 "VALID" 0 "INVALID" ;
VAL_ 409 OBJ_Abs_Lat_Velocity_V_4 1 "VALID" 0 "INVALID" ;
VAL_ 409 OBJ_Abs_Lat_Vel_STD_V_4 1 "VALID" 0 "INVALID" ;
VAL_ 409 OBJ_Abs_Long_Acc_V_4 1 "VALID" 0 "INVALID" ;
VAL_ 409 OBJ_Abs_Long_Acc_STD_V_4 1 "VALID" 0 "INVALID" ;
VAL_ 409 OBJ_Abs_Lat_Acc_V_4 1 "VALID" 0 "INVALID" ;
VAL_ 409 OBJ_Abs_Lat_Acc_STD_V_4 1 "VALID" 0 "INVALID" ;
VAL_ 409 OBJ_Abs_Acceleration_V_4 1 "VALID" 0 "INVALID" ;
VAL_ 409 OBJ_Abs_Acc_STD_V_4 1 "VALID" 0 "INVALID" ;
VAL_ 409 OBJ_Inv_TTC_V_4 1 "VALID" 0 "INVALID" ;
VAL_ 409 OBJ_Inv_TTC_STD_V_4 1 "VALID" 0 "INVALID" ;
VAL_ 409 OBJ_Relative_Long_Acc_V_4 1 "VALID" 0 "INVALID" ;
VAL_ 409 OBJ_Rel_Long_Acc_STD_V_4 1 "VALID" 0 "INVALID" ;
VAL_ 409 OBJ_Relative_Long_Velocity_V_4 1 "VALID" 0 "INVALID" ;
VAL_ 409 OBJ_Rel_Long_Vel_STD_V_4 1 "VALID" 0 "INVALID" ;
VAL_ 410 OBJ_Relative_Lat_Velocity_V_4 1 "VALID" 0 "INVALID" ;
VAL_ 410 OBJ_Rel_Lat_Vel_STD_V_4 1 "VALID" 0 "INVALID" ;
VAL_ 410 OBJ_Long_Distance_V_4 1 "VALID" 0 "INVALID" ;
VAL_ 410 OBJ_Long_Distance_STD_V_4 1 "VALID" 0 "INVALID" ;
VAL_ 410 OBJ_Lat_Distance_V_4 1 "VALID" 0 "INVALID" ;
VAL_ 410 OBJ_Lat_Distance_STD_V_4 1 "VALID" 0 "INVALID" ;
VAL_ 410 OBJ_Absolute_Speed_V_4 1 "VALID" 0 "INVALID" ;
VAL_ 410 OBJ_Absolute_Speed_STD_V_4 1 "VALID" 0 "INVALID" ;
VAL_ 410 OBJ_Heading_V_4 1 "VALID" 0 "INVALID" ;
VAL_ 410 OBJ_Heading_STD_V_4 1 "VALID" 0 "INVALID" ;
VAL_ 410 OBJ_Angle_Rate_STD_V_4 1 "VALID" 0 "INVALID" ;
VAL_ 410 OBJ_Angle_Rate_V_4 1 "VALID" 0 "INVALID" ;
VAL_ 410 OBJ_Angle_Right_V_4 1 "VALID" 0 "INVALID" ;
VAL_ 410 OBJ_Angle_Right_STD_V_4 1 "VALID" 0 "INVALID" ;
VAL_ 410 OBJ_Angle_Left_V_4 1 "VALID" 0 "INVALID" ;
VAL_ 410 OBJ_Angle_Left_STD_V_4 1 "VALID" 0 "INVALID" ;
VAL_ 410 OBJ_Angle_Side_V_4 1 "VALID" 0 "INVALID" ;
VAL_ 410 OBJ_Angle_Side_STD_V_4 1 "VALID" 0 "INVALID" ;
VAL_ 410 OBJ_Angle_Mid_V_4 1 "VALID" 0 "INVALID" ;
VAL_ 410 OBJ_Angle_Mid_STD_V_4 1 "VALID" 0 "INVALID" ;
VAL_ 410 OBJ_Angle_Bottom_V_4 1 "VALID" 0 "INVALID" ;
VAL_ 410 OBJ_Angle_Bottom_STD_V_4 1 "VALID" 0 "INVALID" ;
VAL_ 410 OBJ_Visibility_Side_V_4 1 "VALID" 0 "INVALID" ;
VAL_ 410 OBJ_Visibility_Side_4 2 "REAR" 1 "FRONT" 0 "NOT_VISIBLE" ;
VAL_ 410 OBJ_Is_In_Drivable_Area_4 1 "TRUE" 0 "FALSE" ;
VAL_ 410 OBJ_Is_In_Drivable_Area_V_4 1 "VALID" 0 "INVALID" ;
VAL_ 410 OBJ_Is_VeryClose_V_4 1 "VALID" 0 "INVALID" ;
VAL_ 410 OBJ_Is_VeryClose_4 1 "TRUE" 0 "FALSE" ;
VAL_ 410 OBJ_Is_EMERGENCY_VCL_4 1 "TRUE" 0 "FALSE" ;
VAL_ 410 OBJ_EMERGENCY_LIGHT_COLOR_4 3 "(1000)ORANGE" 2 "(0100)BLUE" 1 "(0010)RED" 0 "(0001)OTHER" ;
VAL_ 410 OBJ_EMERGENCY_V_4 1 "TRUE" 0 "FALSE" ;
VAL_ 411 OBJ_Motion_Category_5 13 "ONCOMING" 12 "PRECEEDING" 11 "MOVING" 10 "RTAP" 9 "LTAP" 8 "CROSSING" 7 "MOVING_OUT" 6 "MOVING_IN" 5 "CLOSE_CUT_IN" 4 "PASSING_OUT" 3 "PASSING_IN" 2 "PASSING" 1 "UNDEFINED" 0 "UNFILLED" ;
VAL_ 411 OBJ_Measuring_Status_5 2 "(BIT_2)NOT_VALID_OR_VALID" 1 "(BIT_1)PREDICTED_OR_MEASURED" 0 "(BIT_0)OLD_OR_NEW" ;
VAL_ 411 OBJ_Object_Class_5 8 "UNCERTAIN_VCL" 7 "ANIMAL" 6 "GENERAL_OBJECT" 5 "PEDESTRIAN" 4 "BICYCLE" 3 "MOTORBIKE" 2 "TRUCK" 1 "CAR" 0 "UNFILLED" ;
VAL_ 411 OBJ_Motion_Status_5 5 "MOVING_SLOWLY" 4 "STOPPED" 3 "STATIONARY" 2 "MOVING" 1 "UNKNOWN" 0 "INVALID" ;
VAL_ 411 OBJ_Motion_Orientation_5 13 "INVALID" 12 "NORTH" 11 "NORTH_WEST" 9 "WEST" 7 "SOUTH_WEST" 6 "SOUTH" 5 "SOUTH_EAST" 3 "EAST" 1 "NORTH_EAST" 0 "UNKNOWN" ;
VAL_ 411 OBJ_Has_Cut_Lane_5 1 "TRUE" 0 "FALSE" ;
VAL_ 411 OBJ_Has_Cut_Path_5 1 "TRUE" 0 "FALSE" ;
VAL_ 411 OBJ_Brake_Light_5 1 "TRUE" 0 "FALSE" ;
VAL_ 411 OBJ_Turn_Indicator_Right_5 1 "TRUE" 0 "FALSE" ;
VAL_ 411 OBJ_Turn_Indicator_Left_5 1 "TRUE" 0 "FALSE" ;
VAL_ 411 OBJ_Light_Indicator_Validity_5 1 "TRUE" 0 "FALSE" ;
VAL_ 411 OBJ_Right_Out_Of_Image_5 1 "TRUE" 0 "FALSE" ;
VAL_ 411 OBJ_Left_Out_Of_Image_5 1 "TRUE" 0 "FALSE" ;
VAL_ 411 OBJ_Right_Out_Of_Image_V_5 1 "TRUE" 0 "FALSE" ;
VAL_ 411 OBJ_Left_Out_Of_Image_V_5 1 "TRUE" 0 "FALSE" ;
VAL_ 411 OBJ_Top_Out_Of_Image_5 1 "TRUE" 0 "FALSE" ;
VAL_ 411 OBJ_Bottom_Out_Of_Image_5 1 "TRUE" 0 "FALSE" ;
VAL_ 411 OBJ_Top_Out_Of_Image_V_5 1 "VALID" 0 "INVALID" ;
VAL_ 411 OBJ_Bottom_Out_Of_Image_V_5 1 "VALID" 0 "INVALID" ;
VAL_ 411 OBJ_Lane_Assignment_5 5 "RIGHT_RIGHT" 4 "RIGHT" 3 "HOST" 2 "LEFT" 1 "LEFT_LEFT" 0 "UNKNOWN" ;
VAL_ 411 OBJ_Lane_Assignment_V_5 1 "VALID" 0 "INVALID" ;
VAL_ 411 OBJ_Age_Seconds_V_5 1 "VALID" 0 "INVALID" ;
VAL_ 411 OBJ_Width_V_5 1 "VALID" 0 "INVALID" ;
VAL_ 411 OBJ_Width_STD_V_5 1 "VALID" 0 "INVALID" ;
VAL_ 411 OBJ_Length_V_5 1 "VALID" 0 "INVALID" ;
VAL_ 411 OBJ_Length_STD_V_5 1 "VALID" 0 "INVALID" ;
VAL_ 411 OBJ_Height_V_5 1 "VALID" 0 "INVALID" ;
VAL_ 411 OBJ_Height_STD_V_5 1 "VALID" 0 "INVALID" ;
VAL_ 411 OBJ_Abs_Long_Velocity_V_5 1 "VALID" 0 "INVALID" ;
VAL_ 411 OBJ_Abs_Long_Vel_STD_V_5 1 "VALID" 0 "INVALID" ;
VAL_ 411 OBJ_Abs_Lat_Velocity_V_5 1 "VALID" 0 "INVALID" ;
VAL_ 411 OBJ_Abs_Lat_Vel_STD_V_5 1 "VALID" 0 "INVALID" ;
VAL_ 411 OBJ_Abs_Long_Acc_V_5 1 "VALID" 0 "INVALID" ;
VAL_ 411 OBJ_Abs_Long_Acc_STD_V_5 1 "VALID" 0 "INVALID" ;
VAL_ 411 OBJ_Abs_Lat_Acc_V_5 1 "VALID" 0 "INVALID" ;
VAL_ 411 OBJ_Abs_Lat_Acc_STD_V_5 1 "VALID" 0 "INVALID" ;
VAL_ 411 OBJ_Abs_Acceleration_V_5 1 "VALID" 0 "INVALID" ;
VAL_ 411 OBJ_Abs_Acc_STD_V_5 1 "VALID" 0 "INVALID" ;
VAL_ 411 OBJ_Inv_TTC_V_5 1 "VALID" 0 "INVALID" ;
VAL_ 411 OBJ_Inv_TTC_STD_V_5 1 "VALID" 0 "INVALID" ;
VAL_ 411 OBJ_Relative_Long_Acc_V_5 1 "VALID" 0 "INVALID" ;
VAL_ 411 OBJ_Rel_Long_Acc_STD_V_5 1 "VALID" 0 "INVALID" ;
VAL_ 411 OBJ_Relative_Long_Velocity_V_5 1 "VALID" 0 "INVALID" ;
VAL_ 411 OBJ_Rel_Long_Vel_STD_V_5 1 "VALID" 0 "INVALID" ;
VAL_ 412 OBJ_Relative_Lat_Velocity_V_5 1 "VALID" 0 "INVALID" ;
VAL_ 412 OBJ_Rel_Lat_Vel_STD_V_5 1 "VALID" 0 "INVALID" ;
VAL_ 412 OBJ_Long_Distance_V_5 1 "VALID" 0 "INVALID" ;
VAL_ 412 OBJ_Long_Distance_STD_V_5 1 "VALID" 0 "INVALID" ;
VAL_ 412 OBJ_Lat_Distance_V_5 1 "VALID" 0 "INVALID" ;
VAL_ 412 OBJ_Lat_Distance_STD_V_5 1 "VALID" 0 "INVALID" ;
VAL_ 412 OBJ_Absolute_Speed_V_5 1 "VALID" 0 "INVALID" ;
VAL_ 412 OBJ_Absolute_Speed_STD_V_5 1 "VALID" 0 "INVALID" ;
VAL_ 412 OBJ_Heading_V_5 1 "VALID" 0 "INVALID" ;
VAL_ 412 OBJ_Heading_STD_V_5 1 "VALID" 0 "INVALID" ;
VAL_ 412 OBJ_Angle_Rate_STD_V_5 1 "VALID" 0 "INVALID" ;
VAL_ 412 OBJ_Angle_Rate_V_5 1 "VALID" 0 "INVALID" ;
VAL_ 412 OBJ_Angle_Right_V_5 1 "VALID" 0 "INVALID" ;
VAL_ 412 OBJ_Angle_Right_STD_V_5 1 "VALID" 0 "INVALID" ;
VAL_ 412 OBJ_Angle_Left_V_5 1 "VALID" 0 "INVALID" ;
VAL_ 412 OBJ_Angle_Left_STD_V_5 1 "VALID" 0 "INVALID" ;
VAL_ 412 OBJ_Angle_Side_V_5 1 "VALID" 0 "INVALID" ;
VAL_ 412 OBJ_Angle_Side_STD_V_5 1 "VALID" 0 "INVALID" ;
VAL_ 412 OBJ_Angle_Mid_V_5 1 "VALID" 0 "INVALID" ;
VAL_ 412 OBJ_Angle_Mid_STD_V_5 1 "VALID" 0 "INVALID" ;
VAL_ 412 OBJ_Angle_Bottom_V_5 1 "VALID" 0 "INVALID" ;
VAL_ 412 OBJ_Angle_Bottom_STD_V_5 1 "VALID" 0 "INVALID" ;
VAL_ 412 OBJ_Visibility_Side_V_5 1 "VALID" 0 "INVALID" ;
VAL_ 412 OBJ_Visibility_Side_5 2 "REAR" 1 "FRONT" 0 "NOT_VISIBLE" ;
VAL_ 412 OBJ_Is_In_Drivable_Area_5 1 "TRUE" 0 "FALSE" ;
VAL_ 412 OBJ_Is_In_Drivable_Area_V_5 1 "VALID" 0 "INVALID" ;
VAL_ 412 OBJ_Is_VeryClose_V_5 1 "VALID" 0 "INVALID" ;
VAL_ 412 OBJ_Is_VeryClose_5 1 "TRUE" 0 "FALSE" ;
VAL_ 412 OBJ_Is_EMERGENCY_VCL_5 1 "TRUE" 0 "FALSE" ;
VAL_ 412 OBJ_EMERGENCY_LIGHT_COLOR_5 3 "(1000)ORANGE" 2 "(0100)BLUE" 1 "(0010)RED" 0 "(0001)OTHER" ;
VAL_ 412 OBJ_EMERGENCY_V_5 1 "TRUE" 0 "FALSE" ;
VAL_ 413 OBJ_Motion_Category_6 13 "ONCOMING" 12 "PRECEEDING" 11 "MOVING" 10 "RTAP" 9 "LTAP" 8 "CROSSING" 7 "MOVING_OUT" 6 "MOVING_IN" 5 "CLOSE_CUT_IN" 4 "PASSING_OUT" 3 "PASSING_IN" 2 "PASSING" 1 "UNDEFINED" 0 "UNFILLED" ;
VAL_ 413 OBJ_Measuring_Status_6 2 "(BIT_2)NOT_VALID_OR_VALID" 1 "(BIT_1)PREDICTED_OR_MEASURED" 0 "(BIT_0)OLD_OR_NEW" ;
VAL_ 413 OBJ_Object_Class_6 8 "UNCERTAIN_VCL" 7 "ANIMAL" 6 "GENERAL_OBJECT" 5 "PEDESTRIAN" 4 "BICYCLE" 3 "MOTORBIKE" 2 "TRUCK" 1 "CAR" 0 "UNFILLED" ;
VAL_ 413 OBJ_Motion_Status_6 5 "MOVING_SLOWLY" 4 "STOPPED" 3 "STATIONARY" 2 "MOVING" 1 "UNKNOWN" 0 "INVALID" ;
VAL_ 413 OBJ_Motion_Orientation_6 13 "INVALID" 12 "NORTH" 11 "NORTH_WEST" 9 "WEST" 7 "SOUTH_WEST" 6 "SOUTH" 5 "SOUTH_EAST" 3 "EAST" 1 "NORTH_EAST" 0 "UNKNOWN" ;
VAL_ 413 OBJ_Has_Cut_Lane_6 1 "TRUE" 0 "FALSE" ;
VAL_ 413 OBJ_Has_Cut_Path_6 1 "TRUE" 0 "FALSE" ;
VAL_ 413 OBJ_Brake_Light_6 1 "TRUE" 0 "FALSE" ;
VAL_ 413 OBJ_Turn_Indicator_Right_6 1 "TRUE" 0 "FALSE" ;
VAL_ 413 OBJ_Turn_Indicator_Left_6 1 "TRUE" 0 "FALSE" ;
VAL_ 413 OBJ_Light_Indicator_Validity_6 1 "TRUE" 0 "FALSE" ;
VAL_ 413 OBJ_Right_Out_Of_Image_6 1 "TRUE" 0 "FALSE" ;
VAL_ 413 OBJ_Left_Out_Of_Image_6 1 "TRUE" 0 "FALSE" ;
VAL_ 413 OBJ_Right_Out_Of_Image_V_6 1 "TRUE" 0 "FALSE" ;
VAL_ 413 OBJ_Left_Out_Of_Image_V_6 1 "TRUE" 0 "FALSE" ;
VAL_ 413 OBJ_Top_Out_Of_Image_6 1 "TRUE" 0 "FALSE" ;
VAL_ 413 OBJ_Bottom_Out_Of_Image_6 1 "TRUE" 0 "FALSE" ;
VAL_ 413 OBJ_Top_Out_Of_Image_V_6 1 "VALID" 0 "INVALID" ;
VAL_ 413 OBJ_Bottom_Out_Of_Image_V_6 1 "VALID" 0 "INVALID" ;
VAL_ 413 OBJ_Lane_Assignment_6 5 "RIGHT_RIGHT" 4 "RIGHT" 3 "HOST" 2 "LEFT" 1 "LEFT_LEFT" 0 "UNKNOWN" ;
VAL_ 413 OBJ_Lane_Assignment_V_6 1 "VALID" 0 "INVALID" ;
VAL_ 413 OBJ_Age_Seconds_V_6 1 "VALID" 0 "INVALID" ;
VAL_ 413 OBJ_Width_V_6 1 "VALID" 0 "INVALID" ;
VAL_ 413 OBJ_Width_STD_V_6 1 "VALID" 0 "INVALID" ;
VAL_ 413 OBJ_Length_V_6 1 "VALID" 0 "INVALID" ;
VAL_ 413 OBJ_Length_STD_V_6 1 "VALID" 0 "INVALID" ;
VAL_ 413 OBJ_Height_V_6 1 "VALID" 0 "INVALID" ;
VAL_ 413 OBJ_Height_STD_V_6 1 "VALID" 0 "INVALID" ;
VAL_ 413 OBJ_Abs_Long_Velocity_V_6 1 "VALID" 0 "INVALID" ;
VAL_ 413 OBJ_Abs_Long_Vel_STD_V_6 1 "VALID" 0 "INVALID" ;
VAL_ 413 OBJ_Abs_Lat_Velocity_V_6 1 "VALID" 0 "INVALID" ;
VAL_ 413 OBJ_Abs_Lat_Vel_STD_V_6 1 "VALID" 0 "INVALID" ;
VAL_ 413 OBJ_Abs_Long_Acc_V_6 1 "VALID" 0 "INVALID" ;
VAL_ 413 OBJ_Abs_Long_Acc_STD_V_6 1 "VALID" 0 "INVALID" ;
VAL_ 413 OBJ_Abs_Lat_Acc_V_6 1 "VALID" 0 "INVALID" ;
VAL_ 413 OBJ_Abs_Lat_Acc_STD_V_6 1 "VALID" 0 "INVALID" ;
VAL_ 413 OBJ_Abs_Acceleration_V_6 1 "VALID" 0 "INVALID" ;
VAL_ 413 OBJ_Abs_Acc_STD_V_6 1 "VALID" 0 "INVALID" ;
VAL_ 413 OBJ_Inv_TTC_V_6 1 "VALID" 0 "INVALID" ;
VAL_ 413 OBJ_Inv_TTC_STD_V_6 1 "VALID" 0 "INVALID" ;
VAL_ 413 OBJ_Relative_Long_Acc_V_6 1 "VALID" 0 "INVALID" ;
VAL_ 413 OBJ_Rel_Long_Acc_STD_V_6 1 "VALID" 0 "INVALID" ;
VAL_ 413 OBJ_Relative_Long_Velocity_V_6 1 "VALID" 0 "INVALID" ;
VAL_ 413 OBJ_Rel_Long_Vel_STD_V_6 1 "VALID" 0 "INVALID" ;
VAL_ 414 OBJ_Relative_Lat_Velocity_V_6 1 "VALID" 0 "INVALID" ;
VAL_ 414 OBJ_Rel_Lat_Vel_STD_V_6 1 "VALID" 0 "INVALID" ;
VAL_ 414 OBJ_Long_Distance_V_6 1 "VALID" 0 "INVALID" ;
VAL_ 414 OBJ_Long_Distance_STD_V_6 1 "VALID" 0 "INVALID" ;
VAL_ 414 OBJ_Lat_Distance_V_6 1 "VALID" 0 "INVALID" ;
VAL_ 414 OBJ_Lat_Distance_STD_V_6 1 "VALID" 0 "INVALID" ;
VAL_ 414 OBJ_Absolute_Speed_V_6 1 "VALID" 0 "INVALID" ;
VAL_ 414 OBJ_Absolute_Speed_STD_V_6 1 "VALID" 0 "INVALID" ;
VAL_ 414 OBJ_Heading_V_6 1 "VALID" 0 "INVALID" ;
VAL_ 414 OBJ_Heading_STD_V_6 1 "VALID" 0 "INVALID" ;
VAL_ 414 OBJ_Angle_Rate_STD_V_6 1 "VALID" 0 "INVALID" ;
VAL_ 414 OBJ_Angle_Rate_V_6 1 "VALID" 0 "INVALID" ;
VAL_ 414 OBJ_Angle_Right_V_6 1 "VALID" 0 "INVALID" ;
VAL_ 414 OBJ_Angle_Right_STD_V_6 1 "VALID" 0 "INVALID" ;
VAL_ 414 OBJ_Angle_Left_V_6 1 "VALID" 0 "INVALID" ;
VAL_ 414 OBJ_Angle_Left_STD_V_6 1 "VALID" 0 "INVALID" ;
VAL_ 414 OBJ_Angle_Side_V_6 1 "VALID" 0 "INVALID" ;
VAL_ 414 OBJ_Angle_Side_STD_V_6 1 "VALID" 0 "INVALID" ;
VAL_ 414 OBJ_Angle_Mid_V_6 1 "VALID" 0 "INVALID" ;
VAL_ 414 OBJ_Angle_Mid_STD_V_6 1 "VALID" 0 "INVALID" ;
VAL_ 414 OBJ_Angle_Bottom_V_6 1 "VALID" 0 "INVALID" ;
VAL_ 414 OBJ_Angle_Bottom_STD_V_6 1 "VALID" 0 "INVALID" ;
VAL_ 414 OBJ_Visibility_Side_V_6 1 "VALID" 0 "INVALID" ;
VAL_ 414 OBJ_Visibility_Side_6 2 "REAR" 1 "FRONT" 0 "NOT_VISIBLE" ;
VAL_ 414 OBJ_Is_In_Drivable_Area_6 1 "TRUE" 0 "FALSE" ;
VAL_ 414 OBJ_Is_In_Drivable_Area_V_6 1 "VALID" 0 "INVALID" ;
VAL_ 414 OBJ_Is_VeryClose_V_6 1 "VALID" 0 "INVALID" ;
VAL_ 414 OBJ_Is_VeryClose_6 1 "TRUE" 0 "FALSE" ;
VAL_ 414 OBJ_Is_EMERGENCY_VCL_6 1 "TRUE" 0 "FALSE" ;
VAL_ 414 OBJ_EMERGENCY_LIGHT_COLOR_6 3 "(1000)ORANGE" 2 "(0100)BLUE" 1 "(0010)RED" 0 "(0001)OTHER" ;
VAL_ 414 OBJ_EMERGENCY_V_6 1 "TRUE" 0 "FALSE" ;
VAL_ 415 OBJ_Motion_Category_7 13 "ONCOMING" 12 "PRECEEDING" 11 "MOVING" 10 "RTAP" 9 "LTAP" 8 "CROSSING" 7 "MOVING_OUT" 6 "MOVING_IN" 5 "CLOSE_CUT_IN" 4 "PASSING_OUT" 3 "PASSING_IN" 2 "PASSING" 1 "UNDEFINED" 0 "UNFILLED" ;
VAL_ 415 OBJ_Measuring_Status_7 2 "(BIT_2)NOT_VALID_OR_VALID" 1 "(BIT_1)PREDICTED_OR_MEASURED" 0 "(BIT_0)OLD_OR_NEW" ;
VAL_ 415 OBJ_Object_Class_7 8 "UNCERTAIN_VCL" 7 "ANIMAL" 6 "GENERAL_OBJECT" 5 "PEDESTRIAN" 4 "BICYCLE" 3 "MOTORBIKE" 2 "TRUCK" 1 "CAR" 0 "UNFILLED" ;
VAL_ 415 OBJ_Motion_Status_7 5 "MOVING_SLOWLY" 4 "STOPPED" 3 "STATIONARY" 2 "MOVING" 1 "UNKNOWN" 0 "INVALID" ;
VAL_ 415 OBJ_Motion_Orientation_7 13 "INVALID" 12 "NORTH" 11 "NORTH_WEST" 9 "WEST" 7 "SOUTH_WEST" 6 "SOUTH" 5 "SOUTH_EAST" 3 "EAST" 1 "NORTH_EAST" 0 "UNKNOWN" ;
VAL_ 415 OBJ_Has_Cut_Lane_7 1 "TRUE" 0 "FALSE" ;
VAL_ 415 OBJ_Has_Cut_Path_7 1 "TRUE" 0 "FALSE" ;
VAL_ 415 OBJ_Brake_Light_7 1 "TRUE" 0 "FALSE" ;
VAL_ 415 OBJ_Turn_Indicator_Right_7 1 "TRUE" 0 "FALSE" ;
VAL_ 415 OBJ_Turn_Indicator_Left_7 1 "TRUE" 0 "FALSE" ;
VAL_ 415 OBJ_Light_Indicator_Validity_7 1 "TRUE" 0 "FALSE" ;
VAL_ 415 OBJ_Right_Out_Of_Image_7 1 "TRUE" 0 "FALSE" ;
VAL_ 415 OBJ_Left_Out_Of_Image_7 1 "TRUE" 0 "FALSE" ;
VAL_ 415 OBJ_Right_Out_Of_Image_V_7 1 "TRUE" 0 "FALSE" ;
VAL_ 415 OBJ_Left_Out_Of_Image_V_7 1 "TRUE" 0 "FALSE" ;
VAL_ 415 OBJ_Top_Out_Of_Image_7 1 "TRUE" 0 "FALSE" ;
VAL_ 415 OBJ_Bottom_Out_Of_Image_7 1 "TRUE" 0 "FALSE" ;
VAL_ 415 OBJ_Top_Out_Of_Image_V_7 1 "VALID" 0 "INVALID" ;
VAL_ 415 OBJ_Bottom_Out_Of_Image_V_7 1 "VALID" 0 "INVALID" ;
VAL_ 415 OBJ_Lane_Assignment_7 5 "RIGHT_RIGHT" 4 "RIGHT" 3 "HOST" 2 "LEFT" 1 "LEFT_LEFT" 0 "UNKNOWN" ;
VAL_ 415 OBJ_Lane_Assignment_V_7 1 "VALID" 0 "INVALID" ;
VAL_ 415 OBJ_Age_Seconds_V_7 1 "VALID" 0 "INVALID" ;
VAL_ 415 OBJ_Width_V_7 1 "VALID" 0 "INVALID" ;
VAL_ 415 OBJ_Width_STD_V_7 1 "VALID" 0 "INVALID" ;
VAL_ 415 OBJ_Length_V_7 1 "VALID" 0 "INVALID" ;
VAL_ 415 OBJ_Length_STD_V_7 1 "VALID" 0 "INVALID" ;
VAL_ 415 OBJ_Height_V_7 1 "VALID" 0 "INVALID" ;
VAL_ 415 OBJ_Height_STD_V_7 1 "VALID" 0 "INVALID" ;
VAL_ 415 OBJ_Abs_Long_Velocity_V_7 1 "VALID" 0 "INVALID" ;
VAL_ 415 OBJ_Abs_Long_Vel_STD_V_7 1 "VALID" 0 "INVALID" ;
VAL_ 415 OBJ_Abs_Lat_Velocity_V_7 1 "VALID" 0 "INVALID" ;
VAL_ 415 OBJ_Abs_Lat_Vel_STD_V_7 1 "VALID" 0 "INVALID" ;
VAL_ 415 OBJ_Abs_Long_Acc_V_7 1 "VALID" 0 "INVALID" ;
VAL_ 415 OBJ_Abs_Long_Acc_STD_V_7 1 "VALID" 0 "INVALID" ;
VAL_ 415 OBJ_Abs_Lat_Acc_V_7 1 "VALID" 0 "INVALID" ;
VAL_ 415 OBJ_Abs_Lat_Acc_STD_V_7 1 "VALID" 0 "INVALID" ;
VAL_ 415 OBJ_Abs_Acceleration_V_7 1 "VALID" 0 "INVALID" ;
VAL_ 415 OBJ_Abs_Acc_STD_V_7 1 "VALID" 0 "INVALID" ;
VAL_ 415 OBJ_Inv_TTC_V_7 1 "VALID" 0 "INVALID" ;
VAL_ 415 OBJ_Inv_TTC_STD_V_7 1 "VALID" 0 "INVALID" ;
VAL_ 415 OBJ_Relative_Long_Acc_V_7 1 "VALID" 0 "INVALID" ;
VAL_ 415 OBJ_Rel_Long_Acc_STD_V_7 1 "VALID" 0 "INVALID" ;
VAL_ 415 OBJ_Relative_Long_Velocity_V_7 1 "VALID" 0 "INVALID" ;
VAL_ 415 OBJ_Rel_Long_Vel_STD_V_7 1 "VALID" 0 "INVALID" ;
VAL_ 416 OBJ_Relative_Lat_Velocity_V_7 1 "VALID" 0 "INVALID" ;
VAL_ 416 OBJ_Rel_Lat_Vel_STD_V_7 1 "VALID" 0 "INVALID" ;
VAL_ 416 OBJ_Long_Distance_V_7 1 "VALID" 0 "INVALID" ;
VAL_ 416 OBJ_Long_Distance_STD_V_7 1 "VALID" 0 "INVALID" ;
VAL_ 416 OBJ_Lat_Distance_V_7 1 "VALID" 0 "INVALID" ;
VAL_ 416 OBJ_Lat_Distance_STD_V_7 1 "VALID" 0 "INVALID" ;
VAL_ 416 OBJ_Absolute_Speed_V_7 1 "VALID" 0 "INVALID" ;
VAL_ 416 OBJ_Absolute_Speed_STD_V_7 1 "VALID" 0 "INVALID" ;
VAL_ 416 OBJ_Heading_V_7 1 "VALID" 0 "INVALID" ;
VAL_ 416 OBJ_Heading_STD_V_7 1 "VALID" 0 "INVALID" ;
VAL_ 416 OBJ_Angle_Rate_STD_V_7 1 "VALID" 0 "INVALID" ;
VAL_ 416 OBJ_Angle_Rate_V_7 1 "VALID" 0 "INVALID" ;
VAL_ 416 OBJ_Angle_Right_V_7 1 "VALID" 0 "INVALID" ;
VAL_ 416 OBJ_Angle_Right_STD_V_7 1 "VALID" 0 "INVALID" ;
VAL_ 416 OBJ_Angle_Left_V_7 1 "VALID" 0 "INVALID" ;
VAL_ 416 OBJ_Angle_Left_STD_V_7 1 "VALID" 0 "INVALID" ;
VAL_ 416 OBJ_Angle_Side_V_7 1 "VALID" 0 "INVALID" ;
VAL_ 416 OBJ_Angle_Side_STD_V_7 1 "VALID" 0 "INVALID" ;
VAL_ 416 OBJ_Angle_Mid_V_7 1 "VALID" 0 "INVALID" ;
VAL_ 416 OBJ_Angle_Mid_STD_V_7 1 "VALID" 0 "INVALID" ;
VAL_ 416 OBJ_Angle_Bottom_V_7 1 "VALID" 0 "INVALID" ;
VAL_ 416 OBJ_Angle_Bottom_STD_V_7 1 "VALID" 0 "INVALID" ;
VAL_ 416 OBJ_Visibility_Side_V_7 1 "VALID" 0 "INVALID" ;
VAL_ 416 OBJ_Visibility_Side_7 2 "REAR" 1 "FRONT" 0 "NOT_VISIBLE" ;
VAL_ 416 OBJ_Is_In_Drivable_Area_7 1 "TRUE" 0 "FALSE" ;
VAL_ 416 OBJ_Is_In_Drivable_Area_V_7 1 "VALID" 0 "INVALID" ;
VAL_ 416 OBJ_Is_VeryClose_V_7 1 "VALID" 0 "INVALID" ;
VAL_ 416 OBJ_Is_VeryClose_7 1 "TRUE" 0 "FALSE" ;
VAL_ 416 OBJ_Is_EMERGENCY_VCL_7 1 "TRUE" 0 "FALSE" ;
VAL_ 416 OBJ_EMERGENCY_LIGHT_COLOR_7 3 "(1000)ORANGE" 2 "(0100)BLUE" 1 "(0010)RED" 0 "(0001)OTHER" ;
VAL_ 416 OBJ_EMERGENCY_V_7 1 "TRUE" 0 "FALSE" ;
VAL_ 417 OBJ_Motion_Category_8 13 "ONCOMING" 12 "PRECEEDING" 11 "MOVING" 10 "RTAP" 9 "LTAP" 8 "CROSSING" 7 "MOVING_OUT" 6 "MOVING_IN" 5 "CLOSE_CUT_IN" 4 "PASSING_OUT" 3 "PASSING_IN" 2 "PASSING" 1 "UNDEFINED" 0 "UNFILLED" ;
VAL_ 417 OBJ_Measuring_Status_8 2 "(BIT_2)NOT_VALID_OR_VALID" 1 "(BIT_1)PREDICTED_OR_MEASURED" 0 "(BIT_0)OLD_OR_NEW" ;
VAL_ 417 OBJ_Object_Class_8 8 "UNCERTAIN_VCL" 7 "ANIMAL" 6 "GENERAL_OBJECT" 5 "PEDESTRIAN" 4 "BICYCLE" 3 "MOTORBIKE" 2 "TRUCK" 1 "CAR" 0 "UNFILLED" ;
VAL_ 417 OBJ_Motion_Status_8 5 "MOVING_SLOWLY" 4 "STOPPED" 3 "STATIONARY" 2 "MOVING" 1 "UNKNOWN" 0 "INVALID" ;
VAL_ 417 OBJ_Motion_Orientation_8 13 "INVALID" 12 "NORTH" 11 "NORTH_WEST" 9 "WEST" 7 "SOUTH_WEST" 6 "SOUTH" 5 "SOUTH_EAST" 3 "EAST" 1 "NORTH_EAST" 0 "UNKNOWN" ;
VAL_ 417 OBJ_Has_Cut_Lane_8 1 "TRUE" 0 "FALSE" ;
VAL_ 417 OBJ_Has_Cut_Path_8 1 "TRUE" 0 "FALSE" ;
VAL_ 417 OBJ_Brake_Light_8 1 "TRUE" 0 "FALSE" ;
VAL_ 417 OBJ_Turn_Indicator_Right_8 1 "TRUE" 0 "FALSE" ;
VAL_ 417 OBJ_Turn_Indicator_Left_8 1 "TRUE" 0 "FALSE" ;
VAL_ 417 OBJ_Light_Indicator_Validity_8 1 "TRUE" 0 "FALSE" ;
VAL_ 417 OBJ_Right_Out_Of_Image_8 1 "TRUE" 0 "FALSE" ;
VAL_ 417 OBJ_Left_Out_Of_Image_8 1 "TRUE" 0 "FALSE" ;
VAL_ 417 OBJ_Right_Out_Of_Image_V_8 1 "TRUE" 0 "FALSE" ;
VAL_ 417 OBJ_Left_Out_Of_Image_V_8 1 "TRUE" 0 "FALSE" ;
VAL_ 417 OBJ_Top_Out_Of_Image_8 1 "TRUE" 0 "FALSE" ;
VAL_ 417 OBJ_Bottom_Out_Of_Image_8 1 "TRUE" 0 "FALSE" ;
VAL_ 417 OBJ_Top_Out_Of_Image_V_8 1 "VALID" 0 "INVALID" ;
VAL_ 417 OBJ_Bottom_Out_Of_Image_V_8 1 "VALID" 0 "INVALID" ;
VAL_ 417 OBJ_Lane_Assignment_8 5 "RIGHT_RIGHT" 4 "RIGHT" 3 "HOST" 2 "LEFT" 1 "LEFT_LEFT" 0 "UNKNOWN" ;
VAL_ 417 OBJ_Lane_Assignment_V_8 1 "VALID" 0 "INVALID" ;
VAL_ 417 OBJ_Age_Seconds_V_8 1 "VALID" 0 "INVALID" ;
VAL_ 417 OBJ_Width_V_8 1 "VALID" 0 "INVALID" ;
VAL_ 417 OBJ_Width_STD_V_8 1 "VALID" 0 "INVALID" ;
VAL_ 417 OBJ_Length_V_8 1 "VALID" 0 "INVALID" ;
VAL_ 417 OBJ_Length_STD_V_8 1 "VALID" 0 "INVALID" ;
VAL_ 417 OBJ_Height_V_8 1 "VALID" 0 "INVALID" ;
VAL_ 417 OBJ_Height_STD_V_8 1 "VALID" 0 "INVALID" ;
VAL_ 417 OBJ_Abs_Long_Velocity_V_8 1 "VALID" 0 "INVALID" ;
VAL_ 417 OBJ_Abs_Long_Vel_STD_V_8 1 "VALID" 0 "INVALID" ;
VAL_ 417 OBJ_Abs_Lat_Velocity_V_8 1 "VALID" 0 "INVALID" ;
VAL_ 417 OBJ_Abs_Lat_Vel_STD_V_8 1 "VALID" 0 "INVALID" ;
VAL_ 417 OBJ_Abs_Long_Acc_V_8 1 "VALID" 0 "INVALID" ;
VAL_ 417 OBJ_Abs_Long_Acc_STD_V_8 1 "VALID" 0 "INVALID" ;
VAL_ 417 OBJ_Abs_Lat_Acc_V_8 1 "VALID" 0 "INVALID" ;
VAL_ 417 OBJ_Abs_Lat_Acc_STD_V_8 1 "VALID" 0 "INVALID" ;
VAL_ 417 OBJ_Abs_Acceleration_V_8 1 "VALID" 0 "INVALID" ;
VAL_ 417 OBJ_Abs_Acc_STD_V_8 1 "VALID" 0 "INVALID" ;
VAL_ 417 OBJ_Inv_TTC_V_8 1 "VALID" 0 "INVALID" ;
VAL_ 417 OBJ_Inv_TTC_STD_V_8 1 "VALID" 0 "INVALID" ;
VAL_ 417 OBJ_Relative_Long_Acc_V_8 1 "VALID" 0 "INVALID" ;
VAL_ 417 OBJ_Rel_Long_Acc_STD_V_8 1 "VALID" 0 "INVALID" ;
VAL_ 417 OBJ_Relative_Long_Velocity_V_8 1 "VALID" 0 "INVALID" ;
VAL_ 417 OBJ_Rel_Long_Vel_STD_V_8 1 "VALID" 0 "INVALID" ;
VAL_ 418 OBJ_Relative_Lat_Velocity_V_8 1 "VALID" 0 "INVALID" ;
VAL_ 418 OBJ_Rel_Lat_Vel_STD_V_8 1 "VALID" 0 "INVALID" ;
VAL_ 418 OBJ_Long_Distance_V_8 1 "VALID" 0 "INVALID" ;
VAL_ 418 OBJ_Long_Distance_STD_V_8 1 "VALID" 0 "INVALID" ;
VAL_ 418 OBJ_Lat_Distance_V_8 1 "VALID" 0 "INVALID" ;
VAL_ 418 OBJ_Lat_Distance_STD_V_8 1 "VALID" 0 "INVALID" ;
VAL_ 418 OBJ_Absolute_Speed_V_8 1 "VALID" 0 "INVALID" ;
VAL_ 418 OBJ_Absolute_Speed_STD_V_8 1 "VALID" 0 "INVALID" ;
VAL_ 418 OBJ_Heading_V_8 1 "VALID" 0 "INVALID" ;
VAL_ 418 OBJ_Heading_STD_V_8 1 "VALID" 0 "INVALID" ;
VAL_ 418 OBJ_Angle_Rate_STD_V_8 1 "VALID" 0 "INVALID" ;
VAL_ 418 OBJ_Angle_Rate_V_8 1 "VALID" 0 "INVALID" ;
VAL_ 418 OBJ_Angle_Right_V_8 1 "VALID" 0 "INVALID" ;
VAL_ 418 OBJ_Angle_Right_STD_V_8 1 "VALID" 0 "INVALID" ;
VAL_ 418 OBJ_Angle_Left_V_8 1 "VALID" 0 "INVALID" ;
VAL_ 418 OBJ_Angle_Left_STD_V_8 1 "VALID" 0 "INVALID" ;
VAL_ 418 OBJ_Angle_Side_V_8 1 "VALID" 0 "INVALID" ;
VAL_ 418 OBJ_Angle_Side_STD_V_8 1 "VALID" 0 "INVALID" ;
VAL_ 418 OBJ_Angle_Mid_V_8 1 "VALID" 0 "INVALID" ;
VAL_ 418 OBJ_Angle_Mid_STD_V_8 1 "VALID" 0 "INVALID" ;
VAL_ 418 OBJ_Angle_Bottom_V_8 1 "VALID" 0 "INVALID" ;
VAL_ 418 OBJ_Angle_Bottom_STD_V_8 1 "VALID" 0 "INVALID" ;
VAL_ 418 OBJ_Visibility_Side_V_8 1 "VALID" 0 "INVALID" ;
VAL_ 418 OBJ_Visibility_Side_8 2 "REAR" 1 "FRONT" 0 "NOT_VISIBLE" ;
VAL_ 418 OBJ_Is_In_Drivable_Area_8 1 "TRUE" 0 "FALSE" ;
VAL_ 418 OBJ_Is_In_Drivable_Area_V_8 1 "VALID" 0 "INVALID" ;
VAL_ 418 OBJ_Is_VeryClose_V_8 1 "VALID" 0 "INVALID" ;
VAL_ 418 OBJ_Is_VeryClose_8 1 "TRUE" 0 "FALSE" ;
VAL_ 418 OBJ_Is_EMERGENCY_VCL_8 1 "TRUE" 0 "FALSE" ;
VAL_ 418 OBJ_EMERGENCY_LIGHT_COLOR_8 3 "(1000)ORANGE" 2 "(0100)BLUE" 1 "(0010)RED" 0 "(0001)OTHER" ;
VAL_ 418 OBJ_EMERGENCY_V_8 1 "TRUE" 0 "FALSE" ;

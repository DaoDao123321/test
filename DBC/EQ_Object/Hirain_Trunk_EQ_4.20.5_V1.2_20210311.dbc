VERSION "created by canmatrix"

NS_ :

BS_:

BU_: ADAS ADU

BO_ 419 Core_Objects_protocol_9_0: 48 ADAS
 SG_ OBJ_Sync_ID_9_0 : 0|8@1+ (1,0) [0|255] "counter"  ADU
 SG_ OBJ_CRC_9 : 8|32@1+ (1,0) [0|4294970000] "NA"  ADU
 SG_ OBJ_ID_9 : 40|8@1+ (1,0) [0|255] "counter"  ADU
 SG_ OBJ_Existence_Probability_9 : 48|8@1+ (0.01,0) [0|1] "NA"  ADU
 SG_ OBJ_Motion_Category_9 : 56|4@1+ (1,0) [0|13] "ENUM"  ADU
 SG_ OBJ_Object_Age_9 : 60|11@1+ (1,0) [0|2047] "frames"  ADU
 SG_ OBJ_Measuring_Status_9 : 71|3@1+ (1,0) [0|7] "BITWIZE"  ADU
 SG_ OBJ_Object_Class_9 : 74|4@1+ (1,0) [0|8] "ENUM"  ADU
 SG_ OBJ_Class_Probability_9 : 78|7@1+ (0.01,0) [0|1] "NA"  ADU
 SG_ OBJ_Motion_Status_9 : 85|3@1+ (1,0) [0|5] "ENUM"  ADU
 SG_ OBJ_Motion_Orientation_9 : 88|4@1+ (1,0) [0|13] "ENUM"  ADU
 SG_ OBJ_Has_Cut_Lane_9 : 92|1@1+ (1,0) [0|1] "bool"  ADU
 SG_ OBJ_Has_Cut_Path_9 : 93|1@1+ (1,0) [0|1] "bool"  ADU
 SG_ OBJ_Brake_Light_9 : 94|1@1+ (1,0) [0|1] "bool"  ADU
 SG_ OBJ_Turn_Indicator_Right_9 : 95|1@1+ (1,0) [0|1] "bool"  ADU
 SG_ OBJ_Turn_Indicator_Left_9 : 96|1@1+ (1,0) [0|1] "bool"  ADU
 SG_ OBJ_Light_Indicator_Validity_9 : 97|1@1+ (1,0) [0|1] "bool"  ADU
 SG_ OBJ_Right_Out_Of_Image_9 : 98|1@1+ (1,0) [0|1] "bool"  ADU
 SG_ OBJ_Left_Out_Of_Image_9 : 99|1@1+ (1,0) [0|1] "bool"  ADU
 SG_ OBJ_Right_Out_Of_Image_V_9 : 100|1@1+ (1,0) [0|1] "bool"  ADU
 SG_ OBJ_Left_Out_Of_Image_V_9 : 101|1@1+ (1,0) [0|1] "bool"  ADU
 SG_ OBJ_Top_Out_Of_Image_9 : 102|1@1+ (1,0) [0|1] "bool"  ADU
 SG_ OBJ_Bottom_Out_Of_Image_9 : 103|1@1+ (1,0) [0|1] "bool"  ADU
 SG_ OBJ_Top_Out_Of_Image_V_9 : 104|1@1+ (1,0) [0|1] "bool"  ADU
 SG_ OBJ_Bottom_Out_Of_Image_V_9 : 105|1@1+ (1,0) [0|1] "bool"  ADU
 SG_ OBJ_Lane_Assignment_9 : 106|3@1+ (1,0) [0|5] "ENUM"  ADU
 SG_ OBJ_Lane_Assignment_V_9 : 109|1@1+ (1,0) [0|1] "bool"  ADU
 SG_ OBJ_Age_Seconds_9 : 110|7@1+ (1,0) [0|100] "s"  ADU
 SG_ OBJ_Age_Seconds_V_9 : 117|1@1+ (1,0) [0|1] "bool"  ADU
 SG_ OBJ_Width_9 : 118|9@1+ (0.01,0) [0.4|2.95] "m"  ADU
 SG_ OBJ_Width_V_9 : 127|1@1+ (1,0) [0|1] "bool"  ADU
 SG_ OBJ_Width_STD_9 : 128|11@1+ (0.001,0) [0|2] "m"  ADU
 SG_ OBJ_Width_STD_V_9 : 139|1@1+ (1,0) [0|1] "bool"  ADU
 SG_ OBJ_Length_9 : 140|9@1+ (0.05,0) [1.2|21] "m"  ADU
 SG_ OBJ_Length_V_9 : 149|1@1+ (1,0) [0|1] "bool"  ADU
 SG_ OBJ_Length_STD_9 : 150|10@1+ (0.01,0) [0|10] "m"  ADU
 SG_ OBJ_Length_STD_V_9 : 160|1@1+ (1,0) [0|1] "bool"  ADU
 SG_ OBJ_Height_9 : 161|9@1+ (0.01,0) [0|2.95] "m"  ADU
 SG_ OBJ_Height_V_9 : 170|1@1+ (1,0) [0|1] "bool"  ADU
 SG_ OBJ_Height_STD_9 : 171|11@1+ (0.001,0) [0|2] "m"  ADU
 SG_ OBJ_Height_STD_V_9 : 182|1@1+ (1,0) [0|1] "bool"  ADU
 SG_ OBJ_Abs_Long_Velocity_9 : 183|12@1+ (0.05,-100) [-100|100] "m_per_s"  ADU
 SG_ OBJ_Abs_Long_Velocity_V_9 : 195|1@1+ (1,0) [0|1] "bool"  ADU
 SG_ OBJ_Abs_Long_Velocity_STD_9 : 196|13@1+ (0.01,0) [0|65] "m_per_s"  ADU
 SG_ OBJ_Abs_Long_Vel_STD_V_9 : 209|1@1+ (1,0) [0|1] "bool"  ADU
 SG_ OBJ_Abs_Lat_Velocity_9 : 210|11@1+ (0.05,-50) [-50|50] "m_per_s"  ADU
 SG_ OBJ_Abs_Lat_Velocity_V_9 : 221|1@1+ (1,0) [0|1] "bool"  ADU
 SG_ OBJ_Abs_Lat_Velocity_STD_9 : 222|13@1+ (0.01,0) [0|50] "m_per_s"  ADU
 SG_ OBJ_Abs_Lat_Vel_STD_V_9 : 235|1@1+ (1,0) [0|1] "bool"  ADU
 SG_ OBJ_Abs_Long_Acc_9 : 236|9@1+ (0.05,-10) [-10|10] "m_per_s2"  ADU
 SG_ OBJ_Abs_Long_Acc_V_9 : 245|1@1+ (1,0) [0|1] "bool"  ADU
 SG_ OBJ_Abs_Long_Acc_STD_9 : 246|10@1+ (0.01,0) [0|7.3] "m_per_s2"  ADU
 SG_ OBJ_Abs_Long_Acc_STD_V_9 : 256|1@1+ (1,0) [0|1] "bool"  ADU
 SG_ OBJ_Abs_Lat_Acc_9 : 257|9@1+ (0.05,-10.3) [-10.3|7.3] "m_per_s2"  ADU
 SG_ OBJ_Abs_Lat_Acc_V_9 : 266|1@1+ (1,0) [0|1] "bool"  ADU
 SG_ OBJ_Abs_Lat_Acc_STD_9 : 267|10@1+ (0.01,0) [0|7.3] "m_per_s2"  ADU
 SG_ OBJ_Abs_Lat_Acc_STD_V_9 : 277|1@1+ (1,0) [0|1] "bool"  ADU
 SG_ OBJ_Abs_Acceleration_9 : 278|9@1+ (0.05,-10.3) [-10.3|7.3] "m_per_s2"  ADU
 SG_ OBJ_Abs_Acceleration_V_9 : 287|1@1+ (1,0) [0|1] "bool"  ADU
 SG_ OBJ_Abs_Acc_STD_9 : 288|10@1+ (0.01,0) [0|7.3] "m_per_s2"  ADU
 SG_ OBJ_Abs_Acc_STD_V_9 : 298|1@1+ (1,0) [0|1] "bool"  ADU
 SG_ OBJ_Inv_TTC_9 : 299|11@1+ (0.01,-8) [-8|8] "INV(s)"  ADU
 SG_ OBJ_Inv_TTC_V_9 : 310|1@1+ (1,0) [0|1] "bool"  ADU
 SG_ OBJ_Inv_TTC_STD_9 : 311|12@1+ (0.001,0) [0|4] "INV(s)"  ADU
 SG_ OBJ_Inv_TTC_STD_V_9 : 323|1@1+ (1,0) [0|1] "bool"  ADU
 SG_ OBJ_Relative_Long_Acc_9 : 324|10@1+ (0.05,-20) [-20|20] "m_per_s2"  ADU
 SG_ OBJ_Relative_Long_Acc_V_9 : 334|1@1+ (1,0) [0|1] "bool"  ADU
 SG_ OBJ_Relative_Long_Acc_STD_9 : 335|10@1+ (0.01,0) [0|7.3] "m_per_s2"  ADU
 SG_ OBJ_Rel_Long_Acc_STD_V_9 : 345|1@1+ (1,0) [0|1] "bool"  ADU
 SG_ OBJ_Relative_Long_Velocity_9 : 346|13@1+ (0.05,-120) [-120|130] "m_per_s"  ADU
 SG_ OBJ_Relative_Long_Velocity_V_9 : 359|1@1+ (1,0) [0|1] "bool"  ADU
 SG_ OBJ_Relative_Long_Vel_STD_9 : 360|14@1+ (0.01,0) [0|130] "m_per_s"  ADU
 SG_ OBJ_Rel_Long_Vel_STD_V_9 : 374|1@1+ (1,0) [0|1] "bool"  ADU

BO_ 420 Core_Objects_protocol_9_1: 48 ADAS
 SG_ OBJ_Sync_ID_9_1 : 0|8@1+ (1,0) [0|255] "counter"  ADU
 SG_ OBJ_Relative_Lat_Velocity_9 : 8|11@1+ (0.05,-50) [-50|50] "m_per_s"  ADU
 SG_ OBJ_Relative_Lat_Velocity_V_9 : 19|1@1+ (1,0) [0|1] "bool"  ADU
 SG_ OBJ_Relative_Lat_Velocity_STD_9 : 20|13@1+ (0.01,0) [0|50] "m_per_s"  ADU
 SG_ OBJ_Rel_Lat_Vel_STD_V_9 : 33|1@1+ (1,0) [0|1] "bool"  ADU
 SG_ OBJ_Long_Distance_9 : 34|14@1+ (0.05,-200) [-200|500] "m"  ADU
 SG_ OBJ_Long_Distance_V_9 : 48|1@1+ (1,0) [0|1] "bool"  ADU
 SG_ OBJ_Long_Distance_STD_9 : 49|15@1+ (0.01,0) [0|250] "m"  ADU
 SG_ OBJ_Long_Distance_STD_V_9 : 64|1@1+ (1,0) [0|1] "bool"  ADU
 SG_ OBJ_Lat_Distance_9 : 65|12@1+ (0.05,-100) [-100|100] "m"  ADU
 SG_ OBJ_Lat_Distance_V_9 : 77|1@1+ (1,0) [0|1] "bool"  ADU
 SG_ OBJ_Lat_Distance_STD_9 : 78|14@1+ (0.01,0) [0|100] "m"  ADU
 SG_ OBJ_Lat_Distance_STD_V_9 : 92|1@1+ (1,0) [0|1] "bool"  ADU
 SG_ OBJ_Absolute_Speed_9 : 93|12@1+ (0.05,-65) [-65|65] "m_per_s"  ADU
 SG_ OBJ_Absolute_Speed_V_9 : 105|1@1+ (1,0) [0|1] "bool"  ADU
 SG_ OBJ_Absolute_Speed_STD_9 : 106|13@1+ (0.01,0) [0|65] "m_per_s"  ADU
 SG_ OBJ_Absolute_Speed_STD_V_9 : 119|1@1+ (1,0) [0|1] "bool"  ADU
 SG_ OBJ_Heading_9 : 120|10@1+ (0.01,-3.14) [-3.14|3.14] "rad"  ADU
 SG_ OBJ_Heading_V_9 : 130|1@1+ (1,0) [0|1] "bool"  ADU
 SG_ OBJ_Heading_STD_9 : 131|15@1+ (0.0001,0) [0|3.14] "rad"  ADU
 SG_ OBJ_Heading_STD_V_9 : 146|1@1+ (1,0) [0|1] "bool"  ADU
 SG_ OBJ_Angle_Rate_STD_9 : 147|15@1+ (0.0001,0) [0|2.2318] "RPS"  ADU
 SG_ OBJ_Angle_Rate_STD_V_9 : 162|1@1+ (1,0) [0|1] "bool"  ADU
 SG_ OBJ_Angle_Rate_9 : 163|12@1+ (0.002,-2.234) [-2.234|2.2318] "RPS"  ADU
 SG_ OBJ_Angle_Rate_V_9 : 175|1@1+ (1,0) [0|1] "bool"  ADU
 SG_ OBJ_Angle_Right_9 : 176|14@1+ (0.0002,-1.571) [-1.571|1.571] "rad"  ADU
 SG_ OBJ_Angle_Right_V_9 : 190|1@1+ (1,0) [0|1] "bool"  ADU
 SG_ OBJ_Angle_Right_STD_9 : 191|14@1+ (0.0001,0) [0|1.571] "rad"  ADU
 SG_ OBJ_Angle_Right_STD_V_9 : 205|1@1+ (1,0) [0|1] "bool"  ADU
 SG_ OBJ_Angle_Left_9 : 206|14@1+ (0.0002,-1.571) [-1.571|1.571] "rad"  ADU
 SG_ OBJ_Angle_Left_V_9 : 220|1@1+ (1,0) [0|1] "bool"  ADU
 SG_ OBJ_Angle_Left_STD_9 : 221|14@1+ (0.0001,0) [0|1.571] "rad"  ADU
 SG_ OBJ_Angle_Left_STD_V_9 : 235|1@1+ (1,0) [0|1] "bool"  ADU
 SG_ OBJ_Angle_Side_9 : 236|14@1+ (0.0002,-1.571) [-1.571|1.571] "rad"  ADU
 SG_ OBJ_Angle_Side_V_9 : 250|1@1+ (1,0) [0|1] "bool"  ADU
 SG_ OBJ_Angle_Side_STD_9 : 251|14@1+ (0.0001,0) [0|1.571] "rad"  ADU
 SG_ OBJ_Angle_Side_STD_V_9 : 265|1@1+ (1,0) [0|1] "bool"  ADU
 SG_ OBJ_Angle_Mid_V_9 : 266|1@1+ (1,0) [0|1] "bool"  ADU
 SG_ OBJ_Angle_Mid_9 : 267|14@1+ (0.0002,-1.571) [-1.571|1.571] "rad"  ADU
 SG_ OBJ_Angle_Mid_STD_9 : 281|14@1+ (0.0001,0) [0|1.571] "rad"  ADU
 SG_ OBJ_Angle_Mid_STD_V_9 : 295|1@1+ (1,0) [0|1] "bool"  ADU
 SG_ OBJ_Angle_Bottom_V_9 : 296|1@1+ (1,0) [0|1] "bool"  ADU
 SG_ OBJ_Angle_Bottom_9 : 297|14@1+ (0.0002,-1.571) [-1.571|1.571] "rad"  ADU
 SG_ OBJ_Angle_Bottom_STD_9 : 311|14@1+ (0.0001,0) [0|1.571] "rad"  ADU
 SG_ OBJ_Angle_Bottom_STD_V_9 : 325|1@1+ (1,0) [0|1] "bool"  ADU
 SG_ OBJ_Visibility_Side_V_9 : 326|1@1+ (1,0) [0|1] "bool"  ADU
 SG_ OBJ_Visibility_Side_9 : 327|2@1+ (1,0) [0|2] "ENUM"  ADU
 SG_ OBJ_Is_In_Drivable_Area_9 : 329|1@1+ (1,0) [0|1] "bool"  ADU
 SG_ OBJ_Is_In_Drivable_Area_V_9 : 330|1@1+ (1,0) [0|1] "bool"  ADU
 SG_ OBJ_Is_VeryClose_V_9 : 331|1@1+ (1,0) [0|1] "bool"  ADU
 SG_ OBJ_Is_VeryClose_9 : 332|1@1+ (1,0) [0|1] "bool"  ADU
 SG_ OBJ_Is_EMERGENCY_VCL_9 : 333|1@1+ (1,0) [0|1] "bool"  ADU
 SG_ OBJ_EMERGENCY_LIGHT_COLOR_9 : 334|4@1+ (1,0) [0|15] "BITWIZE"  ADU
 SG_ OBJ_EMERGENCY_V_9 : 338|1@1+ (1,0) [0|1] "bool"  ADU

BO_ 421 Core_Objects_protocol_10_0: 48 ADAS
 SG_ OBJ_Sync_ID_10_0 : 0|8@1+ (1,0) [0|255] "counter"  ADU
 SG_ OBJ_CRC_10 : 8|32@1+ (1,0) [0|4294970000] "NA"  ADU
 SG_ OBJ_ID_10 : 40|8@1+ (1,0) [0|255] "counter"  ADU
 SG_ OBJ_Existence_Probability_10 : 48|8@1+ (0.01,0) [0|1] "NA"  ADU
 SG_ OBJ_Motion_Category_10 : 56|4@1+ (1,0) [0|13] "ENUM"  ADU
 SG_ OBJ_Object_Age_10 : 60|11@1+ (1,0) [0|2047] "frames"  ADU
 SG_ OBJ_Measuring_Status_10 : 71|3@1+ (1,0) [0|7] "BITWIZE"  ADU
 SG_ OBJ_Object_Class_10 : 74|4@1+ (1,0) [0|8] "ENUM"  ADU
 SG_ OBJ_Class_Probability_10 : 78|7@1+ (0.01,0) [0|1] "NA"  ADU
 SG_ OBJ_Motion_Status_10 : 85|3@1+ (1,0) [0|5] "ENUM"  ADU
 SG_ OBJ_Motion_Orientation_10 : 88|4@1+ (1,0) [0|13] "ENUM"  ADU
 SG_ OBJ_Has_Cut_Lane_10 : 92|1@1+ (1,0) [0|1] "bool"  ADU
 SG_ OBJ_Has_Cut_Path_10 : 93|1@1+ (1,0) [0|1] "bool"  ADU
 SG_ OBJ_Brake_Light_10 : 94|1@1+ (1,0) [0|1] "bool"  ADU
 SG_ OBJ_Turn_Indicator_Right_10 : 95|1@1+ (1,0) [0|1] "bool"  ADU
 SG_ OBJ_Turn_Indicator_Left_10 : 96|1@1+ (1,0) [0|1] "bool"  ADU
 SG_ OBJ_Light_Indicator_Validity_10 : 97|1@1+ (1,0) [0|1] "bool"  ADU
 SG_ OBJ_Right_Out_Of_Image_10 : 98|1@1+ (1,0) [0|1] "bool"  ADU
 SG_ OBJ_Left_Out_Of_Image_10 : 99|1@1+ (1,0) [0|1] "bool"  ADU
 SG_ OBJ_Right_Out_Of_Image_V_10 : 100|1@1+ (1,0) [0|1] "bool"  ADU
 SG_ OBJ_Left_Out_Of_Image_V_10 : 101|1@1+ (1,0) [0|1] "bool"  ADU
 SG_ OBJ_Top_Out_Of_Image_10 : 102|1@1+ (1,0) [0|1] "bool"  ADU
 SG_ OBJ_Bottom_Out_Of_Image_10 : 103|1@1+ (1,0) [0|1] "bool"  ADU
 SG_ OBJ_Top_Out_Of_Image_V_10 : 104|1@1+ (1,0) [0|1] "bool"  ADU
 SG_ OBJ_Bottom_Out_Of_Image_V_10 : 105|1@1+ (1,0) [0|1] "bool"  ADU
 SG_ OBJ_Lane_Assignment_10 : 106|3@1+ (1,0) [0|5] "ENUM"  ADU
 SG_ OBJ_Lane_Assignment_V_10 : 109|1@1+ (1,0) [0|1] "bool"  ADU
 SG_ OBJ_Age_Seconds_10 : 110|7@1+ (1,0) [0|100] "s"  ADU
 SG_ OBJ_Age_Seconds_V_10 : 117|1@1+ (1,0) [0|1] "bool"  ADU
 SG_ OBJ_Width_10 : 118|9@1+ (0.01,0) [0.4|2.95] "m"  ADU
 SG_ OBJ_Width_V_10 : 127|1@1+ (1,0) [0|1] "bool"  ADU
 SG_ OBJ_Width_STD_10 : 128|11@1+ (0.001,0) [0|2] "m"  ADU
 SG_ OBJ_Width_STD_V_10 : 139|1@1+ (1,0) [0|1] "bool"  ADU
 SG_ OBJ_Length_10 : 140|9@1+ (0.05,0) [1.2|21] "m"  ADU
 SG_ OBJ_Length_V_10 : 149|1@1+ (1,0) [0|1] "bool"  ADU
 SG_ OBJ_Length_STD_10 : 150|10@1+ (0.01,0) [0|10] "m"  ADU
 SG_ OBJ_Length_STD_V_10 : 160|1@1+ (1,0) [0|1] "bool"  ADU
 SG_ OBJ_Height_10 : 161|9@1+ (0.01,0) [0|2.95] "m"  ADU
 SG_ OBJ_Height_V_10 : 170|1@1+ (1,0) [0|1] "bool"  ADU
 SG_ OBJ_Height_STD_10 : 171|11@1+ (0.001,0) [0|2] "m"  ADU
 SG_ OBJ_Height_STD_V_10 : 182|1@1+ (1,0) [0|1] "bool"  ADU
 SG_ OBJ_Abs_Long_Velocity_10 : 183|12@1+ (0.05,-100) [-100|100] "m_per_s"  ADU
 SG_ OBJ_Abs_Long_Velocity_V_10 : 195|1@1+ (1,0) [0|1] "bool"  ADU
 SG_ OBJ_Abs_Long_Velocity_STD_10 : 196|13@1+ (0.01,0) [0|65] "m_per_s"  ADU
 SG_ OBJ_Abs_Long_Vel_STD_V_10 : 209|1@1+ (1,0) [0|1] "bool"  ADU
 SG_ OBJ_Abs_Lat_Velocity_10 : 210|11@1+ (0.05,-50) [-50|50] "m_per_s"  ADU
 SG_ OBJ_Abs_Lat_Velocity_V_10 : 221|1@1+ (1,0) [0|1] "bool"  ADU
 SG_ OBJ_Abs_Lat_Velocity_STD_10 : 222|13@1+ (0.01,0) [0|50] "m_per_s"  ADU
 SG_ OBJ_Abs_Lat_Vel_STD_V_10 : 235|1@1+ (1,0) [0|1] "bool"  ADU
 SG_ OBJ_Abs_Long_Acc_10 : 236|9@1+ (0.05,-10) [-10|10] "m_per_s2"  ADU
 SG_ OBJ_Abs_Long_Acc_V_10 : 245|1@1+ (1,0) [0|1] "bool"  ADU
 SG_ OBJ_Abs_Long_Acc_STD_10 : 246|10@1+ (0.01,0) [0|7.3] "m_per_s2"  ADU
 SG_ OBJ_Abs_Long_Acc_STD_V_10 : 256|1@1+ (1,0) [0|1] "bool"  ADU
 SG_ OBJ_Abs_Lat_Acc_10 : 257|9@1+ (0.05,-10.3) [-10.3|7.3] "m_per_s2"  ADU
 SG_ OBJ_Abs_Lat_Acc_V_10 : 266|1@1+ (1,0) [0|1] "bool"  ADU
 SG_ OBJ_Abs_Lat_Acc_STD_10 : 267|10@1+ (0.01,0) [0|7.3] "m_per_s2"  ADU
 SG_ OBJ_Abs_Lat_Acc_STD_V_10 : 277|1@1+ (1,0) [0|1] "bool"  ADU
 SG_ OBJ_Abs_Acceleration_10 : 278|9@1+ (0.05,-10.3) [-10.3|7.3] "m_per_s2"  ADU
 SG_ OBJ_Abs_Acceleration_V_10 : 287|1@1+ (1,0) [0|1] "bool"  ADU
 SG_ OBJ_Abs_Acc_STD_10 : 288|10@1+ (0.01,0) [0|7.3] "m_per_s2"  ADU
 SG_ OBJ_Abs_Acc_STD_V_10 : 298|1@1+ (1,0) [0|1] "bool"  ADU
 SG_ OBJ_Inv_TTC_10 : 299|11@1+ (0.01,-8) [-8|8] "INV(s)"  ADU
 SG_ OBJ_Inv_TTC_V_10 : 310|1@1+ (1,0) [0|1] "bool"  ADU
 SG_ OBJ_Inv_TTC_STD_10 : 311|12@1+ (0.001,0) [0|4] "INV(s)"  ADU
 SG_ OBJ_Inv_TTC_STD_V_10 : 323|1@1+ (1,0) [0|1] "bool"  ADU
 SG_ OBJ_Relative_Long_Acc_10 : 324|10@1+ (0.05,-20) [-20|20] "m_per_s2"  ADU
 SG_ OBJ_Relative_Long_Acc_V_10 : 334|1@1+ (1,0) [0|1] "bool"  ADU
 SG_ OBJ_Relative_Long_Acc_STD_10 : 335|10@1+ (0.01,0) [0|7.3] "m_per_s2"  ADU
 SG_ OBJ_Rel_Long_Acc_STD_V_10 : 345|1@1+ (1,0) [0|1] "bool"  ADU
 SG_ OBJ_Relative_Long_Velocity_10 : 346|13@1+ (0.05,-120) [-120|130] "m_per_s"  ADU
 SG_ OBJ_Relative_Long_Velocity_V_10 : 359|1@1+ (1,0) [0|1] "bool"  ADU
 SG_ OBJ_Relative_Long_Vel_STD_10 : 360|14@1+ (0.01,0) [0|130] "m_per_s"  ADU
 SG_ OBJ_Rel_Long_Vel_STD_V_10 : 374|1@1+ (1,0) [0|1] "bool"  ADU

BO_ 422 Core_Objects_protocol_10_1: 48 ADAS
 SG_ OBJ_Sync_ID_10_1 : 0|8@1+ (1,0) [0|255] "counter"  ADU
 SG_ OBJ_Relative_Lat_Velocity_10 : 8|11@1+ (0.05,-50) [-50|50] "m_per_s"  ADU
 SG_ OBJ_Relative_Lat_Velocity_V_10 : 19|1@1+ (1,0) [0|1] "bool"  ADU
 SG_ OBJ_Relative_Lat_Velocity_STD_10 : 20|13@1+ (0.01,0) [0|50] "m_per_s"  ADU
 SG_ OBJ_Rel_Lat_Vel_STD_V_10 : 33|1@1+ (1,0) [0|1] "bool"  ADU
 SG_ OBJ_Long_Distance_10 : 34|14@1+ (0.05,-200) [-200|500] "m"  ADU
 SG_ OBJ_Long_Distance_V_10 : 48|1@1+ (1,0) [0|1] "bool"  ADU
 SG_ OBJ_Long_Distance_STD_10 : 49|15@1+ (0.01,0) [0|250] "m"  ADU
 SG_ OBJ_Long_Distance_STD_V_10 : 64|1@1+ (1,0) [0|1] "bool"  ADU
 SG_ OBJ_Lat_Distance_10 : 65|12@1+ (0.05,-100) [-100|100] "m"  ADU
 SG_ OBJ_Lat_Distance_V_10 : 77|1@1+ (1,0) [0|1] "bool"  ADU
 SG_ OBJ_Lat_Distance_STD_10 : 78|14@1+ (0.01,0) [0|100] "m"  ADU
 SG_ OBJ_Lat_Distance_STD_V_10 : 92|1@1+ (1,0) [0|1] "bool"  ADU
 SG_ OBJ_Absolute_Speed_10 : 93|12@1+ (0.05,-65) [-65|65] "m_per_s"  ADU
 SG_ OBJ_Absolute_Speed_V_10 : 105|1@1+ (1,0) [0|1] "bool"  ADU
 SG_ OBJ_Absolute_Speed_STD_10 : 106|13@1+ (0.01,0) [0|65] "m_per_s"  ADU
 SG_ OBJ_Absolute_Speed_STD_V_10 : 119|1@1+ (1,0) [0|1] "bool"  ADU
 SG_ OBJ_Heading_10 : 120|10@1+ (0.01,-3.14) [-3.14|3.14] "rad"  ADU
 SG_ OBJ_Heading_V_10 : 130|1@1+ (1,0) [0|1] "bool"  ADU
 SG_ OBJ_Heading_STD_10 : 131|15@1+ (0.0001,0) [0|3.14] "rad"  ADU
 SG_ OBJ_Heading_STD_V_10 : 146|1@1+ (1,0) [0|1] "bool"  ADU
 SG_ OBJ_Angle_Rate_STD_10 : 147|15@1+ (0.0001,0) [0|2.2318] "RPS"  ADU
 SG_ OBJ_Angle_Rate_STD_V_10 : 162|1@1+ (1,0) [0|1] "bool"  ADU
 SG_ OBJ_Angle_Rate_10 : 163|12@1+ (0.002,-2.234) [-2.234|2.2318] "RPS"  ADU
 SG_ OBJ_Angle_Rate_V_10 : 175|1@1+ (1,0) [0|1] "bool"  ADU
 SG_ OBJ_Angle_Right_10 : 176|14@1+ (0.0002,-1.571) [-1.571|1.571] "rad"  ADU
 SG_ OBJ_Angle_Right_V_10 : 190|1@1+ (1,0) [0|1] "bool"  ADU
 SG_ OBJ_Angle_Right_STD_10 : 191|14@1+ (0.0001,0) [0|1.571] "rad"  ADU
 SG_ OBJ_Angle_Right_STD_V_10 : 205|1@1+ (1,0) [0|1] "bool"  ADU
 SG_ OBJ_Angle_Left_10 : 206|14@1+ (0.0002,-1.571) [-1.571|1.571] "rad"  ADU
 SG_ OBJ_Angle_Left_V_10 : 220|1@1+ (1,0) [0|1] "bool"  ADU
 SG_ OBJ_Angle_Left_STD_10 : 221|14@1+ (0.0001,0) [0|1.571] "rad"  ADU
 SG_ OBJ_Angle_Left_STD_V_10 : 235|1@1+ (1,0) [0|1] "bool"  ADU
 SG_ OBJ_Angle_Side_10 : 236|14@1+ (0.0002,-1.571) [-1.571|1.571] "rad"  ADU
 SG_ OBJ_Angle_Side_V_10 : 250|1@1+ (1,0) [0|1] "bool"  ADU
 SG_ OBJ_Angle_Side_STD_10 : 251|14@1+ (0.0001,0) [0|1.571] "rad"  ADU
 SG_ OBJ_Angle_Side_STD_V_10 : 265|1@1+ (1,0) [0|1] "bool"  ADU
 SG_ OBJ_Angle_Mid_V_10 : 266|1@1+ (1,0) [0|1] "bool"  ADU
 SG_ OBJ_Angle_Mid_10 : 267|14@1+ (0.0002,-1.571) [-1.571|1.571] "rad"  ADU
 SG_ OBJ_Angle_Mid_STD_10 : 281|14@1+ (0.0001,0) [0|1.571] "rad"  ADU
 SG_ OBJ_Angle_Mid_STD_V_10 : 295|1@1+ (1,0) [0|1] "bool"  ADU
 SG_ OBJ_Angle_Bottom_V_10 : 296|1@1+ (1,0) [0|1] "bool"  ADU
 SG_ OBJ_Angle_Bottom_10 : 297|14@1+ (0.0002,-1.571) [-1.571|1.571] "rad"  ADU
 SG_ OBJ_Angle_Bottom_STD_10 : 311|14@1+ (0.0001,0) [0|1.571] "rad"  ADU
 SG_ OBJ_Angle_Bottom_STD_V_10 : 325|1@1+ (1,0) [0|1] "bool"  ADU
 SG_ OBJ_Visibility_Side_V_10 : 326|1@1+ (1,0) [0|1] "bool"  ADU
 SG_ OBJ_Visibility_Side_10 : 327|2@1+ (1,0) [0|2] "ENUM"  ADU
 SG_ OBJ_Is_In_Drivable_Area_10 : 329|1@1+ (1,0) [0|1] "bool"  ADU
 SG_ OBJ_Is_In_Drivable_Area_V_10 : 330|1@1+ (1,0) [0|1] "bool"  ADU
 SG_ OBJ_Is_VeryClose_V_10 : 331|1@1+ (1,0) [0|1] "bool"  ADU
 SG_ OBJ_Is_VeryClose_10 : 332|1@1+ (1,0) [0|1] "bool"  ADU
 SG_ OBJ_Is_EMERGENCY_VCL_10 : 333|1@1+ (1,0) [0|1] "bool"  ADU
 SG_ OBJ_EMERGENCY_LIGHT_COLOR_10 : 334|4@1+ (1,0) [0|15] "BITWIZE"  ADU
 SG_ OBJ_EMERGENCY_V_10 : 338|1@1+ (1,0) [0|1] "bool"  ADU

BO_ 423 Core_Objects_protocol_11_0: 48 ADAS
 SG_ OBJ_Sync_ID_11_0 : 0|8@1+ (1,0) [0|255] "counter"  ADU
 SG_ OBJ_CRC_11 : 8|32@1+ (1,0) [0|4294970000] "NA"  ADU
 SG_ OBJ_ID_11 : 40|8@1+ (1,0) [0|255] "counter"  ADU
 SG_ OBJ_Existence_Probability_11 : 48|8@1+ (0.01,0) [0|1] "NA"  ADU
 SG_ OBJ_Motion_Category_11 : 56|4@1+ (1,0) [0|13] "ENUM"  ADU
 SG_ OBJ_Object_Age_11 : 60|11@1+ (1,0) [0|2047] "frames"  ADU
 SG_ OBJ_Measuring_Status_11 : 71|3@1+ (1,0) [0|7] "BITWIZE"  ADU
 SG_ OBJ_Object_Class_11 : 74|4@1+ (1,0) [0|8] "ENUM"  ADU
 SG_ OBJ_Class_Probability_11 : 78|7@1+ (0.01,0) [0|1] "NA"  ADU
 SG_ OBJ_Motion_Status_11 : 85|3@1+ (1,0) [0|5] "ENUM"  ADU
 SG_ OBJ_Motion_Orientation_11 : 88|4@1+ (1,0) [0|13] "ENUM"  ADU
 SG_ OBJ_Has_Cut_Lane_11 : 92|1@1+ (1,0) [0|1] "bool"  ADU
 SG_ OBJ_Has_Cut_Path_11 : 93|1@1+ (1,0) [0|1] "bool"  ADU
 SG_ OBJ_Brake_Light_11 : 94|1@1+ (1,0) [0|1] "bool"  ADU
 SG_ OBJ_Turn_Indicator_Right_11 : 95|1@1+ (1,0) [0|1] "bool"  ADU
 SG_ OBJ_Turn_Indicator_Left_11 : 96|1@1+ (1,0) [0|1] "bool"  ADU
 SG_ OBJ_Light_Indicator_Validity_11 : 97|1@1+ (1,0) [0|1] "bool"  ADU
 SG_ OBJ_Right_Out_Of_Image_11 : 98|1@1+ (1,0) [0|1] "bool"  ADU
 SG_ OBJ_Left_Out_Of_Image_11 : 99|1@1+ (1,0) [0|1] "bool"  ADU
 SG_ OBJ_Right_Out_Of_Image_V_11 : 100|1@1+ (1,0) [0|1] "bool"  ADU
 SG_ OBJ_Left_Out_Of_Image_V_11 : 101|1@1+ (1,0) [0|1] "bool"  ADU
 SG_ OBJ_Top_Out_Of_Image_11 : 102|1@1+ (1,0) [0|1] "bool"  ADU
 SG_ OBJ_Bottom_Out_Of_Image_11 : 103|1@1+ (1,0) [0|1] "bool"  ADU
 SG_ OBJ_Top_Out_Of_Image_V_11 : 104|1@1+ (1,0) [0|1] "bool"  ADU
 SG_ OBJ_Bottom_Out_Of_Image_V_11 : 105|1@1+ (1,0) [0|1] "bool"  ADU
 SG_ OBJ_Lane_Assignment_11 : 106|3@1+ (1,0) [0|5] "ENUM"  ADU
 SG_ OBJ_Lane_Assignment_V_11 : 109|1@1+ (1,0) [0|1] "bool"  ADU
 SG_ OBJ_Age_Seconds_11 : 110|7@1+ (1,0) [0|100] "s"  ADU
 SG_ OBJ_Age_Seconds_V_11 : 117|1@1+ (1,0) [0|1] "bool"  ADU
 SG_ OBJ_Width_11 : 118|9@1+ (0.01,0) [0.4|2.95] "m"  ADU
 SG_ OBJ_Width_V_11 : 127|1@1+ (1,0) [0|1] "bool"  ADU
 SG_ OBJ_Width_STD_11 : 128|11@1+ (0.001,0) [0|2] "m"  ADU
 SG_ OBJ_Width_STD_V_11 : 139|1@1+ (1,0) [0|1] "bool"  ADU
 SG_ OBJ_Length_11 : 140|9@1+ (0.05,0) [1.2|21] "m"  ADU
 SG_ OBJ_Length_V_11 : 149|1@1+ (1,0) [0|1] "bool"  ADU
 SG_ OBJ_Length_STD_11 : 150|10@1+ (0.01,0) [0|10] "m"  ADU
 SG_ OBJ_Length_STD_V_11 : 160|1@1+ (1,0) [0|1] "bool"  ADU
 SG_ OBJ_Height_11 : 161|9@1+ (0.01,0) [0|2.95] "m"  ADU
 SG_ OBJ_Height_V_11 : 170|1@1+ (1,0) [0|1] "bool"  ADU
 SG_ OBJ_Height_STD_11 : 171|11@1+ (0.001,0) [0|2] "m"  ADU
 SG_ OBJ_Height_STD_V_11 : 182|1@1+ (1,0) [0|1] "bool"  ADU
 SG_ OBJ_Abs_Long_Velocity_11 : 183|12@1+ (0.05,-100) [-100|100] "m_per_s"  ADU
 SG_ OBJ_Abs_Long_Velocity_V_11 : 195|1@1+ (1,0) [0|1] "bool"  ADU
 SG_ OBJ_Abs_Long_Velocity_STD_11 : 196|13@1+ (0.01,0) [0|65] "m_per_s"  ADU
 SG_ OBJ_Abs_Long_Vel_STD_V_11 : 209|1@1+ (1,0) [0|1] "bool"  ADU
 SG_ OBJ_Abs_Lat_Velocity_11 : 210|11@1+ (0.05,-50) [-50|50] "m_per_s"  ADU
 SG_ OBJ_Abs_Lat_Velocity_V_11 : 221|1@1+ (1,0) [0|1] "bool"  ADU
 SG_ OBJ_Abs_Lat_Velocity_STD_11 : 222|13@1+ (0.01,0) [0|50] "m_per_s"  ADU
 SG_ OBJ_Abs_Lat_Vel_STD_V_11 : 235|1@1+ (1,0) [0|1] "bool"  ADU
 SG_ OBJ_Abs_Long_Acc_11 : 236|9@1+ (0.05,-10) [-10|10] "m_per_s2"  ADU
 SG_ OBJ_Abs_Long_Acc_V_11 : 245|1@1+ (1,0) [0|1] "bool"  ADU
 SG_ OBJ_Abs_Long_Acc_STD_11 : 246|10@1+ (0.01,0) [0|7.3] "m_per_s2"  ADU
 SG_ OBJ_Abs_Long_Acc_STD_V_11 : 256|1@1+ (1,0) [0|1] "bool"  ADU
 SG_ OBJ_Abs_Lat_Acc_11 : 257|9@1+ (0.05,-10.3) [-10.3|7.3] "m_per_s2"  ADU
 SG_ OBJ_Abs_Lat_Acc_V_11 : 266|1@1+ (1,0) [0|1] "bool"  ADU
 SG_ OBJ_Abs_Lat_Acc_STD_11 : 267|10@1+ (0.01,0) [0|7.3] "m_per_s2"  ADU
 SG_ OBJ_Abs_Lat_Acc_STD_V_11 : 277|1@1+ (1,0) [0|1] "bool"  ADU
 SG_ OBJ_Abs_Acceleration_11 : 278|9@1+ (0.05,-10.3) [-10.3|7.3] "m_per_s2"  ADU
 SG_ OBJ_Abs_Acceleration_V_11 : 287|1@1+ (1,0) [0|1] "bool"  ADU
 SG_ OBJ_Abs_Acc_STD_11 : 288|10@1+ (0.01,0) [0|7.3] "m_per_s2"  ADU
 SG_ OBJ_Abs_Acc_STD_V_11 : 298|1@1+ (1,0) [0|1] "bool"  ADU
 SG_ OBJ_Inv_TTC_11 : 299|11@1+ (0.01,-8) [-8|8] "INV(s)"  ADU
 SG_ OBJ_Inv_TTC_V_11 : 310|1@1+ (1,0) [0|1] "bool"  ADU
 SG_ OBJ_Inv_TTC_STD_11 : 311|12@1+ (0.001,0) [0|4] "INV(s)"  ADU
 SG_ OBJ_Inv_TTC_STD_V_11 : 323|1@1+ (1,0) [0|1] "bool"  ADU
 SG_ OBJ_Relative_Long_Acc_11 : 324|10@1+ (0.05,-20) [-20|20] "m_per_s2"  ADU
 SG_ OBJ_Relative_Long_Acc_V_11 : 334|1@1+ (1,0) [0|1] "bool"  ADU
 SG_ OBJ_Relative_Long_Acc_STD_11 : 335|10@1+ (0.01,0) [0|7.3] "m_per_s2"  ADU
 SG_ OBJ_Rel_Long_Acc_STD_V_11 : 345|1@1+ (1,0) [0|1] "bool"  ADU
 SG_ OBJ_Relative_Long_Velocity_11 : 346|13@1+ (0.05,-120) [-120|130] "m_per_s"  ADU
 SG_ OBJ_Relative_Long_Velocity_V_11 : 359|1@1+ (1,0) [0|1] "bool"  ADU
 SG_ OBJ_Relative_Long_Vel_STD_11 : 360|14@1+ (0.01,0) [0|130] "m_per_s"  ADU
 SG_ OBJ_Rel_Long_Vel_STD_V_11 : 374|1@1+ (1,0) [0|1] "bool"  ADU

BO_ 424 Core_Objects_protocol_11_1: 48 ADAS
 SG_ OBJ_Sync_ID_11_1 : 0|8@1+ (1,0) [0|255] "counter"  ADU
 SG_ OBJ_Relative_Lat_Velocity_11 : 8|11@1+ (0.05,-50) [-50|50] "m_per_s"  ADU
 SG_ OBJ_Relative_Lat_Velocity_V_11 : 19|1@1+ (1,0) [0|1] "bool"  ADU
 SG_ OBJ_Relative_Lat_Velocity_STD_11 : 20|13@1+ (0.01,0) [0|50] "m_per_s"  ADU
 SG_ OBJ_Rel_Lat_Vel_STD_V_11 : 33|1@1+ (1,0) [0|1] "bool"  ADU
 SG_ OBJ_Long_Distance_11 : 34|14@1+ (0.05,-200) [-200|500] "m"  ADU
 SG_ OBJ_Long_Distance_V_11 : 48|1@1+ (1,0) [0|1] "bool"  ADU
 SG_ OBJ_Long_Distance_STD_11 : 49|15@1+ (0.01,0) [0|250] "m"  ADU
 SG_ OBJ_Long_Distance_STD_V_11 : 64|1@1+ (1,0) [0|1] "bool"  ADU
 SG_ OBJ_Lat_Distance_11 : 65|12@1+ (0.05,-100) [-100|100] "m"  ADU
 SG_ OBJ_Lat_Distance_V_11 : 77|1@1+ (1,0) [0|1] "bool"  ADU
 SG_ OBJ_Lat_Distance_STD_11 : 78|14@1+ (0.01,0) [0|100] "m"  ADU
 SG_ OBJ_Lat_Distance_STD_V_11 : 92|1@1+ (1,0) [0|1] "bool"  ADU
 SG_ OBJ_Absolute_Speed_11 : 93|12@1+ (0.05,-65) [-65|65] "m_per_s"  ADU
 SG_ OBJ_Absolute_Speed_V_11 : 105|1@1+ (1,0) [0|1] "bool"  ADU
 SG_ OBJ_Absolute_Speed_STD_11 : 106|13@1+ (0.01,0) [0|65] "m_per_s"  ADU
 SG_ OBJ_Absolute_Speed_STD_V_11 : 119|1@1+ (1,0) [0|1] "bool"  ADU
 SG_ OBJ_Heading_11 : 120|10@1+ (0.01,-3.14) [-3.14|3.14] "rad"  ADU
 SG_ OBJ_Heading_V_11 : 130|1@1+ (1,0) [0|1] "bool"  ADU
 SG_ OBJ_Heading_STD_11 : 131|15@1+ (0.0001,0) [0|3.14] "rad"  ADU
 SG_ OBJ_Heading_STD_V_11 : 146|1@1+ (1,0) [0|1] "bool"  ADU
 SG_ OBJ_Angle_Rate_STD_11 : 147|15@1+ (0.0001,0) [0|2.2318] "RPS"  ADU
 SG_ OBJ_Angle_Rate_STD_V_11 : 162|1@1+ (1,0) [0|1] "bool"  ADU
 SG_ OBJ_Angle_Rate_11 : 163|12@1+ (0.002,-2.234) [-2.234|2.2318] "RPS"  ADU
 SG_ OBJ_Angle_Rate_V_11 : 175|1@1+ (1,0) [0|1] "bool"  ADU
 SG_ OBJ_Angle_Right_11 : 176|14@1+ (0.0002,-1.571) [-1.571|1.571] "rad"  ADU
 SG_ OBJ_Angle_Right_V_11 : 190|1@1+ (1,0) [0|1] "bool"  ADU
 SG_ OBJ_Angle_Right_STD_11 : 191|14@1+ (0.0001,0) [0|1.571] "rad"  ADU
 SG_ OBJ_Angle_Right_STD_V_11 : 205|1@1+ (1,0) [0|1] "bool"  ADU
 SG_ OBJ_Angle_Left_11 : 206|14@1+ (0.0002,-1.571) [-1.571|1.571] "rad"  ADU
 SG_ OBJ_Angle_Left_V_11 : 220|1@1+ (1,0) [0|1] "bool"  ADU
 SG_ OBJ_Angle_Left_STD_11 : 221|14@1+ (0.0001,0) [0|1.571] "rad"  ADU
 SG_ OBJ_Angle_Left_STD_V_11 : 235|1@1+ (1,0) [0|1] "bool"  ADU
 SG_ OBJ_Angle_Side_11 : 236|14@1+ (0.0002,-1.571) [-1.571|1.571] "rad"  ADU
 SG_ OBJ_Angle_Side_V_11 : 250|1@1+ (1,0) [0|1] "bool"  ADU
 SG_ OBJ_Angle_Side_STD_11 : 251|14@1+ (0.0001,0) [0|1.571] "rad"  ADU
 SG_ OBJ_Angle_Side_STD_V_11 : 265|1@1+ (1,0) [0|1] "bool"  ADU
 SG_ OBJ_Angle_Mid_V_11 : 266|1@1+ (1,0) [0|1] "bool"  ADU
 SG_ OBJ_Angle_Mid_11 : 267|14@1+ (0.0002,-1.571) [-1.571|1.571] "rad"  ADU
 SG_ OBJ_Angle_Mid_STD_11 : 281|14@1+ (0.0001,0) [0|1.571] "rad"  ADU
 SG_ OBJ_Angle_Mid_STD_V_11 : 295|1@1+ (1,0) [0|1] "bool"  ADU
 SG_ OBJ_Angle_Bottom_V_11 : 296|1@1+ (1,0) [0|1] "bool"  ADU
 SG_ OBJ_Angle_Bottom_11 : 297|14@1+ (0.0002,-1.571) [-1.571|1.571] "rad"  ADU
 SG_ OBJ_Angle_Bottom_STD_11 : 311|14@1+ (0.0001,0) [0|1.571] "rad"  ADU
 SG_ OBJ_Angle_Bottom_STD_V_11 : 325|1@1+ (1,0) [0|1] "bool"  ADU
 SG_ OBJ_Visibility_Side_V_11 : 326|1@1+ (1,0) [0|1] "bool"  ADU
 SG_ OBJ_Visibility_Side_11 : 327|2@1+ (1,0) [0|2] "ENUM"  ADU
 SG_ OBJ_Is_In_Drivable_Area_11 : 329|1@1+ (1,0) [0|1] "bool"  ADU
 SG_ OBJ_Is_In_Drivable_Area_V_11 : 330|1@1+ (1,0) [0|1] "bool"  ADU
 SG_ OBJ_Is_VeryClose_V_11 : 331|1@1+ (1,0) [0|1] "bool"  ADU
 SG_ OBJ_Is_VeryClose_11 : 332|1@1+ (1,0) [0|1] "bool"  ADU
 SG_ OBJ_Is_EMERGENCY_VCL_11 : 333|1@1+ (1,0) [0|1] "bool"  ADU
 SG_ OBJ_EMERGENCY_LIGHT_COLOR_11 : 334|4@1+ (1,0) [0|15] "BITWIZE"  ADU
 SG_ OBJ_EMERGENCY_V_11 : 338|1@1+ (1,0) [0|1] "bool"  ADU

BO_ 425 Core_Objects_protocol_12_0: 48 ADAS
 SG_ OBJ_Sync_ID_12_0 : 0|8@1+ (1,0) [0|255] "counter"  ADU
 SG_ OBJ_CRC_12 : 8|32@1+ (1,0) [0|4294970000] "NA"  ADU
 SG_ OBJ_ID_12 : 40|8@1+ (1,0) [0|255] "counter"  ADU
 SG_ OBJ_Existence_Probability_12 : 48|8@1+ (0.01,0) [0|1] "NA"  ADU
 SG_ OBJ_Motion_Category_12 : 56|4@1+ (1,0) [0|13] "ENUM"  ADU
 SG_ OBJ_Object_Age_12 : 60|11@1+ (1,0) [0|2047] "frames"  ADU
 SG_ OBJ_Measuring_Status_12 : 71|3@1+ (1,0) [0|7] "BITWIZE"  ADU
 SG_ OBJ_Object_Class_12 : 74|4@1+ (1,0) [0|8] "ENUM"  ADU
 SG_ OBJ_Class_Probability_12 : 78|7@1+ (0.01,0) [0|1] "NA"  ADU
 SG_ OBJ_Motion_Status_12 : 85|3@1+ (1,0) [0|5] "ENUM"  ADU
 SG_ OBJ_Motion_Orientation_12 : 88|4@1+ (1,0) [0|13] "ENUM"  ADU
 SG_ OBJ_Has_Cut_Lane_12 : 92|1@1+ (1,0) [0|1] "bool"  ADU
 SG_ OBJ_Has_Cut_Path_12 : 93|1@1+ (1,0) [0|1] "bool"  ADU
 SG_ OBJ_Brake_Light_12 : 94|1@1+ (1,0) [0|1] "bool"  ADU
 SG_ OBJ_Turn_Indicator_Right_12 : 95|1@1+ (1,0) [0|1] "bool"  ADU
 SG_ OBJ_Turn_Indicator_Left_12 : 96|1@1+ (1,0) [0|1] "bool"  ADU
 SG_ OBJ_Light_Indicator_Validity_12 : 97|1@1+ (1,0) [0|1] "bool"  ADU
 SG_ OBJ_Right_Out_Of_Image_12 : 98|1@1+ (1,0) [0|1] "bool"  ADU
 SG_ OBJ_Left_Out_Of_Image_12 : 99|1@1+ (1,0) [0|1] "bool"  ADU
 SG_ OBJ_Right_Out_Of_Image_V_12 : 100|1@1+ (1,0) [0|1] "bool"  ADU
 SG_ OBJ_Left_Out_Of_Image_V_12 : 101|1@1+ (1,0) [0|1] "bool"  ADU
 SG_ OBJ_Top_Out_Of_Image_12 : 102|1@1+ (1,0) [0|1] "bool"  ADU
 SG_ OBJ_Bottom_Out_Of_Image_12 : 103|1@1+ (1,0) [0|1] "bool"  ADU
 SG_ OBJ_Top_Out_Of_Image_V_12 : 104|1@1+ (1,0) [0|1] "bool"  ADU
 SG_ OBJ_Bottom_Out_Of_Image_V_12 : 105|1@1+ (1,0) [0|1] "bool"  ADU
 SG_ OBJ_Lane_Assignment_12 : 106|3@1+ (1,0) [0|5] "ENUM"  ADU
 SG_ OBJ_Lane_Assignment_V_12 : 109|1@1+ (1,0) [0|1] "bool"  ADU
 SG_ OBJ_Age_Seconds_12 : 110|7@1+ (1,0) [0|100] "s"  ADU
 SG_ OBJ_Age_Seconds_V_12 : 117|1@1+ (1,0) [0|1] "bool"  ADU
 SG_ OBJ_Width_12 : 118|9@1+ (0.01,0) [0.4|2.95] "m"  ADU
 SG_ OBJ_Width_V_12 : 127|1@1+ (1,0) [0|1] "bool"  ADU
 SG_ OBJ_Width_STD_12 : 128|11@1+ (0.001,0) [0|2] "m"  ADU
 SG_ OBJ_Width_STD_V_12 : 139|1@1+ (1,0) [0|1] "bool"  ADU
 SG_ OBJ_Length_12 : 140|9@1+ (0.05,0) [1.2|21] "m"  ADU
 SG_ OBJ_Length_V_12 : 149|1@1+ (1,0) [0|1] "bool"  ADU
 SG_ OBJ_Length_STD_12 : 150|10@1+ (0.01,0) [0|10] "m"  ADU
 SG_ OBJ_Length_STD_V_12 : 160|1@1+ (1,0) [0|1] "bool"  ADU
 SG_ OBJ_Height_12 : 161|9@1+ (0.01,0) [0|2.95] "m"  ADU
 SG_ OBJ_Height_V_12 : 170|1@1+ (1,0) [0|1] "bool"  ADU
 SG_ OBJ_Height_STD_12 : 171|11@1+ (0.001,0) [0|2] "m"  ADU
 SG_ OBJ_Height_STD_V_12 : 182|1@1+ (1,0) [0|1] "bool"  ADU
 SG_ OBJ_Abs_Long_Velocity_12 : 183|12@1+ (0.05,-100) [-100|100] "m_per_s"  ADU
 SG_ OBJ_Abs_Long_Velocity_V_12 : 195|1@1+ (1,0) [0|1] "bool"  ADU
 SG_ OBJ_Abs_Long_Velocity_STD_12 : 196|13@1+ (0.01,0) [0|65] "m_per_s"  ADU
 SG_ OBJ_Abs_Long_Vel_STD_V_12 : 209|1@1+ (1,0) [0|1] "bool"  ADU
 SG_ OBJ_Abs_Lat_Velocity_12 : 210|11@1+ (0.05,-50) [-50|50] "m_per_s"  ADU
 SG_ OBJ_Abs_Lat_Velocity_V_12 : 221|1@1+ (1,0) [0|1] "bool"  ADU
 SG_ OBJ_Abs_Lat_Velocity_STD_12 : 222|13@1+ (0.01,0) [0|50] "m_per_s"  ADU
 SG_ OBJ_Abs_Lat_Vel_STD_V_12 : 235|1@1+ (1,0) [0|1] "bool"  ADU
 SG_ OBJ_Abs_Long_Acc_12 : 236|9@1+ (0.05,-10) [-10|10] "m_per_s2"  ADU
 SG_ OBJ_Abs_Long_Acc_V_12 : 245|1@1+ (1,0) [0|1] "bool"  ADU
 SG_ OBJ_Abs_Long_Acc_STD_12 : 246|10@1+ (0.01,0) [0|7.3] "m_per_s2"  ADU
 SG_ OBJ_Abs_Long_Acc_STD_V_12 : 256|1@1+ (1,0) [0|1] "bool"  ADU
 SG_ OBJ_Abs_Lat_Acc_12 : 257|9@1+ (0.05,-10.3) [-10.3|7.3] "m_per_s2"  ADU
 SG_ OBJ_Abs_Lat_Acc_V_12 : 266|1@1+ (1,0) [0|1] "bool"  ADU
 SG_ OBJ_Abs_Lat_Acc_STD_12 : 267|10@1+ (0.01,0) [0|7.3] "m_per_s2"  ADU
 SG_ OBJ_Abs_Lat_Acc_STD_V_12 : 277|1@1+ (1,0) [0|1] "bool"  ADU
 SG_ OBJ_Abs_Acceleration_12 : 278|9@1+ (0.05,-10.3) [-10.3|7.3] "m_per_s2"  ADU
 SG_ OBJ_Abs_Acceleration_V_12 : 287|1@1+ (1,0) [0|1] "bool"  ADU
 SG_ OBJ_Abs_Acc_STD_12 : 288|10@1+ (0.01,0) [0|7.3] "m_per_s2"  ADU
 SG_ OBJ_Abs_Acc_STD_V_12 : 298|1@1+ (1,0) [0|1] "bool"  ADU
 SG_ OBJ_Inv_TTC_12 : 299|11@1+ (0.01,-8) [-8|8] "INV(s)"  ADU
 SG_ OBJ_Inv_TTC_V_12 : 310|1@1+ (1,0) [0|1] "bool"  ADU
 SG_ OBJ_Inv_TTC_STD_12 : 311|12@1+ (0.001,0) [0|4] "INV(s)"  ADU
 SG_ OBJ_Inv_TTC_STD_V_12 : 323|1@1+ (1,0) [0|1] "bool"  ADU
 SG_ OBJ_Relative_Long_Acc_12 : 324|10@1+ (0.05,-20) [-20|20] "m_per_s2"  ADU
 SG_ OBJ_Relative_Long_Acc_V_12 : 334|1@1+ (1,0) [0|1] "bool"  ADU
 SG_ OBJ_Relative_Long_Acc_STD_12 : 335|10@1+ (0.01,0) [0|7.3] "m_per_s2"  ADU
 SG_ OBJ_Rel_Long_Acc_STD_V_12 : 345|1@1+ (1,0) [0|1] "bool"  ADU
 SG_ OBJ_Relative_Long_Velocity_12 : 346|13@1+ (0.05,-120) [-120|130] "m_per_s"  ADU
 SG_ OBJ_Relative_Long_Velocity_V_12 : 359|1@1+ (1,0) [0|1] "bool"  ADU
 SG_ OBJ_Relative_Long_Vel_STD_12 : 360|14@1+ (0.01,0) [0|130] "m_per_s"  ADU
 SG_ OBJ_Rel_Long_Vel_STD_V_12 : 374|1@1+ (1,0) [0|1] "bool"  ADU

BO_ 426 Core_Objects_protocol_12_1: 48 ADAS
 SG_ OBJ_Sync_ID_12_1 : 0|8@1+ (1,0) [0|255] "counter"  ADU
 SG_ OBJ_Relative_Lat_Velocity_12 : 8|11@1+ (0.05,-50) [-50|50] "m_per_s"  ADU
 SG_ OBJ_Relative_Lat_Velocity_V_12 : 19|1@1+ (1,0) [0|1] "bool"  ADU
 SG_ OBJ_Relative_Lat_Velocity_STD_12 : 20|13@1+ (0.01,0) [0|50] "m_per_s"  ADU
 SG_ OBJ_Rel_Lat_Vel_STD_V_12 : 33|1@1+ (1,0) [0|1] "bool"  ADU
 SG_ OBJ_Long_Distance_12 : 34|14@1+ (0.05,-200) [-200|500] "m"  ADU
 SG_ OBJ_Long_Distance_V_12 : 48|1@1+ (1,0) [0|1] "bool"  ADU
 SG_ OBJ_Long_Distance_STD_12 : 49|15@1+ (0.01,0) [0|250] "m"  ADU
 SG_ OBJ_Long_Distance_STD_V_12 : 64|1@1+ (1,0) [0|1] "bool"  ADU
 SG_ OBJ_Lat_Distance_12 : 65|12@1+ (0.05,-100) [-100|100] "m"  ADU
 SG_ OBJ_Lat_Distance_V_12 : 77|1@1+ (1,0) [0|1] "bool"  ADU
 SG_ OBJ_Lat_Distance_STD_12 : 78|14@1+ (0.01,0) [0|100] "m"  ADU
 SG_ OBJ_Lat_Distance_STD_V_12 : 92|1@1+ (1,0) [0|1] "bool"  ADU
 SG_ OBJ_Absolute_Speed_12 : 93|12@1+ (0.05,-65) [-65|65] "m_per_s"  ADU
 SG_ OBJ_Absolute_Speed_V_12 : 105|1@1+ (1,0) [0|1] "bool"  ADU
 SG_ OBJ_Absolute_Speed_STD_12 : 106|13@1+ (0.01,0) [0|65] "m_per_s"  ADU
 SG_ OBJ_Absolute_Speed_STD_V_12 : 119|1@1+ (1,0) [0|1] "bool"  ADU
 SG_ OBJ_Heading_12 : 120|10@1+ (0.01,-3.14) [-3.14|3.14] "rad"  ADU
 SG_ OBJ_Heading_V_12 : 130|1@1+ (1,0) [0|1] "bool"  ADU
 SG_ OBJ_Heading_STD_12 : 131|15@1+ (0.0001,0) [0|3.14] "rad"  ADU
 SG_ OBJ_Heading_STD_V_12 : 146|1@1+ (1,0) [0|1] "bool"  ADU
 SG_ OBJ_Angle_Rate_STD_12 : 147|15@1+ (0.0001,0) [0|2.2318] "RPS"  ADU
 SG_ OBJ_Angle_Rate_STD_V_12 : 162|1@1+ (1,0) [0|1] "bool"  ADU
 SG_ OBJ_Angle_Rate_12 : 163|12@1+ (0.002,-2.234) [-2.234|2.2318] "RPS"  ADU
 SG_ OBJ_Angle_Rate_V_12 : 175|1@1+ (1,0) [0|1] "bool"  ADU
 SG_ OBJ_Angle_Right_12 : 176|14@1+ (0.0002,-1.571) [-1.571|1.571] "rad"  ADU
 SG_ OBJ_Angle_Right_V_12 : 190|1@1+ (1,0) [0|1] "bool"  ADU
 SG_ OBJ_Angle_Right_STD_12 : 191|14@1+ (0.0001,0) [0|1.571] "rad"  ADU
 SG_ OBJ_Angle_Right_STD_V_12 : 205|1@1+ (1,0) [0|1] "bool"  ADU
 SG_ OBJ_Angle_Left_12 : 206|14@1+ (0.0002,-1.571) [-1.571|1.571] "rad"  ADU
 SG_ OBJ_Angle_Left_V_12 : 220|1@1+ (1,0) [0|1] "bool"  ADU
 SG_ OBJ_Angle_Left_STD_12 : 221|14@1+ (0.0001,0) [0|1.571] "rad"  ADU
 SG_ OBJ_Angle_Left_STD_V_12 : 235|1@1+ (1,0) [0|1] "bool"  ADU
 SG_ OBJ_Angle_Side_12 : 236|14@1+ (0.0002,-1.571) [-1.571|1.571] "rad"  ADU
 SG_ OBJ_Angle_Side_V_12 : 250|1@1+ (1,0) [0|1] "bool"  ADU
 SG_ OBJ_Angle_Side_STD_12 : 251|14@1+ (0.0001,0) [0|1.571] "rad"  ADU
 SG_ OBJ_Angle_Side_STD_V_12 : 265|1@1+ (1,0) [0|1] "bool"  ADU
 SG_ OBJ_Angle_Mid_V_12 : 266|1@1+ (1,0) [0|1] "bool"  ADU
 SG_ OBJ_Angle_Mid_12 : 267|14@1+ (0.0002,-1.571) [-1.571|1.571] "rad"  ADU
 SG_ OBJ_Angle_Mid_STD_12 : 281|14@1+ (0.0001,0) [0|1.571] "rad"  ADU
 SG_ OBJ_Angle_Mid_STD_V_12 : 295|1@1+ (1,0) [0|1] "bool"  ADU
 SG_ OBJ_Angle_Bottom_V_12 : 296|1@1+ (1,0) [0|1] "bool"  ADU
 SG_ OBJ_Angle_Bottom_12 : 297|14@1+ (0.0002,-1.571) [-1.571|1.571] "rad"  ADU
 SG_ OBJ_Angle_Bottom_STD_12 : 311|14@1+ (0.0001,0) [0|1.571] "rad"  ADU
 SG_ OBJ_Angle_Bottom_STD_V_12 : 325|1@1+ (1,0) [0|1] "bool"  ADU
 SG_ OBJ_Visibility_Side_V_12 : 326|1@1+ (1,0) [0|1] "bool"  ADU
 SG_ OBJ_Visibility_Side_12 : 327|2@1+ (1,0) [0|2] "ENUM"  ADU
 SG_ OBJ_Is_In_Drivable_Area_12 : 329|1@1+ (1,0) [0|1] "bool"  ADU
 SG_ OBJ_Is_In_Drivable_Area_V_12 : 330|1@1+ (1,0) [0|1] "bool"  ADU
 SG_ OBJ_Is_VeryClose_V_12 : 331|1@1+ (1,0) [0|1] "bool"  ADU
 SG_ OBJ_Is_VeryClose_12 : 332|1@1+ (1,0) [0|1] "bool"  ADU
 SG_ OBJ_Is_EMERGENCY_VCL_12 : 333|1@1+ (1,0) [0|1] "bool"  ADU
 SG_ OBJ_EMERGENCY_LIGHT_COLOR_12 : 334|4@1+ (1,0) [0|15] "BITWIZE"  ADU
 SG_ OBJ_EMERGENCY_V_12 : 338|1@1+ (1,0) [0|1] "bool"  ADU

BO_ 427 Core_Objects_protocol_13_0: 48 ADAS
 SG_ OBJ_Sync_ID_13_0 : 0|8@1+ (1,0) [0|255] "counter"  ADU
 SG_ OBJ_CRC_13 : 8|32@1+ (1,0) [0|4294970000] "NA"  ADU
 SG_ OBJ_ID_13 : 40|8@1+ (1,0) [0|255] "counter"  ADU
 SG_ OBJ_Existence_Probability_13 : 48|8@1+ (0.01,0) [0|1] "NA"  ADU
 SG_ OBJ_Motion_Category_13 : 56|4@1+ (1,0) [0|13] "ENUM"  ADU
 SG_ OBJ_Object_Age_13 : 60|11@1+ (1,0) [0|2047] "frames"  ADU
 SG_ OBJ_Measuring_Status_13 : 71|3@1+ (1,0) [0|7] "BITWIZE"  ADU
 SG_ OBJ_Object_Class_13 : 74|4@1+ (1,0) [0|8] "ENUM"  ADU
 SG_ OBJ_Class_Probability_13 : 78|7@1+ (0.01,0) [0|1] "NA"  ADU
 SG_ OBJ_Motion_Status_13 : 85|3@1+ (1,0) [0|5] "ENUM"  ADU
 SG_ OBJ_Motion_Orientation_13 : 88|4@1+ (1,0) [0|13] "ENUM"  ADU
 SG_ OBJ_Has_Cut_Lane_13 : 92|1@1+ (1,0) [0|1] "bool"  ADU
 SG_ OBJ_Has_Cut_Path_13 : 93|1@1+ (1,0) [0|1] "bool"  ADU
 SG_ OBJ_Brake_Light_13 : 94|1@1+ (1,0) [0|1] "bool"  ADU
 SG_ OBJ_Turn_Indicator_Right_13 : 95|1@1+ (1,0) [0|1] "bool"  ADU
 SG_ OBJ_Turn_Indicator_Left_13 : 96|1@1+ (1,0) [0|1] "bool"  ADU
 SG_ OBJ_Light_Indicator_Validity_13 : 97|1@1+ (1,0) [0|1] "bool"  ADU
 SG_ OBJ_Right_Out_Of_Image_13 : 98|1@1+ (1,0) [0|1] "bool"  ADU
 SG_ OBJ_Left_Out_Of_Image_13 : 99|1@1+ (1,0) [0|1] "bool"  ADU
 SG_ OBJ_Right_Out_Of_Image_V_13 : 100|1@1+ (1,0) [0|1] "bool"  ADU
 SG_ OBJ_Left_Out_Of_Image_V_13 : 101|1@1+ (1,0) [0|1] "bool"  ADU
 SG_ OBJ_Top_Out_Of_Image_13 : 102|1@1+ (1,0) [0|1] "bool"  ADU
 SG_ OBJ_Bottom_Out_Of_Image_13 : 103|1@1+ (1,0) [0|1] "bool"  ADU
 SG_ OBJ_Top_Out_Of_Image_V_13 : 104|1@1+ (1,0) [0|1] "bool"  ADU
 SG_ OBJ_Bottom_Out_Of_Image_V_13 : 105|1@1+ (1,0) [0|1] "bool"  ADU
 SG_ OBJ_Lane_Assignment_13 : 106|3@1+ (1,0) [0|5] "ENUM"  ADU
 SG_ OBJ_Lane_Assignment_V_13 : 109|1@1+ (1,0) [0|1] "bool"  ADU
 SG_ OBJ_Age_Seconds_13 : 110|7@1+ (1,0) [0|100] "s"  ADU
 SG_ OBJ_Age_Seconds_V_13 : 117|1@1+ (1,0) [0|1] "bool"  ADU
 SG_ OBJ_Width_13 : 118|9@1+ (0.01,0) [0.4|2.95] "m"  ADU
 SG_ OBJ_Width_V_13 : 127|1@1+ (1,0) [0|1] "bool"  ADU
 SG_ OBJ_Width_STD_13 : 128|11@1+ (0.001,0) [0|2] "m"  ADU
 SG_ OBJ_Width_STD_V_13 : 139|1@1+ (1,0) [0|1] "bool"  ADU
 SG_ OBJ_Length_13 : 140|9@1+ (0.05,0) [1.2|21] "m"  ADU
 SG_ OBJ_Length_V_13 : 149|1@1+ (1,0) [0|1] "bool"  ADU
 SG_ OBJ_Length_STD_13 : 150|10@1+ (0.01,0) [0|10] "m"  ADU
 SG_ OBJ_Length_STD_V_13 : 160|1@1+ (1,0) [0|1] "bool"  ADU
 SG_ OBJ_Height_13 : 161|9@1+ (0.01,0) [0|2.95] "m"  ADU
 SG_ OBJ_Height_V_13 : 170|1@1+ (1,0) [0|1] "bool"  ADU
 SG_ OBJ_Height_STD_13 : 171|11@1+ (0.001,0) [0|2] "m"  ADU
 SG_ OBJ_Height_STD_V_13 : 182|1@1+ (1,0) [0|1] "bool"  ADU
 SG_ OBJ_Abs_Long_Velocity_13 : 183|12@1+ (0.05,-100) [-100|100] "m_per_s"  ADU
 SG_ OBJ_Abs_Long_Velocity_V_13 : 195|1@1+ (1,0) [0|1] "bool"  ADU
 SG_ OBJ_Abs_Long_Velocity_STD_13 : 196|13@1+ (0.01,0) [0|65] "m_per_s"  ADU
 SG_ OBJ_Abs_Long_Vel_STD_V_13 : 209|1@1+ (1,0) [0|1] "bool"  ADU
 SG_ OBJ_Abs_Lat_Velocity_13 : 210|11@1+ (0.05,-50) [-50|50] "m_per_s"  ADU
 SG_ OBJ_Abs_Lat_Velocity_V_13 : 221|1@1+ (1,0) [0|1] "bool"  ADU
 SG_ OBJ_Abs_Lat_Velocity_STD_13 : 222|13@1+ (0.01,0) [0|50] "m_per_s"  ADU
 SG_ OBJ_Abs_Lat_Vel_STD_V_13 : 235|1@1+ (1,0) [0|1] "bool"  ADU
 SG_ OBJ_Abs_Long_Acc_13 : 236|9@1+ (0.05,-10) [-10|10] "m_per_s2"  ADU
 SG_ OBJ_Abs_Long_Acc_V_13 : 245|1@1+ (1,0) [0|1] "bool"  ADU
 SG_ OBJ_Abs_Long_Acc_STD_13 : 246|10@1+ (0.01,0) [0|7.3] "m_per_s2"  ADU
 SG_ OBJ_Abs_Long_Acc_STD_V_13 : 256|1@1+ (1,0) [0|1] "bool"  ADU
 SG_ OBJ_Abs_Lat_Acc_13 : 257|9@1+ (0.05,-10.3) [-10.3|7.3] "m_per_s2"  ADU
 SG_ OBJ_Abs_Lat_Acc_V_13 : 266|1@1+ (1,0) [0|1] "bool"  ADU
 SG_ OBJ_Abs_Lat_Acc_STD_13 : 267|10@1+ (0.01,0) [0|7.3] "m_per_s2"  ADU
 SG_ OBJ_Abs_Lat_Acc_STD_V_13 : 277|1@1+ (1,0) [0|1] "bool"  ADU
 SG_ OBJ_Abs_Acceleration_13 : 278|9@1+ (0.05,-10.3) [-10.3|7.3] "m_per_s2"  ADU
 SG_ OBJ_Abs_Acceleration_V_13 : 287|1@1+ (1,0) [0|1] "bool"  ADU
 SG_ OBJ_Abs_Acc_STD_13 : 288|10@1+ (0.01,0) [0|7.3] "m_per_s2"  ADU
 SG_ OBJ_Abs_Acc_STD_V_13 : 298|1@1+ (1,0) [0|1] "bool"  ADU
 SG_ OBJ_Inv_TTC_13 : 299|11@1+ (0.01,-8) [-8|8] "INV(s)"  ADU
 SG_ OBJ_Inv_TTC_V_13 : 310|1@1+ (1,0) [0|1] "bool"  ADU
 SG_ OBJ_Inv_TTC_STD_13 : 311|12@1+ (0.001,0) [0|4] "INV(s)"  ADU
 SG_ OBJ_Inv_TTC_STD_V_13 : 323|1@1+ (1,0) [0|1] "bool"  ADU
 SG_ OBJ_Relative_Long_Acc_13 : 324|10@1+ (0.05,-20) [-20|20] "m_per_s2"  ADU
 SG_ OBJ_Relative_Long_Acc_V_13 : 334|1@1+ (1,0) [0|1] "bool"  ADU
 SG_ OBJ_Relative_Long_Acc_STD_13 : 335|10@1+ (0.01,0) [0|7.3] "m_per_s2"  ADU
 SG_ OBJ_Rel_Long_Acc_STD_V_13 : 345|1@1+ (1,0) [0|1] "bool"  ADU
 SG_ OBJ_Relative_Long_Velocity_13 : 346|13@1+ (0.05,-120) [-120|130] "m_per_s"  ADU
 SG_ OBJ_Relative_Long_Velocity_V_13 : 359|1@1+ (1,0) [0|1] "bool"  ADU
 SG_ OBJ_Relative_Long_Vel_STD_13 : 360|14@1+ (0.01,0) [0|130] "m_per_s"  ADU
 SG_ OBJ_Rel_Long_Vel_STD_V_13 : 374|1@1+ (1,0) [0|1] "bool"  ADU

BO_ 428 Core_Objects_protocol_13_1: 48 ADAS
 SG_ OBJ_Sync_ID_13_1 : 0|8@1+ (1,0) [0|255] "counter"  ADU
 SG_ OBJ_Relative_Lat_Velocity_13 : 8|11@1+ (0.05,-50) [-50|50] "m_per_s"  ADU
 SG_ OBJ_Relative_Lat_Velocity_V_13 : 19|1@1+ (1,0) [0|1] "bool"  ADU
 SG_ OBJ_Relative_Lat_Velocity_STD_13 : 20|13@1+ (0.01,0) [0|50] "m_per_s"  ADU
 SG_ OBJ_Rel_Lat_Vel_STD_V_13 : 33|1@1+ (1,0) [0|1] "bool"  ADU
 SG_ OBJ_Long_Distance_13 : 34|14@1+ (0.05,-200) [-200|500] "m"  ADU
 SG_ OBJ_Long_Distance_V_13 : 48|1@1+ (1,0) [0|1] "bool"  ADU
 SG_ OBJ_Long_Distance_STD_13 : 49|15@1+ (0.01,0) [0|250] "m"  ADU
 SG_ OBJ_Long_Distance_STD_V_13 : 64|1@1+ (1,0) [0|1] "bool"  ADU
 SG_ OBJ_Lat_Distance_13 : 65|12@1+ (0.05,-100) [-100|100] "m"  ADU
 SG_ OBJ_Lat_Distance_V_13 : 77|1@1+ (1,0) [0|1] "bool"  ADU
 SG_ OBJ_Lat_Distance_STD_13 : 78|14@1+ (0.01,0) [0|100] "m"  ADU
 SG_ OBJ_Lat_Distance_STD_V_13 : 92|1@1+ (1,0) [0|1] "bool"  ADU
 SG_ OBJ_Absolute_Speed_13 : 93|12@1+ (0.05,-65) [-65|65] "m_per_s"  ADU
 SG_ OBJ_Absolute_Speed_V_13 : 105|1@1+ (1,0) [0|1] "bool"  ADU
 SG_ OBJ_Absolute_Speed_STD_13 : 106|13@1+ (0.01,0) [0|65] "m_per_s"  ADU
 SG_ OBJ_Absolute_Speed_STD_V_13 : 119|1@1+ (1,0) [0|1] "bool"  ADU
 SG_ OBJ_Heading_13 : 120|10@1+ (0.01,-3.14) [-3.14|3.14] "rad"  ADU
 SG_ OBJ_Heading_V_13 : 130|1@1+ (1,0) [0|1] "bool"  ADU
 SG_ OBJ_Heading_STD_13 : 131|15@1+ (0.0001,0) [0|3.14] "rad"  ADU
 SG_ OBJ_Heading_STD_V_13 : 146|1@1+ (1,0) [0|1] "bool"  ADU
 SG_ OBJ_Angle_Rate_STD_13 : 147|15@1+ (0.0001,0) [0|2.2318] "RPS"  ADU
 SG_ OBJ_Angle_Rate_STD_V_13 : 162|1@1+ (1,0) [0|1] "bool"  ADU
 SG_ OBJ_Angle_Rate_13 : 163|12@1+ (0.002,-2.234) [-2.234|2.2318] "RPS"  ADU
 SG_ OBJ_Angle_Rate_V_13 : 175|1@1+ (1,0) [0|1] "bool"  ADU
 SG_ OBJ_Angle_Right_13 : 176|14@1+ (0.0002,-1.571) [-1.571|1.571] "rad"  ADU
 SG_ OBJ_Angle_Right_V_13 : 190|1@1+ (1,0) [0|1] "bool"  ADU
 SG_ OBJ_Angle_Right_STD_13 : 191|14@1+ (0.0001,0) [0|1.571] "rad"  ADU
 SG_ OBJ_Angle_Right_STD_V_13 : 205|1@1+ (1,0) [0|1] "bool"  ADU
 SG_ OBJ_Angle_Left_13 : 206|14@1+ (0.0002,-1.571) [-1.571|1.571] "rad"  ADU
 SG_ OBJ_Angle_Left_V_13 : 220|1@1+ (1,0) [0|1] "bool"  ADU
 SG_ OBJ_Angle_Left_STD_13 : 221|14@1+ (0.0001,0) [0|1.571] "rad"  ADU
 SG_ OBJ_Angle_Left_STD_V_13 : 235|1@1+ (1,0) [0|1] "bool"  ADU
 SG_ OBJ_Angle_Side_13 : 236|14@1+ (0.0002,-1.571) [-1.571|1.571] "rad"  ADU
 SG_ OBJ_Angle_Side_V_13 : 250|1@1+ (1,0) [0|1] "bool"  ADU
 SG_ OBJ_Angle_Side_STD_13 : 251|14@1+ (0.0001,0) [0|1.571] "rad"  ADU
 SG_ OBJ_Angle_Side_STD_V_13 : 265|1@1+ (1,0) [0|1] "bool"  ADU
 SG_ OBJ_Angle_Mid_V_13 : 266|1@1+ (1,0) [0|1] "bool"  ADU
 SG_ OBJ_Angle_Mid_13 : 267|14@1+ (0.0002,-1.571) [-1.571|1.571] "rad"  ADU
 SG_ OBJ_Angle_Mid_STD_13 : 281|14@1+ (0.0001,0) [0|1.571] "rad"  ADU
 SG_ OBJ_Angle_Mid_STD_V_13 : 295|1@1+ (1,0) [0|1] "bool"  ADU
 SG_ OBJ_Angle_Bottom_V_13 : 296|1@1+ (1,0) [0|1] "bool"  ADU
 SG_ OBJ_Angle_Bottom_13 : 297|14@1+ (0.0002,-1.571) [-1.571|1.571] "rad"  ADU
 SG_ OBJ_Angle_Bottom_STD_13 : 311|14@1+ (0.0001,0) [0|1.571] "rad"  ADU
 SG_ OBJ_Angle_Bottom_STD_V_13 : 325|1@1+ (1,0) [0|1] "bool"  ADU
 SG_ OBJ_Visibility_Side_V_13 : 326|1@1+ (1,0) [0|1] "bool"  ADU
 SG_ OBJ_Visibility_Side_13 : 327|2@1+ (1,0) [0|2] "ENUM"  ADU
 SG_ OBJ_Is_In_Drivable_Area_13 : 329|1@1+ (1,0) [0|1] "bool"  ADU
 SG_ OBJ_Is_In_Drivable_Area_V_13 : 330|1@1+ (1,0) [0|1] "bool"  ADU
 SG_ OBJ_Is_VeryClose_V_13 : 331|1@1+ (1,0) [0|1] "bool"  ADU
 SG_ OBJ_Is_VeryClose_13 : 332|1@1+ (1,0) [0|1] "bool"  ADU
 SG_ OBJ_Is_EMERGENCY_VCL_13 : 333|1@1+ (1,0) [0|1] "bool"  ADU
 SG_ OBJ_EMERGENCY_LIGHT_COLOR_13 : 334|4@1+ (1,0) [0|15] "BITWIZE"  ADU
 SG_ OBJ_EMERGENCY_V_13 : 338|1@1+ (1,0) [0|1] "bool"  ADU

BO_ 429 Core_Objects_protocol_14_0: 48 ADAS
 SG_ OBJ_Sync_ID_14_0 : 0|8@1+ (1,0) [0|255] "counter"  ADU
 SG_ OBJ_CRC_14 : 8|32@1+ (1,0) [0|4294970000] "NA"  ADU
 SG_ OBJ_ID_14 : 40|8@1+ (1,0) [0|255] "counter"  ADU
 SG_ OBJ_Existence_Probability_14 : 48|8@1+ (0.01,0) [0|1] "NA"  ADU
 SG_ OBJ_Motion_Category_14 : 56|4@1+ (1,0) [0|13] "ENUM"  ADU
 SG_ OBJ_Buffer_C0_14 : 60|7@1+ (0.01,0) [0|1] "NA"  ADU
 SG_ OBJ_Object_Age_14 : 67|11@1+ (1,0) [0|2047] "frames"  ADU
 SG_ OBJ_Measuring_Status_14 : 78|3@1+ (1,0) [0|7] "BITWIZE"  ADU
 SG_ OBJ_Object_Class_14 : 81|4@1+ (1,0) [0|8] "ENUM"  ADU
 SG_ OBJ_Class_Probability_14 : 85|7@1+ (0.01,0) [0|1] "NA"  ADU
 SG_ OBJ_Motion_Status_14 : 92|3@1+ (1,0) [0|5] "ENUM"  ADU
 SG_ OBJ_Motion_Orientation_14 : 95|4@1+ (1,0) [0|13] "ENUM"  ADU
 SG_ OBJ_Has_Cut_Lane_14 : 99|1@1+ (1,0) [0|1] "bool"  ADU
 SG_ OBJ_Has_Cut_Path_14 : 100|1@1+ (1,0) [0|1] "bool"  ADU
 SG_ OBJ_Brake_Light_14 : 101|1@1+ (1,0) [0|1] "bool"  ADU
 SG_ OBJ_Turn_Indicator_Right_14 : 102|1@1+ (1,0) [0|1] "bool"  ADU
 SG_ OBJ_Turn_Indicator_Left_14 : 103|1@1+ (1,0) [0|1] "bool"  ADU
 SG_ OBJ_Light_Indicator_Validity_14 : 104|1@1+ (1,0) [0|1] "bool"  ADU
 SG_ OBJ_Right_Out_Of_Image_14 : 105|1@1+ (1,0) [0|1] "bool"  ADU
 SG_ OBJ_Left_Out_Of_Image_14 : 106|1@1+ (1,0) [0|1] "bool"  ADU
 SG_ OBJ_Right_Out_Of_Image_V_14 : 107|1@1+ (1,0) [0|1] "bool"  ADU
 SG_ OBJ_Left_Out_Of_Image_V_14 : 108|1@1+ (1,0) [0|1] "bool"  ADU
 SG_ OBJ_Top_Out_Of_Image_14 : 109|1@1+ (1,0) [0|1] "bool"  ADU
 SG_ OBJ_Bottom_Out_Of_Image_14 : 110|1@1+ (1,0) [0|1] "bool"  ADU
 SG_ OBJ_Top_Out_Of_Image_V_14 : 111|1@1+ (1,0) [0|1] "bool"  ADU
 SG_ OBJ_Bottom_Out_Of_Image_V_14 : 112|1@1+ (1,0) [0|1] "bool"  ADU
 SG_ OBJ_Lane_Assignment_14 : 113|3@1+ (1,0) [0|5] "ENUM"  ADU
 SG_ OBJ_Lane_Assignment_V_14 : 116|1@1+ (1,0) [0|1] "bool"  ADU
 SG_ OBJ_Age_Seconds_14 : 117|7@1+ (1,0) [0|100] "s"  ADU
 SG_ OBJ_Age_Seconds_V_14 : 124|1@1+ (1,0) [0|1] "bool"  ADU
 SG_ OBJ_Width_14 : 125|9@1+ (0.01,0) [0.4|2.95] "m"  ADU
 SG_ OBJ_Width_V_14 : 134|1@1+ (1,0) [0|1] "bool"  ADU
 SG_ OBJ_Width_STD_14 : 135|11@1+ (0.001,0) [0|2] "m"  ADU
 SG_ OBJ_Width_STD_V_14 : 146|1@1+ (1,0) [0|1] "bool"  ADU
 SG_ OBJ_Length_14 : 147|9@1+ (0.05,0) [1.2|21] "m"  ADU
 SG_ OBJ_Length_V_14 : 156|1@1+ (1,0) [0|1] "bool"  ADU
 SG_ OBJ_Length_STD_14 : 157|10@1+ (0.01,0) [0|10] "m"  ADU
 SG_ OBJ_Length_STD_V_14 : 167|1@1+ (1,0) [0|1] "bool"  ADU
 SG_ OBJ_Height_14 : 168|9@1+ (0.01,0) [0|2.95] "m"  ADU
 SG_ OBJ_Height_V_14 : 177|1@1+ (1,0) [0|1] "bool"  ADU
 SG_ OBJ_Height_STD_14 : 178|11@1+ (0.001,0) [0|2] "m"  ADU
 SG_ OBJ_Height_STD_V_14 : 189|1@1+ (1,0) [0|1] "bool"  ADU
 SG_ OBJ_Abs_Long_Velocity_14 : 190|12@1+ (0.05,-100) [-100|100] "m_per_s"  ADU
 SG_ OBJ_Abs_Long_Velocity_V_14 : 202|1@1+ (1,0) [0|1] "bool"  ADU
 SG_ OBJ_Abs_Long_Velocity_STD_14 : 203|13@1+ (0.01,0) [0|65] "m_per_s"  ADU
 SG_ OBJ_Abs_Long_Vel_STD_V_14 : 216|1@1+ (1,0) [0|1] "bool"  ADU
 SG_ OBJ_Abs_Lat_Velocity_14 : 217|11@1+ (0.05,-50) [-50|50] "m_per_s"  ADU
 SG_ OBJ_Abs_Lat_Velocity_V_14 : 228|1@1+ (1,0) [0|1] "bool"  ADU
 SG_ OBJ_Abs_Lat_Velocity_STD_14 : 229|13@1+ (0.01,0) [0|50] "m_per_s"  ADU
 SG_ OBJ_Abs_Lat_Vel_STD_V_14 : 242|1@1+ (1,0) [0|1] "bool"  ADU
 SG_ OBJ_Abs_Long_Acc_14 : 243|9@1+ (0.05,-10) [-10|10] "m_per_s2"  ADU
 SG_ OBJ_Abs_Long_Acc_V_14 : 252|1@1+ (1,0) [0|1] "bool"  ADU
 SG_ OBJ_Abs_Long_Acc_STD_14 : 253|10@1+ (0.01,0) [0|7.3] "m_per_s2"  ADU
 SG_ OBJ_Abs_Long_Acc_STD_V_14 : 263|1@1+ (1,0) [0|1] "bool"  ADU
 SG_ OBJ_Abs_Lat_Acc_14 : 264|9@1+ (0.05,-10.3) [-10.3|7.3] "m_per_s2"  ADU
 SG_ OBJ_Abs_Lat_Acc_V_14 : 273|1@1+ (1,0) [0|1] "bool"  ADU
 SG_ OBJ_Abs_Lat_Acc_STD_14 : 274|10@1+ (0.01,0) [0|7.3] "m_per_s2"  ADU
 SG_ OBJ_Abs_Lat_Acc_STD_V_14 : 284|1@1+ (1,0) [0|1] "bool"  ADU
 SG_ OBJ_Abs_Acceleration_14 : 285|9@1+ (0.05,-10.3) [-10.3|7.3] "m_per_s2"  ADU
 SG_ OBJ_Abs_Acceleration_V_14 : 294|1@1+ (1,0) [0|1] "bool"  ADU
 SG_ OBJ_Abs_Acc_STD_14 : 295|10@1+ (0.01,0) [0|7.3] "m_per_s2"  ADU
 SG_ OBJ_Abs_Acc_STD_V_14 : 305|1@1+ (1,0) [0|1] "bool"  ADU
 SG_ OBJ_Inv_TTC_14 : 306|11@1+ (0.01,-8) [-8|8] "INV(s)"  ADU
 SG_ OBJ_Inv_TTC_V_14 : 317|1@1+ (1,0) [0|1] "bool"  ADU
 SG_ OBJ_Inv_TTC_STD_14 : 318|12@1+ (0.001,0) [0|4] "INV(s)"  ADU
 SG_ OBJ_Inv_TTC_STD_V_14 : 330|1@1+ (1,0) [0|1] "bool"  ADU
 SG_ OBJ_Relative_Long_Acc_14 : 331|10@1+ (0.05,-20) [-20|20] "m_per_s2"  ADU
 SG_ OBJ_Relative_Long_Acc_V_14 : 341|1@1+ (1,0) [0|1] "bool"  ADU
 SG_ OBJ_Relative_Long_Acc_STD_14 : 342|10@1+ (0.01,0) [0|7.3] "m_per_s2"  ADU
 SG_ OBJ_Rel_Long_Acc_STD_V_14 : 352|1@1+ (1,0) [0|1] "bool"  ADU
 SG_ OBJ_Relative_Long_Velocity_14 : 353|13@1+ (0.05,-120) [-120|130] "m_per_s"  ADU
 SG_ OBJ_Relative_Long_Velocity_V_14 : 366|1@1+ (1,0) [0|1] "bool"  ADU
 SG_ OBJ_Relative_Long_Vel_STD_14 : 367|14@1+ (0.01,0) [0|130] "m_per_s"  ADU
 SG_ OBJ_Rel_Long_Vel_STD_V_14 : 381|1@1+ (1,0) [0|1] "bool"  ADU

BO_ 430 Core_Objects_protocol_14_1: 48 ADAS
 SG_ OBJ_Sync_ID_14_1 : 0|8@1+ (1,0) [0|255] "counter"  ADU
 SG_ OBJ_Relative_Lat_Velocity_14 : 8|11@1+ (0.05,-50) [-50|50] "m_per_s"  ADU
 SG_ OBJ_Relative_Lat_Velocity_V_14 : 19|1@1+ (1,0) [0|1] "bool"  ADU
 SG_ OBJ_Relative_Lat_Velocity_STD_14 : 20|13@1+ (0.01,0) [0|50] "m_per_s"  ADU
 SG_ OBJ_Rel_Lat_Vel_STD_V_14 : 33|1@1+ (1,0) [0|1] "bool"  ADU
 SG_ OBJ_Long_Distance_14 : 34|14@1+ (0.05,-200) [-200|500] "m"  ADU
 SG_ OBJ_Long_Distance_V_14 : 48|1@1+ (1,0) [0|1] "bool"  ADU
 SG_ OBJ_Long_Distance_STD_14 : 49|15@1+ (0.01,0) [0|250] "m"  ADU
 SG_ OBJ_Long_Distance_STD_V_14 : 64|1@1+ (1,0) [0|1] "bool"  ADU
 SG_ OBJ_Lat_Distance_14 : 65|12@1+ (0.05,-100) [-100|100] "m"  ADU
 SG_ OBJ_Lat_Distance_V_14 : 77|1@1+ (1,0) [0|1] "bool"  ADU
 SG_ OBJ_Lat_Distance_STD_14 : 78|14@1+ (0.01,0) [0|100] "m"  ADU
 SG_ OBJ_Lat_Distance_STD_V_14 : 92|1@1+ (1,0) [0|1] "bool"  ADU
 SG_ OBJ_Absolute_Speed_14 : 93|12@1+ (0.05,-65) [-65|65] "m_per_s"  ADU
 SG_ OBJ_Absolute_Speed_V_14 : 105|1@1+ (1,0) [0|1] "bool"  ADU
 SG_ OBJ_Absolute_Speed_STD_14 : 106|13@1+ (0.01,0) [0|65] "m_per_s"  ADU
 SG_ OBJ_Absolute_Speed_STD_V_14 : 119|1@1+ (1,0) [0|1] "bool"  ADU
 SG_ OBJ_Heading_14 : 120|10@1+ (0.01,-3.14) [-3.14|3.14] "rad"  ADU
 SG_ OBJ_Heading_V_14 : 130|1@1+ (1,0) [0|1] "bool"  ADU
 SG_ OBJ_Heading_STD_14 : 131|15@1+ (0.0001,0) [0|3.14] "rad"  ADU
 SG_ OBJ_Heading_STD_V_14 : 146|1@1+ (1,0) [0|1] "bool"  ADU
 SG_ OBJ_Angle_Rate_STD_14 : 147|15@1+ (0.0001,0) [0|2.2318] "RPS"  ADU
 SG_ OBJ_Angle_Rate_STD_V_14 : 162|1@1+ (1,0) [0|1] "bool"  ADU
 SG_ OBJ_Angle_Rate_14 : 163|12@1+ (0.002,-2.234) [-2.234|2.2318] "RPS"  ADU
 SG_ OBJ_Angle_Rate_V_14 : 175|1@1+ (1,0) [0|1] "bool"  ADU
 SG_ OBJ_Angle_Right_14 : 176|14@1+ (0.0002,-1.571) [-1.571|1.571] "rad"  ADU
 SG_ OBJ_Angle_Right_V_14 : 190|1@1+ (1,0) [0|1] "bool"  ADU
 SG_ OBJ_Angle_Right_STD_14 : 191|14@1+ (0.0001,0) [0|1.571] "rad"  ADU
 SG_ OBJ_Angle_Right_STD_V_14 : 205|1@1+ (1,0) [0|1] "bool"  ADU
 SG_ OBJ_Angle_Left_14 : 206|14@1+ (0.0002,-1.571) [-1.571|1.571] "rad"  ADU
 SG_ OBJ_Angle_Left_V_14 : 220|1@1+ (1,0) [0|1] "bool"  ADU
 SG_ OBJ_Angle_Left_STD_14 : 221|14@1+ (0.0001,0) [0|1.571] "rad"  ADU
 SG_ OBJ_Angle_Left_STD_V_14 : 235|1@1+ (1,0) [0|1] "bool"  ADU
 SG_ OBJ_Angle_Side_14 : 236|14@1+ (0.0002,-1.571) [-1.571|1.571] "rad"  ADU
 SG_ OBJ_Angle_Side_V_14 : 250|1@1+ (1,0) [0|1] "bool"  ADU
 SG_ OBJ_Angle_Side_STD_14 : 251|14@1+ (0.0001,0) [0|1.571] "rad"  ADU
 SG_ OBJ_Angle_Side_STD_V_14 : 265|1@1+ (1,0) [0|1] "bool"  ADU
 SG_ OBJ_Angle_Mid_V_14 : 266|1@1+ (1,0) [0|1] "bool"  ADU
 SG_ OBJ_Angle_Mid_14 : 267|14@1+ (0.0002,-1.571) [-1.571|1.571] "rad"  ADU
 SG_ OBJ_Angle_Mid_STD_14 : 281|14@1+ (0.0001,0) [0|1.571] "rad"  ADU
 SG_ OBJ_Angle_Mid_STD_V_14 : 295|1@1+ (1,0) [0|1] "bool"  ADU
 SG_ OBJ_Angle_Bottom_V_14 : 296|1@1+ (1,0) [0|1] "bool"  ADU
 SG_ OBJ_Angle_Bottom_14 : 297|14@1+ (0.0002,-1.571) [-1.571|1.571] "rad"  ADU
 SG_ OBJ_Angle_Bottom_STD_14 : 311|14@1+ (0.0001,0) [0|1.571] "rad"  ADU
 SG_ OBJ_Angle_Bottom_STD_V_14 : 325|1@1+ (1,0) [0|1] "bool"  ADU
 SG_ OBJ_Visibility_Side_V_14 : 326|1@1+ (1,0) [0|1] "bool"  ADU
 SG_ OBJ_Visibility_Side_14 : 327|2@1+ (1,0) [0|2] "ENUM"  ADU
 SG_ OBJ_Is_In_Drivable_Area_14 : 329|1@1+ (1,0) [0|1] "bool"  ADU
 SG_ OBJ_Is_In_Drivable_Area_V_14 : 330|1@1+ (1,0) [0|1] "bool"  ADU
 SG_ OBJ_Is_VeryClose_V_14 : 331|1@1+ (1,0) [0|1] "bool"  ADU
 SG_ OBJ_Is_VeryClose_14 : 332|1@1+ (1,0) [0|1] "bool"  ADU
 SG_ OBJ_Is_EMERGENCY_VCL_14 : 333|1@1+ (1,0) [0|1] "bool"  ADU
 SG_ OBJ_EMERGENCY_LIGHT_COLOR_14 : 334|4@1+ (1,0) [0|15] "BITWIZE"  ADU
 SG_ OBJ_EMERGENCY_V_14 : 338|1@1+ (1,0) [0|1] "bool"  ADU

CM_ SG_ 419 OBJ_Sync_ID_9_0 "The ID of the Sync message, used to synchronize between signals in the system. Every new frame promotes the sync ID by one.";
CM_ SG_ 419 OBJ_CRC_9 "Calculated over all element signals. From the signal after the CRC until the first signal in the next elements OBJ_CRC_N+1  not including";
CM_ SG_ 419 OBJ_ID_9 "The detected object ID. Range is 1-255, while 0 indicates that the field in unfilled.";
CM_ SG_ 419 OBJ_Existence_Probability_9 "The existence probability of the vehicle";
CM_ SG_ 419 OBJ_Motion_Category_9 "Relevant for VD only. Full description of values can be found at the ACC guide.";
CM_ SG_ 419 OBJ_Object_Age_9 "The number of frames in which the object was recognized.";
CM_ SG_ 419 OBJ_Measuring_Status_9 "Measurment status. Old vs New marks if this is the first frame in which the object is reported. Predicted vs Measured marks if the report is raw or has been predicted forward in time using the measured dynamics and ego motion.";
CM_ SG_ 419 OBJ_Object_Class_9 "Indicates the object type. Uncertain is outputted in case the probability that a vehicle is a truck is very similar to the probability that it is a car.";
CM_ SG_ 419 OBJ_Class_Probability_9 "The probability of this type classification.";
CM_ SG_ 419 OBJ_Motion_Status_9 "MOVING - the object is moving STATIONARY - the object was never seen moving STOPPED -  the object was moving and has stopped MOVING_SLOWLY - the object is moving very slowly";
CM_ SG_ 419 OBJ_Motion_Orientation_9 "The direction of the targets heading compared to the host.";
CM_ SG_ 419 OBJ_Has_Cut_Lane_9 "Indicates whether the object cut the host's (right or left) lane. In case there are no lanes, indicates whether the objects is at most 1 meters away from the host.";
CM_ SG_ 419 OBJ_Has_Cut_Path_9 "Indicates whether the object is in the host's path.";
CM_ SG_ 419 OBJ_Brake_Light_9 "Indication for brake lights";
CM_ SG_ 419 OBJ_Turn_Indicator_Right_9 "Indication for blinking right light.";
CM_ SG_ 419 OBJ_Turn_Indicator_Left_9 "Indication for blinking left light";
CM_ SG_ 419 OBJ_Light_Indicator_Validity_9 "Validator for light indicators";
CM_ SG_ 419 OBJ_Right_Out_Of_Image_9 "Indicates whether the measurment are predicted out of the right side of the image bounderies.";
CM_ SG_ 419 OBJ_Left_Out_Of_Image_9 "Indicates whether if measurment are predicted out of  the left side of the image bounderies";
CM_ SG_ 419 OBJ_Right_Out_Of_Image_V_9 "validator";
CM_ SG_ 419 OBJ_Left_Out_Of_Image_V_9 "validator";
CM_ SG_ 419 OBJ_Top_Out_Of_Image_9 "Indicates whether if measurment are predicted out of  the top of the image bounderies";
CM_ SG_ 419 OBJ_Bottom_Out_Of_Image_9 "Indicates whether if measurment are predicted out of  the bottom of the image bounderies";
CM_ SG_ 419 OBJ_Top_Out_Of_Image_V_9 "validator";
CM_ SG_ 419 OBJ_Bottom_Out_Of_Image_V_9 "validator";
CM_ SG_ 419 OBJ_Lane_Assignment_9 "The object's lane relative to the host lane.";
CM_ SG_ 419 OBJ_Lane_Assignment_V_9 "Validator for lane assignment";
CM_ SG_ 419 OBJ_Age_Seconds_9 "Time in seconds in which the object was recognized.";
CM_ SG_ 419 OBJ_Age_Seconds_V_9 "Validator for object age";
CM_ SG_ 419 OBJ_Width_9 "The width of the target vehicle in the world (not to be mistaken with the width of the visible part of the vehicle).";
CM_ SG_ 419 OBJ_Width_V_9 "Validator for object width";
CM_ SG_ 419 OBJ_Width_STD_9 "Standard deviation for object width";
CM_ SG_ 419 OBJ_Width_STD_V_9 "Validator for the standard deviation of object width";
CM_ SG_ 419 OBJ_Length_9 "The length of the vehicle in the world. For crossing bicycles it gives the viewed length of the bicycle.";
CM_ SG_ 419 OBJ_Length_V_9 "Validator for object length.";
CM_ SG_ 419 OBJ_Length_STD_9 "Standard deviation for object length.";
CM_ SG_ 419 OBJ_Length_STD_V_9 "Validator for the standard deviation of object length.";
CM_ SG_ 419 OBJ_Height_9 "The height of the object in the world.";
CM_ SG_ 419 OBJ_Height_V_9 "Validator for object height.";
CM_ SG_ 419 OBJ_Height_STD_9 "Standard deviation for object height.";
CM_ SG_ 419 OBJ_Height_STD_V_9 "Validator for the standard deviation of object height.";
CM_ SG_ 419 OBJ_Abs_Long_Velocity_9 "Absolute longitudinal velocity.";
CM_ SG_ 419 OBJ_Abs_Long_Velocity_V_9 "Validator for absolute longitudinal velocity.";
CM_ SG_ 419 OBJ_Abs_Long_Velocity_STD_9 "Standard deviation of absolute longitudinal velocity.";
CM_ SG_ 419 OBJ_Abs_Long_Vel_STD_V_9 "Validator for the standard deviation of the absolute longitudinal velocity.";
CM_ SG_ 419 OBJ_Abs_Lat_Velocity_9 "The lateral ground speed of the object.";
CM_ SG_ 419 OBJ_Abs_Lat_Velocity_V_9 "Validator for the lateral ground speed of the object.";
CM_ SG_ 419 OBJ_Abs_Lat_Velocity_STD_9 "STD of the lateral ground speed of the object.";
CM_ SG_ 419 OBJ_Abs_Lat_Vel_STD_V_9 "Validator for the STD of the lateral ground speed of the object.";
CM_ SG_ 419 OBJ_Abs_Long_Acc_9 "The longitudinal ground acceleration of the object.";
CM_ SG_ 419 OBJ_Abs_Long_Acc_V_9 "Validator for the longitudinal ground acceleration of the object.";
CM_ SG_ 419 OBJ_Abs_Long_Acc_STD_9 "STD of the longitudinal ground acceleration of the object.";
CM_ SG_ 419 OBJ_Abs_Long_Acc_STD_V_9 "Validator for the STD of the longitudinal ground acceleration of the object.";
CM_ SG_ 419 OBJ_Abs_Lat_Acc_9 "The lateral ground acceleration of the object.";
CM_ SG_ 419 OBJ_Abs_Lat_Acc_V_9 "Validator for the lateral ground acceleration of the object.";
CM_ SG_ 419 OBJ_Abs_Lat_Acc_STD_9 "STD of the lateral ground acceleration of the object.";
CM_ SG_ 419 OBJ_Abs_Lat_Acc_STD_V_9 "Validator for the STD of the lateral ground acceleration of the object.";
CM_ SG_ 419 OBJ_Abs_Acceleration_9 "The absolute ground acceleration in the target's heading direction.";
CM_ SG_ 419 OBJ_Abs_Acceleration_V_9 "Validator for the absolute ground acceleration.";
CM_ SG_ 419 OBJ_Abs_Acc_STD_9 "STD of the absolute ground acceleration.";
CM_ SG_ 419 OBJ_Abs_Acc_STD_V_9 "Validator for the STD of the absolute ground acceleration.";
CM_ SG_ 419 OBJ_Inv_TTC_9 "Inverse TTC (time to collision).";
CM_ SG_ 419 OBJ_Inv_TTC_STD_9 "STD for inverse TTC .";
CM_ SG_ 419 OBJ_Inv_TTC_STD_V_9 "Validator for the STD for inverse TTC .";
CM_ SG_ 419 OBJ_Relative_Long_Acc_9 "The relative lateral ground acceleration of the object.";
CM_ SG_ 419 OBJ_Relative_Long_Acc_V_9 "Validator for the relative lateral ground acceleration of the object.";
CM_ SG_ 419 OBJ_Relative_Long_Acc_STD_9 "STD of the relative lateral ground acceleration of the object.";
CM_ SG_ 419 OBJ_Rel_Long_Acc_STD_V_9 "Validator for the STD of the relative lateral ground acceleration.";
CM_ SG_ 419 OBJ_Relative_Long_Velocity_9 "The relative longtitudinal speed between the target and ego vehicle.";
CM_ SG_ 419 OBJ_Relative_Long_Velocity_V_9 "Validator for the relative longtitudinal speed.";
CM_ SG_ 419 OBJ_Relative_Long_Vel_STD_9 "STD of the relative longtitudinal speed.";
CM_ SG_ 419 OBJ_Rel_Long_Vel_STD_V_9 "Validator for the STD of the relative longtitudinal speed.";
CM_ SG_ 420 OBJ_Sync_ID_9_1 "The ID of the Sync message, used to synchronize between signals in the system. Every new frame promotes the sync ID by one.";
CM_ SG_ 420 OBJ_Relative_Lat_Velocity_9 "The relative lateral speed between the target and ego vehicle.";
CM_ SG_ 420 OBJ_Relative_Lat_Velocity_V_9 "Validator for the relative lateral speed.";
CM_ SG_ 420 OBJ_Relative_Lat_Velocity_STD_9 "STD of the relative lateral speed.";
CM_ SG_ 420 OBJ_Rel_Lat_Vel_STD_V_9 "Validator for the STD of the relative lateral speed.";
CM_ SG_ 420 OBJ_Long_Distance_9 "The longtitudinal distance from the object to middle of the rear bumper (middle of the RL and RR corners) of the target.";
CM_ SG_ 420 OBJ_Long_Distance_V_9 "Validator of the longtitudinal distance field";
CM_ SG_ 420 OBJ_Long_Distance_STD_9 "STD of the  longtitudinal distance.";
CM_ SG_ 420 OBJ_Long_Distance_STD_V_9 "Validator for the STD of the  longtitudinal distance.";
CM_ SG_ 420 OBJ_Lat_Distance_9 "Lateral distance to the middle of the RL and RR corners.";
CM_ SG_ 420 OBJ_Lat_Distance_V_9 "Validator for the lateral distance of the object.";
CM_ SG_ 420 OBJ_Lat_Distance_STD_9 "STD of the lateral distance of the object.";
CM_ SG_ 420 OBJ_Lat_Distance_STD_V_9 "Validator for the STD of the lateral distance of the object.";
CM_ SG_ 420 OBJ_Absolute_Speed_9 "The absolute ground speed in the targets' heading direction.";
CM_ SG_ 420 OBJ_Absolute_Speed_V_9 "Validator for the absolute ground speed.";
CM_ SG_ 420 OBJ_Absolute_Speed_STD_9 "STD of the absolute ground speed.";
CM_ SG_ 420 OBJ_Absolute_Speed_STD_V_9 "Validator for the STD of the absolute ground speed.";
CM_ SG_ 420 OBJ_Heading_9 "The angle beetweenthe host longitudinal axis and target's heading (clockwise, e.g. PI/2 is a target crossing from left to right).";
CM_ SG_ 420 OBJ_Heading_V_9 "Validator for the object heading.";
CM_ SG_ 420 OBJ_Heading_STD_9 "STD of the object heading.";
CM_ SG_ 420 OBJ_Heading_STD_V_9 "Validator for the STD of the object heading.";
CM_ SG_ 420 OBJ_Angle_Rate_STD_9 "Standard deviation of the angular speed. (radians)";
CM_ SG_ 420 OBJ_Angle_Rate_STD_V_9 "Validator for the STD of the angular speed.";
CM_ SG_ 420 OBJ_Angle_Rate_9 "The momentary angular speed of the object. (radians)";
CM_ SG_ 420 OBJ_Angle_Rate_V_9 "Validator for the angular speed.";
CM_ SG_ 420 OBJ_Angle_Right_9 "The angle between the host longitudinal axis and the right side of the front / rear of the target (the visible one). The positive side is to the host's right.";
CM_ SG_ 420 OBJ_Angle_Right_V_9 "Validator for angleRight";
CM_ SG_ 420 OBJ_Angle_Right_STD_9 "Standard deviation of angleRight";
CM_ SG_ 420 OBJ_Angle_Right_STD_V_9 "Validator for the standard deviation of angleRight.";
CM_ SG_ 420 OBJ_Angle_Left_9 "The angle between the host longitudinal axis and the left side of the front / rear of the target (the visible one). The positive side is to the host's right.";
CM_ SG_ 420 OBJ_Angle_Left_V_9 "Validator for angleLeft.";
CM_ SG_ 420 OBJ_Angle_Left_STD_9 "Standard deviation of angleLeft.";
CM_ SG_ 420 OBJ_Angle_Left_STD_V_9 "Validator for the standard deviation of angleLeft.";
CM_ SG_ 420 OBJ_Angle_Side_9 "The angle between the host longitudinal axis and the far visible edge - the visible edge of the front / rear of the target that is not visible. Currently supported for vehicles only.";
CM_ SG_ 420 OBJ_Angle_Side_V_9 "Validator for angleSide.";
CM_ SG_ 420 OBJ_Angle_Side_STD_9 "Standard deviation of angleSide.";
CM_ SG_ 420 OBJ_Angle_Side_STD_V_9 "Validator for the STD of angleSide.";
CM_ SG_ 420 OBJ_Angle_Mid_V_9 "Validator for angleMid.";
CM_ SG_ 420 OBJ_Angle_Mid_9 "The angle between the host longitudinal axis and the middle of the front / rear of the target (the visible one). The positive side is to the host's right.";
CM_ SG_ 420 OBJ_Angle_Mid_STD_9 "Standard deviation of angleMid.";
CM_ SG_ 420 OBJ_Angle_Mid_STD_V_9 "Validator for the STD of angleMid.";
CM_ SG_ 420 OBJ_Angle_Bottom_V_9 "Validator for OBJAngle_Bottom.";
CM_ SG_ 420 OBJ_Angle_Bottom_9 "The angle between the longitudinal axis and the Bottom of the front / rear of the target (the visible one). The positive side is to the host's bottom";
CM_ SG_ 420 OBJ_Angle_Bottom_STD_9 "STD for OBJAngle_Bottom.";
CM_ SG_ 420 OBJ_Angle_Bottom_STD_V_9 "Validator for OBJAngle_Bottom_STD.";
CM_ SG_ 420 OBJ_Visibility_Side_V_9 "Currently Supported for VD only";
CM_ SG_ 420 OBJ_Visibility_Side_9 "From what car  side is the object visible";
CM_ SG_ 420 OBJ_Is_In_Drivable_Area_9 "Indicates whether the target is in a driveable area.";
CM_ SG_ 420 OBJ_Is_In_Drivable_Area_V_9 "Validator for OBJ_Is_In_Drivable_Area.";
CM_ SG_ 420 OBJ_Is_VeryClose_V_9 "Validator for OBJ_Is_VeryClose.";
CM_ SG_ 420 OBJ_Is_VeryClose_9 "Indicates whether the target is very close to the host such that it is hard to measure its distance. Currently relevant for peds only";
CM_ SG_ 420 OBJ_Is_EMERGENCY_VCL_9 "Is Object an Emergency Vehicle";
CM_ SG_ 420 OBJ_EMERGENCY_LIGHT_COLOR_9 "Emergency Color";
CM_ SG_ 420 OBJ_EMERGENCY_V_9 "Are OBJ_Is_EMERGENCY_VCL and OBJ_EMERGENCY_LIGHT_COLOR Valid";
CM_ SG_ 421 OBJ_Sync_ID_10_0 "The ID of the Sync message, used to synchronize between signals in the system. Every new frame promotes the sync ID by one.";
CM_ SG_ 421 OBJ_CRC_10 "Calculated over all element signals. From the signal after the CRC until the first signal in the next elements OBJ_CRC_N+1  not including";
CM_ SG_ 421 OBJ_ID_10 "The detected object ID. Range is 1-255, while 0 indicates that the field in unfilled.";
CM_ SG_ 421 OBJ_Existence_Probability_10 "The existence probability of the vehicle";
CM_ SG_ 421 OBJ_Motion_Category_10 "Relevant for VD only. Full description of values can be found at the ACC guide.";
CM_ SG_ 421 OBJ_Object_Age_10 "The number of frames in which the object was recognized.";
CM_ SG_ 421 OBJ_Measuring_Status_10 "Measurment status. Old vs New marks if this is the first frame in which the object is reported. Predicted vs Measured marks if the report is raw or has been predicted forward in time using the measured dynamics and ego motion.";
CM_ SG_ 421 OBJ_Object_Class_10 "Indicates the object type. Uncertain is outputted in case the probability that a vehicle is a truck is very similar to the probability that it is a car.";
CM_ SG_ 421 OBJ_Class_Probability_10 "The probability of this type classification.";
CM_ SG_ 421 OBJ_Motion_Status_10 "MOVING - the object is moving STATIONARY - the object was never seen moving STOPPED -  the object was moving and has stopped MOVING_SLOWLY - the object is moving very slowly";
CM_ SG_ 421 OBJ_Motion_Orientation_10 "The direction of the targets heading compared to the host.";
CM_ SG_ 421 OBJ_Has_Cut_Lane_10 "Indicates whether the object cut the host's (right or left) lane. In case there are no lanes, indicates whether the objects is at most 1 meters away from the host.";
CM_ SG_ 421 OBJ_Has_Cut_Path_10 "Indicates whether the object is in the host's path.";
CM_ SG_ 421 OBJ_Brake_Light_10 "Indication for brake lights";
CM_ SG_ 421 OBJ_Turn_Indicator_Right_10 "Indication for blinking right light.";
CM_ SG_ 421 OBJ_Turn_Indicator_Left_10 "Indication for blinking left light";
CM_ SG_ 421 OBJ_Light_Indicator_Validity_10 "Validator for light indicators";
CM_ SG_ 421 OBJ_Right_Out_Of_Image_10 "Indicates whether the measurment are predicted out of the right side of the image bounderies.";
CM_ SG_ 421 OBJ_Left_Out_Of_Image_10 "Indicates whether if measurment are predicted out of  the left side of the image bounderies";
CM_ SG_ 421 OBJ_Right_Out_Of_Image_V_10 "validator";
CM_ SG_ 421 OBJ_Left_Out_Of_Image_V_10 "validator";
CM_ SG_ 421 OBJ_Top_Out_Of_Image_10 "Indicates whether if measurment are predicted out of  the top of the image bounderies";
CM_ SG_ 421 OBJ_Bottom_Out_Of_Image_10 "Indicates whether if measurment are predicted out of  the bottom of the image bounderies";
CM_ SG_ 421 OBJ_Top_Out_Of_Image_V_10 "validator";
CM_ SG_ 421 OBJ_Bottom_Out_Of_Image_V_10 "validator";
CM_ SG_ 421 OBJ_Lane_Assignment_10 "The object's lane relative to the host lane.";
CM_ SG_ 421 OBJ_Lane_Assignment_V_10 "Validator for lane assignment";
CM_ SG_ 421 OBJ_Age_Seconds_10 "Time in seconds in which the object was recognized.";
CM_ SG_ 421 OBJ_Age_Seconds_V_10 "Validator for object age";
CM_ SG_ 421 OBJ_Width_10 "The width of the target vehicle in the world (not to be mistaken with the width of the visible part of the vehicle).";
CM_ SG_ 421 OBJ_Width_V_10 "Validator for object width";
CM_ SG_ 421 OBJ_Width_STD_10 "Standard deviation for object width";
CM_ SG_ 421 OBJ_Width_STD_V_10 "Validator for the standard deviation of object width";
CM_ SG_ 421 OBJ_Length_10 "The length of the vehicle in the world. For crossing bicycles it gives the viewed length of the bicycle.";
CM_ SG_ 421 OBJ_Length_V_10 "Validator for object length.";
CM_ SG_ 421 OBJ_Length_STD_10 "Standard deviation for object length.";
CM_ SG_ 421 OBJ_Length_STD_V_10 "Validator for the standard deviation of object length.";
CM_ SG_ 421 OBJ_Height_10 "The height of the object in the world.";
CM_ SG_ 421 OBJ_Height_V_10 "Validator for object height.";
CM_ SG_ 421 OBJ_Height_STD_10 "Standard deviation for object height.";
CM_ SG_ 421 OBJ_Height_STD_V_10 "Validator for the standard deviation of object height.";
CM_ SG_ 421 OBJ_Abs_Long_Velocity_10 "Absolute longitudinal velocity.";
CM_ SG_ 421 OBJ_Abs_Long_Velocity_V_10 "Validator for absolute longitudinal velocity.";
CM_ SG_ 421 OBJ_Abs_Long_Velocity_STD_10 "Standard deviation of absolute longitudinal velocity.";
CM_ SG_ 421 OBJ_Abs_Long_Vel_STD_V_10 "Validator for the standard deviation of the absolute longitudinal velocity.";
CM_ SG_ 421 OBJ_Abs_Lat_Velocity_10 "The lateral ground speed of the object.";
CM_ SG_ 421 OBJ_Abs_Lat_Velocity_V_10 "Validator for the lateral ground speed of the object.";
CM_ SG_ 421 OBJ_Abs_Lat_Velocity_STD_10 "STD of the lateral ground speed of the object.";
CM_ SG_ 421 OBJ_Abs_Lat_Vel_STD_V_10 "Validator for the STD of the lateral ground speed of the object.";
CM_ SG_ 421 OBJ_Abs_Long_Acc_10 "The longitudinal ground acceleration of the object.";
CM_ SG_ 421 OBJ_Abs_Long_Acc_V_10 "Validator for the longitudinal ground acceleration of the object.";
CM_ SG_ 421 OBJ_Abs_Long_Acc_STD_10 "STD of the longitudinal ground acceleration of the object.";
CM_ SG_ 421 OBJ_Abs_Long_Acc_STD_V_10 "Validator for the STD of the longitudinal ground acceleration of the object.";
CM_ SG_ 421 OBJ_Abs_Lat_Acc_10 "The lateral ground acceleration of the object.";
CM_ SG_ 421 OBJ_Abs_Lat_Acc_V_10 "Validator for the lateral ground acceleration of the object.";
CM_ SG_ 421 OBJ_Abs_Lat_Acc_STD_10 "STD of the lateral ground acceleration of the object.";
CM_ SG_ 421 OBJ_Abs_Lat_Acc_STD_V_10 "Validator for the STD of the lateral ground acceleration of the object.";
CM_ SG_ 421 OBJ_Abs_Acceleration_10 "The absolute ground acceleration in the target's heading direction.";
CM_ SG_ 421 OBJ_Abs_Acceleration_V_10 "Validator for the absolute ground acceleration.";
CM_ SG_ 421 OBJ_Abs_Acc_STD_10 "STD of the absolute ground acceleration.";
CM_ SG_ 421 OBJ_Abs_Acc_STD_V_10 "Validator for the STD of the absolute ground acceleration.";
CM_ SG_ 421 OBJ_Inv_TTC_10 "Inverse TTC (time to collision).";
CM_ SG_ 421 OBJ_Inv_TTC_STD_10 "STD for inverse TTC .";
CM_ SG_ 421 OBJ_Inv_TTC_STD_V_10 "Validator for the STD for inverse TTC .";
CM_ SG_ 421 OBJ_Relative_Long_Acc_10 "The relative lateral ground acceleration of the object.";
CM_ SG_ 421 OBJ_Relative_Long_Acc_V_10 "Validator for the relative lateral ground acceleration of the object.";
CM_ SG_ 421 OBJ_Relative_Long_Acc_STD_10 "STD of the relative lateral ground acceleration of the object.";
CM_ SG_ 421 OBJ_Rel_Long_Acc_STD_V_10 "Validator for the STD of the relative lateral ground acceleration.";
CM_ SG_ 421 OBJ_Relative_Long_Velocity_10 "The relative longtitudinal speed between the target and ego vehicle.";
CM_ SG_ 421 OBJ_Relative_Long_Velocity_V_10 "Validator for the relative longtitudinal speed.";
CM_ SG_ 421 OBJ_Relative_Long_Vel_STD_10 "STD of the relative longtitudinal speed.";
CM_ SG_ 421 OBJ_Rel_Long_Vel_STD_V_10 "Validator for the STD of the relative longtitudinal speed.";
CM_ SG_ 422 OBJ_Sync_ID_10_1 "The ID of the Sync message, used to synchronize between signals in the system. Every new frame promotes the sync ID by one.";
CM_ SG_ 422 OBJ_Relative_Lat_Velocity_10 "The relative lateral speed between the target and ego vehicle.";
CM_ SG_ 422 OBJ_Relative_Lat_Velocity_V_10 "Validator for the relative lateral speed.";
CM_ SG_ 422 OBJ_Relative_Lat_Velocity_STD_10 "STD of the relative lateral speed.";
CM_ SG_ 422 OBJ_Rel_Lat_Vel_STD_V_10 "Validator for the STD of the relative lateral speed.";
CM_ SG_ 422 OBJ_Long_Distance_10 "The longtitudinal distance from the object to middle of the rear bumper (middle of the RL and RR corners) of the target.";
CM_ SG_ 422 OBJ_Long_Distance_V_10 "Validator of the longtitudinal distance field";
CM_ SG_ 422 OBJ_Long_Distance_STD_10 "STD of the  longtitudinal distance.";
CM_ SG_ 422 OBJ_Long_Distance_STD_V_10 "Validator for the STD of the  longtitudinal distance.";
CM_ SG_ 422 OBJ_Lat_Distance_10 "Lateral distance to the middle of the RL and RR corners.";
CM_ SG_ 422 OBJ_Lat_Distance_V_10 "Validator for the lateral distance of the object.";
CM_ SG_ 422 OBJ_Lat_Distance_STD_10 "STD of the lateral distance of the object.";
CM_ SG_ 422 OBJ_Lat_Distance_STD_V_10 "Validator for the STD of the lateral distance of the object.";
CM_ SG_ 422 OBJ_Absolute_Speed_10 "The absolute ground speed in the targets' heading direction.";
CM_ SG_ 422 OBJ_Absolute_Speed_V_10 "Validator for the absolute ground speed.";
CM_ SG_ 422 OBJ_Absolute_Speed_STD_10 "STD of the absolute ground speed.";
CM_ SG_ 422 OBJ_Absolute_Speed_STD_V_10 "Validator for the STD of the absolute ground speed.";
CM_ SG_ 422 OBJ_Heading_10 "The angle beetweenthe host longitudinal axis and target's heading (clockwise, e.g. PI/2 is a target crossing from left to right).";
CM_ SG_ 422 OBJ_Heading_V_10 "Validator for the object heading.";
CM_ SG_ 422 OBJ_Heading_STD_10 "STD of the object heading.";
CM_ SG_ 422 OBJ_Heading_STD_V_10 "Validator for the STD of the object heading.";
CM_ SG_ 422 OBJ_Angle_Rate_STD_10 "Standard deviation of the angular speed. (radians)";
CM_ SG_ 422 OBJ_Angle_Rate_STD_V_10 "Validator for the STD of the angular speed.";
CM_ SG_ 422 OBJ_Angle_Rate_10 "The momentary angular speed of the object. (radians)";
CM_ SG_ 422 OBJ_Angle_Rate_V_10 "Validator for the angular speed.";
CM_ SG_ 422 OBJ_Angle_Right_10 "The angle between the host longitudinal axis and the right side of the front / rear of the target (the visible one). The positive side is to the host's right.";
CM_ SG_ 422 OBJ_Angle_Right_V_10 "Validator for angleRight";
CM_ SG_ 422 OBJ_Angle_Right_STD_10 "Standard deviation of angleRight";
CM_ SG_ 422 OBJ_Angle_Right_STD_V_10 "Validator for the standard deviation of angleRight.";
CM_ SG_ 422 OBJ_Angle_Left_10 "The angle between the host longitudinal axis and the left side of the front / rear of the target (the visible one). The positive side is to the host's right.";
CM_ SG_ 422 OBJ_Angle_Left_V_10 "Validator for angleLeft.";
CM_ SG_ 422 OBJ_Angle_Left_STD_10 "Standard deviation of angleLeft.";
CM_ SG_ 422 OBJ_Angle_Left_STD_V_10 "Validator for the standard deviation of angleLeft.";
CM_ SG_ 422 OBJ_Angle_Side_10 "The angle between the host longitudinal axis and the far visible edge - the visible edge of the front / rear of the target that is not visible. Currently supported for vehicles only.";
CM_ SG_ 422 OBJ_Angle_Side_V_10 "Validator for angleSide.";
CM_ SG_ 422 OBJ_Angle_Side_STD_10 "Standard deviation of angleSide.";
CM_ SG_ 422 OBJ_Angle_Side_STD_V_10 "Validator for the STD of angleSide.";
CM_ SG_ 422 OBJ_Angle_Mid_V_10 "Validator for angleMid.";
CM_ SG_ 422 OBJ_Angle_Mid_10 "The angle between the host longitudinal axis and the middle of the front / rear of the target (the visible one). The positive side is to the host's right.";
CM_ SG_ 422 OBJ_Angle_Mid_STD_10 "Standard deviation of angleMid.";
CM_ SG_ 422 OBJ_Angle_Mid_STD_V_10 "Validator for the STD of angleMid.";
CM_ SG_ 422 OBJ_Angle_Bottom_V_10 "Validator for OBJAngle_Bottom.";
CM_ SG_ 422 OBJ_Angle_Bottom_10 "The angle between the longitudinal axis and the Bottom of the front / rear of the target (the visible one). The positive side is to the host's bottom";
CM_ SG_ 422 OBJ_Angle_Bottom_STD_10 "STD for OBJAngle_Bottom.";
CM_ SG_ 422 OBJ_Angle_Bottom_STD_V_10 "Validator for OBJAngle_Bottom_STD.";
CM_ SG_ 422 OBJ_Visibility_Side_V_10 "Currently Supported for VD only";
CM_ SG_ 422 OBJ_Visibility_Side_10 "From what car  side is the object visible";
CM_ SG_ 422 OBJ_Is_In_Drivable_Area_10 "Indicates whether the target is in a driveable area.";
CM_ SG_ 422 OBJ_Is_In_Drivable_Area_V_10 "Validator for OBJ_Is_In_Drivable_Area.";
CM_ SG_ 422 OBJ_Is_VeryClose_V_10 "Validator for OBJ_Is_VeryClose.";
CM_ SG_ 422 OBJ_Is_VeryClose_10 "Indicates whether the target is very close to the host such that it is hard to measure its distance. Currently relevant for peds only";
CM_ SG_ 422 OBJ_Is_EMERGENCY_VCL_10 "Is Object an Emergency Vehicle";
CM_ SG_ 422 OBJ_EMERGENCY_LIGHT_COLOR_10 "Emergency Color";
CM_ SG_ 422 OBJ_EMERGENCY_V_10 "Are OBJ_Is_EMERGENCY_VCL and OBJ_EMERGENCY_LIGHT_COLOR Valid";
CM_ SG_ 423 OBJ_Sync_ID_11_0 "The ID of the Sync message, used to synchronize between signals in the system. Every new frame promotes the sync ID by one.";
CM_ SG_ 423 OBJ_CRC_11 "Calculated over all element signals. From the signal after the CRC until the first signal in the next elements OBJ_CRC_N+1  not including";
CM_ SG_ 423 OBJ_ID_11 "The detected object ID. Range is 1-255, while 0 indicates that the field in unfilled.";
CM_ SG_ 423 OBJ_Existence_Probability_11 "The existence probability of the vehicle";
CM_ SG_ 423 OBJ_Motion_Category_11 "Relevant for VD only. Full description of values can be found at the ACC guide.";
CM_ SG_ 423 OBJ_Object_Age_11 "The number of frames in which the object was recognized.";
CM_ SG_ 423 OBJ_Measuring_Status_11 "Measurment status. Old vs New marks if this is the first frame in which the object is reported. Predicted vs Measured marks if the report is raw or has been predicted forward in time using the measured dynamics and ego motion.";
CM_ SG_ 423 OBJ_Object_Class_11 "Indicates the object type. Uncertain is outputted in case the probability that a vehicle is a truck is very similar to the probability that it is a car.";
CM_ SG_ 423 OBJ_Class_Probability_11 "The probability of this type classification.";
CM_ SG_ 423 OBJ_Motion_Status_11 "MOVING - the object is moving STATIONARY - the object was never seen moving STOPPED -  the object was moving and has stopped MOVING_SLOWLY - the object is moving very slowly";
CM_ SG_ 423 OBJ_Motion_Orientation_11 "The direction of the targets heading compared to the host.";
CM_ SG_ 423 OBJ_Has_Cut_Lane_11 "Indicates whether the object cut the host's (right or left) lane. In case there are no lanes, indicates whether the objects is at most 1 meters away from the host.";
CM_ SG_ 423 OBJ_Has_Cut_Path_11 "Indicates whether the object is in the host's path.";
CM_ SG_ 423 OBJ_Brake_Light_11 "Indication for brake lights";
CM_ SG_ 423 OBJ_Turn_Indicator_Right_11 "Indication for blinking right light.";
CM_ SG_ 423 OBJ_Turn_Indicator_Left_11 "Indication for blinking left light";
CM_ SG_ 423 OBJ_Light_Indicator_Validity_11 "Validator for light indicators";
CM_ SG_ 423 OBJ_Right_Out_Of_Image_11 "Indicates whether the measurment are predicted out of the right side of the image bounderies.";
CM_ SG_ 423 OBJ_Left_Out_Of_Image_11 "Indicates whether if measurment are predicted out of  the left side of the image bounderies";
CM_ SG_ 423 OBJ_Right_Out_Of_Image_V_11 "validator";
CM_ SG_ 423 OBJ_Left_Out_Of_Image_V_11 "validator";
CM_ SG_ 423 OBJ_Top_Out_Of_Image_11 "Indicates whether if measurment are predicted out of  the top of the image bounderies";
CM_ SG_ 423 OBJ_Bottom_Out_Of_Image_11 "Indicates whether if measurment are predicted out of  the bottom of the image bounderies";
CM_ SG_ 423 OBJ_Top_Out_Of_Image_V_11 "validator";
CM_ SG_ 423 OBJ_Bottom_Out_Of_Image_V_11 "validator";
CM_ SG_ 423 OBJ_Lane_Assignment_11 "The object's lane relative to the host lane.";
CM_ SG_ 423 OBJ_Lane_Assignment_V_11 "Validator for lane assignment";
CM_ SG_ 423 OBJ_Age_Seconds_11 "Time in seconds in which the object was recognized.";
CM_ SG_ 423 OBJ_Age_Seconds_V_11 "Validator for object age";
CM_ SG_ 423 OBJ_Width_11 "The width of the target vehicle in the world (not to be mistaken with the width of the visible part of the vehicle).";
CM_ SG_ 423 OBJ_Width_V_11 "Validator for object width";
CM_ SG_ 423 OBJ_Width_STD_11 "Standard deviation for object width";
CM_ SG_ 423 OBJ_Width_STD_V_11 "Validator for the standard deviation of object width";
CM_ SG_ 423 OBJ_Length_11 "The length of the vehicle in the world. For crossing bicycles it gives the viewed length of the bicycle.";
CM_ SG_ 423 OBJ_Length_V_11 "Validator for object length.";
CM_ SG_ 423 OBJ_Length_STD_11 "Standard deviation for object length.";
CM_ SG_ 423 OBJ_Length_STD_V_11 "Validator for the standard deviation of object length.";
CM_ SG_ 423 OBJ_Height_11 "The height of the object in the world.";
CM_ SG_ 423 OBJ_Height_V_11 "Validator for object height.";
CM_ SG_ 423 OBJ_Height_STD_11 "Standard deviation for object height.";
CM_ SG_ 423 OBJ_Height_STD_V_11 "Validator for the standard deviation of object height.";
CM_ SG_ 423 OBJ_Abs_Long_Velocity_11 "Absolute longitudinal velocity.";
CM_ SG_ 423 OBJ_Abs_Long_Velocity_V_11 "Validator for absolute longitudinal velocity.";
CM_ SG_ 423 OBJ_Abs_Long_Velocity_STD_11 "Standard deviation of absolute longitudinal velocity.";
CM_ SG_ 423 OBJ_Abs_Long_Vel_STD_V_11 "Validator for the standard deviation of the absolute longitudinal velocity.";
CM_ SG_ 423 OBJ_Abs_Lat_Velocity_11 "The lateral ground speed of the object.";
CM_ SG_ 423 OBJ_Abs_Lat_Velocity_V_11 "Validator for the lateral ground speed of the object.";
CM_ SG_ 423 OBJ_Abs_Lat_Velocity_STD_11 "STD of the lateral ground speed of the object.";
CM_ SG_ 423 OBJ_Abs_Lat_Vel_STD_V_11 "Validator for the STD of the lateral ground speed of the object.";
CM_ SG_ 423 OBJ_Abs_Long_Acc_11 "The longitudinal ground acceleration of the object.";
CM_ SG_ 423 OBJ_Abs_Long_Acc_V_11 "Validator for the longitudinal ground acceleration of the object.";
CM_ SG_ 423 OBJ_Abs_Long_Acc_STD_11 "STD of the longitudinal ground acceleration of the object.";
CM_ SG_ 423 OBJ_Abs_Long_Acc_STD_V_11 "Validator for the STD of the longitudinal ground acceleration of the object.";
CM_ SG_ 423 OBJ_Abs_Lat_Acc_11 "The lateral ground acceleration of the object.";
CM_ SG_ 423 OBJ_Abs_Lat_Acc_V_11 "Validator for the lateral ground acceleration of the object.";
CM_ SG_ 423 OBJ_Abs_Lat_Acc_STD_11 "STD of the lateral ground acceleration of the object.";
CM_ SG_ 423 OBJ_Abs_Lat_Acc_STD_V_11 "Validator for the STD of the lateral ground acceleration of the object.";
CM_ SG_ 423 OBJ_Abs_Acceleration_11 "The absolute ground acceleration in the target's heading direction.";
CM_ SG_ 423 OBJ_Abs_Acceleration_V_11 "Validator for the absolute ground acceleration.";
CM_ SG_ 423 OBJ_Abs_Acc_STD_11 "STD of the absolute ground acceleration.";
CM_ SG_ 423 OBJ_Abs_Acc_STD_V_11 "Validator for the STD of the absolute ground acceleration.";
CM_ SG_ 423 OBJ_Inv_TTC_11 "Inverse TTC (time to collision).";
CM_ SG_ 423 OBJ_Inv_TTC_STD_11 "STD for inverse TTC .";
CM_ SG_ 423 OBJ_Inv_TTC_STD_V_11 "Validator for the STD for inverse TTC .";
CM_ SG_ 423 OBJ_Relative_Long_Acc_11 "The relative lateral ground acceleration of the object.";
CM_ SG_ 423 OBJ_Relative_Long_Acc_V_11 "Validator for the relative lateral ground acceleration of the object.";
CM_ SG_ 423 OBJ_Relative_Long_Acc_STD_11 "STD of the relative lateral ground acceleration of the object.";
CM_ SG_ 423 OBJ_Rel_Long_Acc_STD_V_11 "Validator for the STD of the relative lateral ground acceleration.";
CM_ SG_ 423 OBJ_Relative_Long_Velocity_11 "The relative longtitudinal speed between the target and ego vehicle.";
CM_ SG_ 423 OBJ_Relative_Long_Velocity_V_11 "Validator for the relative longtitudinal speed.";
CM_ SG_ 423 OBJ_Relative_Long_Vel_STD_11 "STD of the relative longtitudinal speed.";
CM_ SG_ 423 OBJ_Rel_Long_Vel_STD_V_11 "Validator for the STD of the relative longtitudinal speed.";
CM_ SG_ 424 OBJ_Sync_ID_11_1 "The ID of the Sync message, used to synchronize between signals in the system. Every new frame promotes the sync ID by one.";
CM_ SG_ 424 OBJ_Relative_Lat_Velocity_11 "The relative lateral speed between the target and ego vehicle.";
CM_ SG_ 424 OBJ_Relative_Lat_Velocity_V_11 "Validator for the relative lateral speed.";
CM_ SG_ 424 OBJ_Relative_Lat_Velocity_STD_11 "STD of the relative lateral speed.";
CM_ SG_ 424 OBJ_Rel_Lat_Vel_STD_V_11 "Validator for the STD of the relative lateral speed.";
CM_ SG_ 424 OBJ_Long_Distance_11 "The longtitudinal distance from the object to middle of the rear bumper (middle of the RL and RR corners) of the target.";
CM_ SG_ 424 OBJ_Long_Distance_V_11 "Validator of the longtitudinal distance field";
CM_ SG_ 424 OBJ_Long_Distance_STD_11 "STD of the  longtitudinal distance.";
CM_ SG_ 424 OBJ_Long_Distance_STD_V_11 "Validator for the STD of the  longtitudinal distance.";
CM_ SG_ 424 OBJ_Lat_Distance_11 "Lateral distance to the middle of the RL and RR corners.";
CM_ SG_ 424 OBJ_Lat_Distance_V_11 "Validator for the lateral distance of the object.";
CM_ SG_ 424 OBJ_Lat_Distance_STD_11 "STD of the lateral distance of the object.";
CM_ SG_ 424 OBJ_Lat_Distance_STD_V_11 "Validator for the STD of the lateral distance of the object.";
CM_ SG_ 424 OBJ_Absolute_Speed_11 "The absolute ground speed in the targets' heading direction.";
CM_ SG_ 424 OBJ_Absolute_Speed_V_11 "Validator for the absolute ground speed.";
CM_ SG_ 424 OBJ_Absolute_Speed_STD_11 "STD of the absolute ground speed.";
CM_ SG_ 424 OBJ_Absolute_Speed_STD_V_11 "Validator for the STD of the absolute ground speed.";
CM_ SG_ 424 OBJ_Heading_11 "The angle beetweenthe host longitudinal axis and target's heading (clockwise, e.g. PI/2 is a target crossing from left to right).";
CM_ SG_ 424 OBJ_Heading_V_11 "Validator for the object heading.";
CM_ SG_ 424 OBJ_Heading_STD_11 "STD of the object heading.";
CM_ SG_ 424 OBJ_Heading_STD_V_11 "Validator for the STD of the object heading.";
CM_ SG_ 424 OBJ_Angle_Rate_STD_11 "Standard deviation of the angular speed. (radians)";
CM_ SG_ 424 OBJ_Angle_Rate_STD_V_11 "Validator for the STD of the angular speed.";
CM_ SG_ 424 OBJ_Angle_Rate_11 "The momentary angular speed of the object. (radians)";
CM_ SG_ 424 OBJ_Angle_Rate_V_11 "Validator for the angular speed.";
CM_ SG_ 424 OBJ_Angle_Right_11 "The angle between the host longitudinal axis and the right side of the front / rear of the target (the visible one). The positive side is to the host's right.";
CM_ SG_ 424 OBJ_Angle_Right_V_11 "Validator for angleRight";
CM_ SG_ 424 OBJ_Angle_Right_STD_11 "Standard deviation of angleRight";
CM_ SG_ 424 OBJ_Angle_Right_STD_V_11 "Validator for the standard deviation of angleRight.";
CM_ SG_ 424 OBJ_Angle_Left_11 "The angle between the host longitudinal axis and the left side of the front / rear of the target (the visible one). The positive side is to the host's right.";
CM_ SG_ 424 OBJ_Angle_Left_V_11 "Validator for angleLeft.";
CM_ SG_ 424 OBJ_Angle_Left_STD_11 "Standard deviation of angleLeft.";
CM_ SG_ 424 OBJ_Angle_Left_STD_V_11 "Validator for the standard deviation of angleLeft.";
CM_ SG_ 424 OBJ_Angle_Side_11 "The angle between the host longitudinal axis and the far visible edge - the visible edge of the front / rear of the target that is not visible. Currently supported for vehicles only.";
CM_ SG_ 424 OBJ_Angle_Side_V_11 "Validator for angleSide.";
CM_ SG_ 424 OBJ_Angle_Side_STD_11 "Standard deviation of angleSide.";
CM_ SG_ 424 OBJ_Angle_Side_STD_V_11 "Validator for the STD of angleSide.";
CM_ SG_ 424 OBJ_Angle_Mid_V_11 "Validator for angleMid.";
CM_ SG_ 424 OBJ_Angle_Mid_11 "The angle between the host longitudinal axis and the middle of the front / rear of the target (the visible one). The positive side is to the host's right.";
CM_ SG_ 424 OBJ_Angle_Mid_STD_11 "Standard deviation of angleMid.";
CM_ SG_ 424 OBJ_Angle_Mid_STD_V_11 "Validator for the STD of angleMid.";
CM_ SG_ 424 OBJ_Angle_Bottom_V_11 "Validator for OBJAngle_Bottom.";
CM_ SG_ 424 OBJ_Angle_Bottom_11 "The angle between the longitudinal axis and the Bottom of the front / rear of the target (the visible one). The positive side is to the host's bottom";
CM_ SG_ 424 OBJ_Angle_Bottom_STD_11 "STD for OBJAngle_Bottom.";
CM_ SG_ 424 OBJ_Angle_Bottom_STD_V_11 "Validator for OBJAngle_Bottom_STD.";
CM_ SG_ 424 OBJ_Visibility_Side_V_11 "Currently Supported for VD only";
CM_ SG_ 424 OBJ_Visibility_Side_11 "From what car  side is the object visible";
CM_ SG_ 424 OBJ_Is_In_Drivable_Area_11 "Indicates whether the target is in a driveable area.";
CM_ SG_ 424 OBJ_Is_In_Drivable_Area_V_11 "Validator for OBJ_Is_In_Drivable_Area.";
CM_ SG_ 424 OBJ_Is_VeryClose_V_11 "Validator for OBJ_Is_VeryClose.";
CM_ SG_ 424 OBJ_Is_VeryClose_11 "Indicates whether the target is very close to the host such that it is hard to measure its distance. Currently relevant for peds only";
CM_ SG_ 424 OBJ_Is_EMERGENCY_VCL_11 "Is Object an Emergency Vehicle";
CM_ SG_ 424 OBJ_EMERGENCY_LIGHT_COLOR_11 "Emergency Color";
CM_ SG_ 424 OBJ_EMERGENCY_V_11 "Are OBJ_Is_EMERGENCY_VCL and OBJ_EMERGENCY_LIGHT_COLOR Valid";
CM_ SG_ 425 OBJ_Sync_ID_12_0 "The ID of the Sync message, used to synchronize between signals in the system. Every new frame promotes the sync ID by one.";
CM_ SG_ 425 OBJ_CRC_12 "Calculated over all element signals. From the signal after the CRC until the first signal in the next elements OBJ_CRC_N+1  not including";
CM_ SG_ 425 OBJ_ID_12 "The detected object ID. Range is 1-255, while 0 indicates that the field in unfilled.";
CM_ SG_ 425 OBJ_Existence_Probability_12 "The existence probability of the vehicle";
CM_ SG_ 425 OBJ_Motion_Category_12 "Relevant for VD only. Full description of values can be found at the ACC guide.";
CM_ SG_ 425 OBJ_Object_Age_12 "The number of frames in which the object was recognized.";
CM_ SG_ 425 OBJ_Measuring_Status_12 "Measurment status. Old vs New marks if this is the first frame in which the object is reported. Predicted vs Measured marks if the report is raw or has been predicted forward in time using the measured dynamics and ego motion.";
CM_ SG_ 425 OBJ_Object_Class_12 "Indicates the object type. Uncertain is outputted in case the probability that a vehicle is a truck is very similar to the probability that it is a car.";
CM_ SG_ 425 OBJ_Class_Probability_12 "The probability of this type classification.";
CM_ SG_ 425 OBJ_Motion_Status_12 "MOVING - the object is moving STATIONARY - the object was never seen moving STOPPED -  the object was moving and has stopped MOVING_SLOWLY - the object is moving very slowly";
CM_ SG_ 425 OBJ_Motion_Orientation_12 "The direction of the targets heading compared to the host.";
CM_ SG_ 425 OBJ_Has_Cut_Lane_12 "Indicates whether the object cut the host's (right or left) lane. In case there are no lanes, indicates whether the objects is at most 1 meters away from the host.";
CM_ SG_ 425 OBJ_Has_Cut_Path_12 "Indicates whether the object is in the host's path.";
CM_ SG_ 425 OBJ_Brake_Light_12 "Indication for brake lights";
CM_ SG_ 425 OBJ_Turn_Indicator_Right_12 "Indication for blinking right light.";
CM_ SG_ 425 OBJ_Turn_Indicator_Left_12 "Indication for blinking left light";
CM_ SG_ 425 OBJ_Light_Indicator_Validity_12 "Validator for light indicators";
CM_ SG_ 425 OBJ_Right_Out_Of_Image_12 "Indicates whether the measurment are predicted out of the right side of the image bounderies.";
CM_ SG_ 425 OBJ_Left_Out_Of_Image_12 "Indicates whether if measurment are predicted out of  the left side of the image bounderies";
CM_ SG_ 425 OBJ_Right_Out_Of_Image_V_12 "validator";
CM_ SG_ 425 OBJ_Left_Out_Of_Image_V_12 "validator";
CM_ SG_ 425 OBJ_Top_Out_Of_Image_12 "Indicates whether if measurment are predicted out of  the top of the image bounderies";
CM_ SG_ 425 OBJ_Bottom_Out_Of_Image_12 "Indicates whether if measurment are predicted out of  the bottom of the image bounderies";
CM_ SG_ 425 OBJ_Top_Out_Of_Image_V_12 "validator";
CM_ SG_ 425 OBJ_Bottom_Out_Of_Image_V_12 "validator";
CM_ SG_ 425 OBJ_Lane_Assignment_12 "The object's lane relative to the host lane.";
CM_ SG_ 425 OBJ_Lane_Assignment_V_12 "Validator for lane assignment";
CM_ SG_ 425 OBJ_Age_Seconds_12 "Time in seconds in which the object was recognized.";
CM_ SG_ 425 OBJ_Age_Seconds_V_12 "Validator for object age";
CM_ SG_ 425 OBJ_Width_12 "The width of the target vehicle in the world (not to be mistaken with the width of the visible part of the vehicle).";
CM_ SG_ 425 OBJ_Width_V_12 "Validator for object width";
CM_ SG_ 425 OBJ_Width_STD_12 "Standard deviation for object width";
CM_ SG_ 425 OBJ_Width_STD_V_12 "Validator for the standard deviation of object width";
CM_ SG_ 425 OBJ_Length_12 "The length of the vehicle in the world. For crossing bicycles it gives the viewed length of the bicycle.";
CM_ SG_ 425 OBJ_Length_V_12 "Validator for object length.";
CM_ SG_ 425 OBJ_Length_STD_12 "Standard deviation for object length.";
CM_ SG_ 425 OBJ_Length_STD_V_12 "Validator for the standard deviation of object length.";
CM_ SG_ 425 OBJ_Height_12 "The height of the object in the world.";
CM_ SG_ 425 OBJ_Height_V_12 "Validator for object height.";
CM_ SG_ 425 OBJ_Height_STD_12 "Standard deviation for object height.";
CM_ SG_ 425 OBJ_Height_STD_V_12 "Validator for the standard deviation of object height.";
CM_ SG_ 425 OBJ_Abs_Long_Velocity_12 "Absolute longitudinal velocity.";
CM_ SG_ 425 OBJ_Abs_Long_Velocity_V_12 "Validator for absolute longitudinal velocity.";
CM_ SG_ 425 OBJ_Abs_Long_Velocity_STD_12 "Standard deviation of absolute longitudinal velocity.";
CM_ SG_ 425 OBJ_Abs_Long_Vel_STD_V_12 "Validator for the standard deviation of the absolute longitudinal velocity.";
CM_ SG_ 425 OBJ_Abs_Lat_Velocity_12 "The lateral ground speed of the object.";
CM_ SG_ 425 OBJ_Abs_Lat_Velocity_V_12 "Validator for the lateral ground speed of the object.";
CM_ SG_ 425 OBJ_Abs_Lat_Velocity_STD_12 "STD of the lateral ground speed of the object.";
CM_ SG_ 425 OBJ_Abs_Lat_Vel_STD_V_12 "Validator for the STD of the lateral ground speed of the object.";
CM_ SG_ 425 OBJ_Abs_Long_Acc_12 "The longitudinal ground acceleration of the object.";
CM_ SG_ 425 OBJ_Abs_Long_Acc_V_12 "Validator for the longitudinal ground acceleration of the object.";
CM_ SG_ 425 OBJ_Abs_Long_Acc_STD_12 "STD of the longitudinal ground acceleration of the object.";
CM_ SG_ 425 OBJ_Abs_Long_Acc_STD_V_12 "Validator for the STD of the longitudinal ground acceleration of the object.";
CM_ SG_ 425 OBJ_Abs_Lat_Acc_12 "The lateral ground acceleration of the object.";
CM_ SG_ 425 OBJ_Abs_Lat_Acc_V_12 "Validator for the lateral ground acceleration of the object.";
CM_ SG_ 425 OBJ_Abs_Lat_Acc_STD_12 "STD of the lateral ground acceleration of the object.";
CM_ SG_ 425 OBJ_Abs_Lat_Acc_STD_V_12 "Validator for the STD of the lateral ground acceleration of the object.";
CM_ SG_ 425 OBJ_Abs_Acceleration_12 "The absolute ground acceleration in the target's heading direction.";
CM_ SG_ 425 OBJ_Abs_Acceleration_V_12 "Validator for the absolute ground acceleration.";
CM_ SG_ 425 OBJ_Abs_Acc_STD_12 "STD of the absolute ground acceleration.";
CM_ SG_ 425 OBJ_Abs_Acc_STD_V_12 "Validator for the STD of the absolute ground acceleration.";
CM_ SG_ 425 OBJ_Inv_TTC_12 "Inverse TTC (time to collision).";
CM_ SG_ 425 OBJ_Inv_TTC_STD_12 "STD for inverse TTC .";
CM_ SG_ 425 OBJ_Inv_TTC_STD_V_12 "Validator for the STD for inverse TTC .";
CM_ SG_ 425 OBJ_Relative_Long_Acc_12 "The relative lateral ground acceleration of the object.";
CM_ SG_ 425 OBJ_Relative_Long_Acc_V_12 "Validator for the relative lateral ground acceleration of the object.";
CM_ SG_ 425 OBJ_Relative_Long_Acc_STD_12 "STD of the relative lateral ground acceleration of the object.";
CM_ SG_ 425 OBJ_Rel_Long_Acc_STD_V_12 "Validator for the STD of the relative lateral ground acceleration.";
CM_ SG_ 425 OBJ_Relative_Long_Velocity_12 "The relative longtitudinal speed between the target and ego vehicle.";
CM_ SG_ 425 OBJ_Relative_Long_Velocity_V_12 "Validator for the relative longtitudinal speed.";
CM_ SG_ 425 OBJ_Relative_Long_Vel_STD_12 "STD of the relative longtitudinal speed.";
CM_ SG_ 425 OBJ_Rel_Long_Vel_STD_V_12 "Validator for the STD of the relative longtitudinal speed.";
CM_ SG_ 426 OBJ_Sync_ID_12_1 "The ID of the Sync message, used to synchronize between signals in the system. Every new frame promotes the sync ID by one.";
CM_ SG_ 426 OBJ_Relative_Lat_Velocity_12 "The relative lateral speed between the target and ego vehicle.";
CM_ SG_ 426 OBJ_Relative_Lat_Velocity_V_12 "Validator for the relative lateral speed.";
CM_ SG_ 426 OBJ_Relative_Lat_Velocity_STD_12 "STD of the relative lateral speed.";
CM_ SG_ 426 OBJ_Rel_Lat_Vel_STD_V_12 "Validator for the STD of the relative lateral speed.";
CM_ SG_ 426 OBJ_Long_Distance_12 "The longtitudinal distance from the object to middle of the rear bumper (middle of the RL and RR corners) of the target.";
CM_ SG_ 426 OBJ_Long_Distance_V_12 "Validator of the longtitudinal distance field";
CM_ SG_ 426 OBJ_Long_Distance_STD_12 "STD of the  longtitudinal distance.";
CM_ SG_ 426 OBJ_Long_Distance_STD_V_12 "Validator for the STD of the  longtitudinal distance.";
CM_ SG_ 426 OBJ_Lat_Distance_12 "Lateral distance to the middle of the RL and RR corners.";
CM_ SG_ 426 OBJ_Lat_Distance_V_12 "Validator for the lateral distance of the object.";
CM_ SG_ 426 OBJ_Lat_Distance_STD_12 "STD of the lateral distance of the object.";
CM_ SG_ 426 OBJ_Lat_Distance_STD_V_12 "Validator for the STD of the lateral distance of the object.";
CM_ SG_ 426 OBJ_Absolute_Speed_12 "The absolute ground speed in the targets' heading direction.";
CM_ SG_ 426 OBJ_Absolute_Speed_V_12 "Validator for the absolute ground speed.";
CM_ SG_ 426 OBJ_Absolute_Speed_STD_12 "STD of the absolute ground speed.";
CM_ SG_ 426 OBJ_Absolute_Speed_STD_V_12 "Validator for the STD of the absolute ground speed.";
CM_ SG_ 426 OBJ_Heading_12 "The angle beetweenthe host longitudinal axis and target's heading (clockwise, e.g. PI/2 is a target crossing from left to right).";
CM_ SG_ 426 OBJ_Heading_V_12 "Validator for the object heading.";
CM_ SG_ 426 OBJ_Heading_STD_12 "STD of the object heading.";
CM_ SG_ 426 OBJ_Heading_STD_V_12 "Validator for the STD of the object heading.";
CM_ SG_ 426 OBJ_Angle_Rate_STD_12 "Standard deviation of the angular speed. (radians)";
CM_ SG_ 426 OBJ_Angle_Rate_STD_V_12 "Validator for the STD of the angular speed.";
CM_ SG_ 426 OBJ_Angle_Rate_12 "The momentary angular speed of the object. (radians)";
CM_ SG_ 426 OBJ_Angle_Rate_V_12 "Validator for the angular speed.";
CM_ SG_ 426 OBJ_Angle_Right_12 "The angle between the host longitudinal axis and the right side of the front / rear of the target (the visible one). The positive side is to the host's right.";
CM_ SG_ 426 OBJ_Angle_Right_V_12 "Validator for angleRight";
CM_ SG_ 426 OBJ_Angle_Right_STD_12 "Standard deviation of angleRight";
CM_ SG_ 426 OBJ_Angle_Right_STD_V_12 "Validator for the standard deviation of angleRight.";
CM_ SG_ 426 OBJ_Angle_Left_12 "The angle between the host longitudinal axis and the left side of the front / rear of the target (the visible one). The positive side is to the host's right.";
CM_ SG_ 426 OBJ_Angle_Left_V_12 "Validator for angleLeft.";
CM_ SG_ 426 OBJ_Angle_Left_STD_12 "Standard deviation of angleLeft.";
CM_ SG_ 426 OBJ_Angle_Left_STD_V_12 "Validator for the standard deviation of angleLeft.";
CM_ SG_ 426 OBJ_Angle_Side_12 "The angle between the host longitudinal axis and the far visible edge - the visible edge of the front / rear of the target that is not visible. Currently supported for vehicles only.";
CM_ SG_ 426 OBJ_Angle_Side_V_12 "Validator for angleSide.";
CM_ SG_ 426 OBJ_Angle_Side_STD_12 "Standard deviation of angleSide.";
CM_ SG_ 426 OBJ_Angle_Side_STD_V_12 "Validator for the STD of angleSide.";
CM_ SG_ 426 OBJ_Angle_Mid_V_12 "Validator for angleMid.";
CM_ SG_ 426 OBJ_Angle_Mid_12 "The angle between the host longitudinal axis and the middle of the front / rear of the target (the visible one). The positive side is to the host's right.";
CM_ SG_ 426 OBJ_Angle_Mid_STD_12 "Standard deviation of angleMid.";
CM_ SG_ 426 OBJ_Angle_Mid_STD_V_12 "Validator for the STD of angleMid.";
CM_ SG_ 426 OBJ_Angle_Bottom_V_12 "Validator for OBJAngle_Bottom.";
CM_ SG_ 426 OBJ_Angle_Bottom_12 "The angle between the longitudinal axis and the Bottom of the front / rear of the target (the visible one). The positive side is to the host's bottom";
CM_ SG_ 426 OBJ_Angle_Bottom_STD_12 "STD for OBJAngle_Bottom.";
CM_ SG_ 426 OBJ_Angle_Bottom_STD_V_12 "Validator for OBJAngle_Bottom_STD.";
CM_ SG_ 426 OBJ_Visibility_Side_V_12 "Currently Supported for VD only";
CM_ SG_ 426 OBJ_Visibility_Side_12 "From what car  side is the object visible";
CM_ SG_ 426 OBJ_Is_In_Drivable_Area_12 "Indicates whether the target is in a driveable area.";
CM_ SG_ 426 OBJ_Is_In_Drivable_Area_V_12 "Validator for OBJ_Is_In_Drivable_Area.";
CM_ SG_ 426 OBJ_Is_VeryClose_V_12 "Validator for OBJ_Is_VeryClose.";
CM_ SG_ 426 OBJ_Is_VeryClose_12 "Indicates whether the target is very close to the host such that it is hard to measure its distance. Currently relevant for peds only";
CM_ SG_ 426 OBJ_Is_EMERGENCY_VCL_12 "Is Object an Emergency Vehicle";
CM_ SG_ 426 OBJ_EMERGENCY_LIGHT_COLOR_12 "Emergency Color";
CM_ SG_ 426 OBJ_EMERGENCY_V_12 "Are OBJ_Is_EMERGENCY_VCL and OBJ_EMERGENCY_LIGHT_COLOR Valid";
CM_ SG_ 427 OBJ_Sync_ID_13_0 "The ID of the Sync message, used to synchronize between signals in the system. Every new frame promotes the sync ID by one.";
CM_ SG_ 427 OBJ_CRC_13 "Calculated over all element signals. From the signal after the CRC until the first signal in the next elements OBJ_CRC_N+1  not including";
CM_ SG_ 427 OBJ_ID_13 "The detected object ID. Range is 1-255, while 0 indicates that the field in unfilled.";
CM_ SG_ 427 OBJ_Existence_Probability_13 "The existence probability of the vehicle";
CM_ SG_ 427 OBJ_Motion_Category_13 "Relevant for VD only. Full description of values can be found at the ACC guide.";
CM_ SG_ 427 OBJ_Object_Age_13 "The number of frames in which the object was recognized.";
CM_ SG_ 427 OBJ_Measuring_Status_13 "Measurment status. Old vs New marks if this is the first frame in which the object is reported. Predicted vs Measured marks if the report is raw or has been predicted forward in time using the measured dynamics and ego motion.";
CM_ SG_ 427 OBJ_Object_Class_13 "Indicates the object type. Uncertain is outputted in case the probability that a vehicle is a truck is very similar to the probability that it is a car.";
CM_ SG_ 427 OBJ_Class_Probability_13 "The probability of this type classification.";
CM_ SG_ 427 OBJ_Motion_Status_13 "MOVING - the object is moving STATIONARY - the object was never seen moving STOPPED -  the object was moving and has stopped MOVING_SLOWLY - the object is moving very slowly";
CM_ SG_ 427 OBJ_Motion_Orientation_13 "The direction of the targets heading compared to the host.";
CM_ SG_ 427 OBJ_Has_Cut_Lane_13 "Indicates whether the object cut the host's (right or left) lane. In case there are no lanes, indicates whether the objects is at most 1 meters away from the host.";
CM_ SG_ 427 OBJ_Has_Cut_Path_13 "Indicates whether the object is in the host's path.";
CM_ SG_ 427 OBJ_Brake_Light_13 "Indication for brake lights";
CM_ SG_ 427 OBJ_Turn_Indicator_Right_13 "Indication for blinking right light.";
CM_ SG_ 427 OBJ_Turn_Indicator_Left_13 "Indication for blinking left light";
CM_ SG_ 427 OBJ_Light_Indicator_Validity_13 "Validator for light indicators";
CM_ SG_ 427 OBJ_Right_Out_Of_Image_13 "Indicates whether the measurment are predicted out of the right side of the image bounderies.";
CM_ SG_ 427 OBJ_Left_Out_Of_Image_13 "Indicates whether if measurment are predicted out of  the left side of the image bounderies";
CM_ SG_ 427 OBJ_Right_Out_Of_Image_V_13 "validator";
CM_ SG_ 427 OBJ_Left_Out_Of_Image_V_13 "validator";
CM_ SG_ 427 OBJ_Top_Out_Of_Image_13 "Indicates whether if measurment are predicted out of  the top of the image bounderies";
CM_ SG_ 427 OBJ_Bottom_Out_Of_Image_13 "Indicates whether if measurment are predicted out of  the bottom of the image bounderies";
CM_ SG_ 427 OBJ_Top_Out_Of_Image_V_13 "validator";
CM_ SG_ 427 OBJ_Bottom_Out_Of_Image_V_13 "validator";
CM_ SG_ 427 OBJ_Lane_Assignment_13 "The object's lane relative to the host lane.";
CM_ SG_ 427 OBJ_Lane_Assignment_V_13 "Validator for lane assignment";
CM_ SG_ 427 OBJ_Age_Seconds_13 "Time in seconds in which the object was recognized.";
CM_ SG_ 427 OBJ_Age_Seconds_V_13 "Validator for object age";
CM_ SG_ 427 OBJ_Width_13 "The width of the target vehicle in the world (not to be mistaken with the width of the visible part of the vehicle).";
CM_ SG_ 427 OBJ_Width_V_13 "Validator for object width";
CM_ SG_ 427 OBJ_Width_STD_13 "Standard deviation for object width";
CM_ SG_ 427 OBJ_Width_STD_V_13 "Validator for the standard deviation of object width";
CM_ SG_ 427 OBJ_Length_13 "The length of the vehicle in the world. For crossing bicycles it gives the viewed length of the bicycle.";
CM_ SG_ 427 OBJ_Length_V_13 "Validator for object length.";
CM_ SG_ 427 OBJ_Length_STD_13 "Standard deviation for object length.";
CM_ SG_ 427 OBJ_Length_STD_V_13 "Validator for the standard deviation of object length.";
CM_ SG_ 427 OBJ_Height_13 "The height of the object in the world.";
CM_ SG_ 427 OBJ_Height_V_13 "Validator for object height.";
CM_ SG_ 427 OBJ_Height_STD_13 "Standard deviation for object height.";
CM_ SG_ 427 OBJ_Height_STD_V_13 "Validator for the standard deviation of object height.";
CM_ SG_ 427 OBJ_Abs_Long_Velocity_13 "Absolute longitudinal velocity.";
CM_ SG_ 427 OBJ_Abs_Long_Velocity_V_13 "Validator for absolute longitudinal velocity.";
CM_ SG_ 427 OBJ_Abs_Long_Velocity_STD_13 "Standard deviation of absolute longitudinal velocity.";
CM_ SG_ 427 OBJ_Abs_Long_Vel_STD_V_13 "Validator for the standard deviation of the absolute longitudinal velocity.";
CM_ SG_ 427 OBJ_Abs_Lat_Velocity_13 "The lateral ground speed of the object.";
CM_ SG_ 427 OBJ_Abs_Lat_Velocity_V_13 "Validator for the lateral ground speed of the object.";
CM_ SG_ 427 OBJ_Abs_Lat_Velocity_STD_13 "STD of the lateral ground speed of the object.";
CM_ SG_ 427 OBJ_Abs_Lat_Vel_STD_V_13 "Validator for the STD of the lateral ground speed of the object.";
CM_ SG_ 427 OBJ_Abs_Long_Acc_13 "The longitudinal ground acceleration of the object.";
CM_ SG_ 427 OBJ_Abs_Long_Acc_V_13 "Validator for the longitudinal ground acceleration of the object.";
CM_ SG_ 427 OBJ_Abs_Long_Acc_STD_13 "STD of the longitudinal ground acceleration of the object.";
CM_ SG_ 427 OBJ_Abs_Long_Acc_STD_V_13 "Validator for the STD of the longitudinal ground acceleration of the object.";
CM_ SG_ 427 OBJ_Abs_Lat_Acc_13 "The lateral ground acceleration of the object.";
CM_ SG_ 427 OBJ_Abs_Lat_Acc_V_13 "Validator for the lateral ground acceleration of the object.";
CM_ SG_ 427 OBJ_Abs_Lat_Acc_STD_13 "STD of the lateral ground acceleration of the object.";
CM_ SG_ 427 OBJ_Abs_Lat_Acc_STD_V_13 "Validator for the STD of the lateral ground acceleration of the object.";
CM_ SG_ 427 OBJ_Abs_Acceleration_13 "The absolute ground acceleration in the target's heading direction.";
CM_ SG_ 427 OBJ_Abs_Acceleration_V_13 "Validator for the absolute ground acceleration.";
CM_ SG_ 427 OBJ_Abs_Acc_STD_13 "STD of the absolute ground acceleration.";
CM_ SG_ 427 OBJ_Abs_Acc_STD_V_13 "Validator for the STD of the absolute ground acceleration.";
CM_ SG_ 427 OBJ_Inv_TTC_13 "Inverse TTC (time to collision).";
CM_ SG_ 427 OBJ_Inv_TTC_STD_13 "STD for inverse TTC .";
CM_ SG_ 427 OBJ_Inv_TTC_STD_V_13 "Validator for the STD for inverse TTC .";
CM_ SG_ 427 OBJ_Relative_Long_Acc_13 "The relative lateral ground acceleration of the object.";
CM_ SG_ 427 OBJ_Relative_Long_Acc_V_13 "Validator for the relative lateral ground acceleration of the object.";
CM_ SG_ 427 OBJ_Relative_Long_Acc_STD_13 "STD of the relative lateral ground acceleration of the object.";
CM_ SG_ 427 OBJ_Rel_Long_Acc_STD_V_13 "Validator for the STD of the relative lateral ground acceleration.";
CM_ SG_ 427 OBJ_Relative_Long_Velocity_13 "The relative longtitudinal speed between the target and ego vehicle.";
CM_ SG_ 427 OBJ_Relative_Long_Velocity_V_13 "Validator for the relative longtitudinal speed.";
CM_ SG_ 427 OBJ_Relative_Long_Vel_STD_13 "STD of the relative longtitudinal speed.";
CM_ SG_ 427 OBJ_Rel_Long_Vel_STD_V_13 "Validator for the STD of the relative longtitudinal speed.";
CM_ SG_ 428 OBJ_Sync_ID_13_1 "The ID of the Sync message, used to synchronize between signals in the system. Every new frame promotes the sync ID by one.";
CM_ SG_ 428 OBJ_Relative_Lat_Velocity_13 "The relative lateral speed between the target and ego vehicle.";
CM_ SG_ 428 OBJ_Relative_Lat_Velocity_V_13 "Validator for the relative lateral speed.";
CM_ SG_ 428 OBJ_Relative_Lat_Velocity_STD_13 "STD of the relative lateral speed.";
CM_ SG_ 428 OBJ_Rel_Lat_Vel_STD_V_13 "Validator for the STD of the relative lateral speed.";
CM_ SG_ 428 OBJ_Long_Distance_13 "The longtitudinal distance from the object to middle of the rear bumper (middle of the RL and RR corners) of the target.";
CM_ SG_ 428 OBJ_Long_Distance_V_13 "Validator of the longtitudinal distance field";
CM_ SG_ 428 OBJ_Long_Distance_STD_13 "STD of the  longtitudinal distance.";
CM_ SG_ 428 OBJ_Long_Distance_STD_V_13 "Validator for the STD of the  longtitudinal distance.";
CM_ SG_ 428 OBJ_Lat_Distance_13 "Lateral distance to the middle of the RL and RR corners.";
CM_ SG_ 428 OBJ_Lat_Distance_V_13 "Validator for the lateral distance of the object.";
CM_ SG_ 428 OBJ_Lat_Distance_STD_13 "STD of the lateral distance of the object.";
CM_ SG_ 428 OBJ_Lat_Distance_STD_V_13 "Validator for the STD of the lateral distance of the object.";
CM_ SG_ 428 OBJ_Absolute_Speed_13 "The absolute ground speed in the targets' heading direction.";
CM_ SG_ 428 OBJ_Absolute_Speed_V_13 "Validator for the absolute ground speed.";
CM_ SG_ 428 OBJ_Absolute_Speed_STD_13 "STD of the absolute ground speed.";
CM_ SG_ 428 OBJ_Absolute_Speed_STD_V_13 "Validator for the STD of the absolute ground speed.";
CM_ SG_ 428 OBJ_Heading_13 "The angle beetweenthe host longitudinal axis and target's heading (clockwise, e.g. PI/2 is a target crossing from left to right).";
CM_ SG_ 428 OBJ_Heading_V_13 "Validator for the object heading.";
CM_ SG_ 428 OBJ_Heading_STD_13 "STD of the object heading.";
CM_ SG_ 428 OBJ_Heading_STD_V_13 "Validator for the STD of the object heading.";
CM_ SG_ 428 OBJ_Angle_Rate_STD_13 "Standard deviation of the angular speed. (radians)";
CM_ SG_ 428 OBJ_Angle_Rate_STD_V_13 "Validator for the STD of the angular speed.";
CM_ SG_ 428 OBJ_Angle_Rate_13 "The momentary angular speed of the object. (radians)";
CM_ SG_ 428 OBJ_Angle_Rate_V_13 "Validator for the angular speed.";
CM_ SG_ 428 OBJ_Angle_Right_13 "The angle between the host longitudinal axis and the right side of the front / rear of the target (the visible one). The positive side is to the host's right.";
CM_ SG_ 428 OBJ_Angle_Right_V_13 "Validator for angleRight";
CM_ SG_ 428 OBJ_Angle_Right_STD_13 "Standard deviation of angleRight";
CM_ SG_ 428 OBJ_Angle_Right_STD_V_13 "Validator for the standard deviation of angleRight.";
CM_ SG_ 428 OBJ_Angle_Left_13 "The angle between the host longitudinal axis and the left side of the front / rear of the target (the visible one). The positive side is to the host's right.";
CM_ SG_ 428 OBJ_Angle_Left_V_13 "Validator for angleLeft.";
CM_ SG_ 428 OBJ_Angle_Left_STD_13 "Standard deviation of angleLeft.";
CM_ SG_ 428 OBJ_Angle_Left_STD_V_13 "Validator for the standard deviation of angleLeft.";
CM_ SG_ 428 OBJ_Angle_Side_13 "The angle between the host longitudinal axis and the far visible edge - the visible edge of the front / rear of the target that is not visible. Currently supported for vehicles only.";
CM_ SG_ 428 OBJ_Angle_Side_V_13 "Validator for angleSide.";
CM_ SG_ 428 OBJ_Angle_Side_STD_13 "Standard deviation of angleSide.";
CM_ SG_ 428 OBJ_Angle_Side_STD_V_13 "Validator for the STD of angleSide.";
CM_ SG_ 428 OBJ_Angle_Mid_V_13 "Validator for angleMid.";
CM_ SG_ 428 OBJ_Angle_Mid_13 "The angle between the host longitudinal axis and the middle of the front / rear of the target (the visible one). The positive side is to the host's right.";
CM_ SG_ 428 OBJ_Angle_Mid_STD_13 "Standard deviation of angleMid.";
CM_ SG_ 428 OBJ_Angle_Mid_STD_V_13 "Validator for the STD of angleMid.";
CM_ SG_ 428 OBJ_Angle_Bottom_V_13 "Validator for OBJAngle_Bottom.";
CM_ SG_ 428 OBJ_Angle_Bottom_13 "The angle between the longitudinal axis and the Bottom of the front / rear of the target (the visible one). The positive side is to the host's bottom";
CM_ SG_ 428 OBJ_Angle_Bottom_STD_13 "STD for OBJAngle_Bottom.";
CM_ SG_ 428 OBJ_Angle_Bottom_STD_V_13 "Validator for OBJAngle_Bottom_STD.";
CM_ SG_ 428 OBJ_Visibility_Side_V_13 "Currently Supported for VD only";
CM_ SG_ 428 OBJ_Visibility_Side_13 "From what car  side is the object visible";
CM_ SG_ 428 OBJ_Is_In_Drivable_Area_13 "Indicates whether the target is in a driveable area.";
CM_ SG_ 428 OBJ_Is_In_Drivable_Area_V_13 "Validator for OBJ_Is_In_Drivable_Area.";
CM_ SG_ 428 OBJ_Is_VeryClose_V_13 "Validator for OBJ_Is_VeryClose.";
CM_ SG_ 428 OBJ_Is_VeryClose_13 "Indicates whether the target is very close to the host such that it is hard to measure its distance. Currently relevant for peds only";
CM_ SG_ 428 OBJ_Is_EMERGENCY_VCL_13 "Is Object an Emergency Vehicle";
CM_ SG_ 428 OBJ_EMERGENCY_LIGHT_COLOR_13 "Emergency Color";
CM_ SG_ 428 OBJ_EMERGENCY_V_13 "Are OBJ_Is_EMERGENCY_VCL and OBJ_EMERGENCY_LIGHT_COLOR Valid";
CM_ SG_ 429 OBJ_Sync_ID_14_0 "The ID of the Sync message, used to synchronize between signals in the system. Every new frame promotes the sync ID by one.";
CM_ SG_ 429 OBJ_CRC_14 "Calculated over all element signals. From the signal after the CRC until the first signal in the next elements OBJ_CRC_N+1  not including";
CM_ SG_ 429 OBJ_ID_14 "The detected object ID. Range is 1-255, while 0 indicates that the field in unfilled.";
CM_ SG_ 429 OBJ_Existence_Probability_14 "The existence probability of the vehicle";
CM_ SG_ 429 OBJ_Motion_Category_14 "Relevant for VD only. Full description of values can be found at the ACC guide.";
CM_ SG_ 429 OBJ_Object_Age_14 "The number of frames in which the object was recognized.";
CM_ SG_ 429 OBJ_Measuring_Status_14 "Measurment status. Old vs New marks if this is the first frame in which the object is reported. Predicted vs Measured marks if the report is raw or has been predicted forward in time using the measured dynamics and ego motion.";
CM_ SG_ 429 OBJ_Object_Class_14 "Indicates the object type. Uncertain is outputted in case the probability that a vehicle is a truck is very similar to the probability that it is a car.";
CM_ SG_ 429 OBJ_Class_Probability_14 "The probability of this type classification.";
CM_ SG_ 429 OBJ_Motion_Status_14 "MOVING - the object is moving STATIONARY - the object was never seen moving STOPPED -  the object was moving and has stopped MOVING_SLOWLY - the object is moving very slowly";
CM_ SG_ 429 OBJ_Motion_Orientation_14 "The direction of the targets heading compared to the host.";
CM_ SG_ 429 OBJ_Has_Cut_Lane_14 "Indicates whether the object cut the host's (right or left) lane. In case there are no lanes, indicates whether the objects is at most 1 meters away from the host.";
CM_ SG_ 429 OBJ_Has_Cut_Path_14 "Indicates whether the object is in the host's path.";
CM_ SG_ 429 OBJ_Brake_Light_14 "Indication for brake lights";
CM_ SG_ 429 OBJ_Turn_Indicator_Right_14 "Indication for blinking right light.";
CM_ SG_ 429 OBJ_Turn_Indicator_Left_14 "Indication for blinking left light";
CM_ SG_ 429 OBJ_Light_Indicator_Validity_14 "Validator for light indicators";
CM_ SG_ 429 OBJ_Right_Out_Of_Image_14 "Indicates whether the measurment are predicted out of the right side of the image bounderies.";
CM_ SG_ 429 OBJ_Left_Out_Of_Image_14 "Indicates whether if measurment are predicted out of  the left side of the image bounderies";
CM_ SG_ 429 OBJ_Right_Out_Of_Image_V_14 "validator";
CM_ SG_ 429 OBJ_Left_Out_Of_Image_V_14 "validator";
CM_ SG_ 429 OBJ_Top_Out_Of_Image_14 "Indicates whether if measurment are predicted out of  the top of the image bounderies";
CM_ SG_ 429 OBJ_Bottom_Out_Of_Image_14 "Indicates whether if measurment are predicted out of  the bottom of the image bounderies";
CM_ SG_ 429 OBJ_Top_Out_Of_Image_V_14 "validator";
CM_ SG_ 429 OBJ_Bottom_Out_Of_Image_V_14 "validator";
CM_ SG_ 429 OBJ_Lane_Assignment_14 "The object's lane relative to the host lane.";
CM_ SG_ 429 OBJ_Lane_Assignment_V_14 "Validator for lane assignment";
CM_ SG_ 429 OBJ_Age_Seconds_14 "Time in seconds in which the object was recognized.";
CM_ SG_ 429 OBJ_Age_Seconds_V_14 "Validator for object age";
CM_ SG_ 429 OBJ_Width_14 "The width of the target vehicle in the world (not to be mistaken with the width of the visible part of the vehicle).";
CM_ SG_ 429 OBJ_Width_V_14 "Validator for object width";
CM_ SG_ 429 OBJ_Width_STD_14 "Standard deviation for object width";
CM_ SG_ 429 OBJ_Width_STD_V_14 "Validator for the standard deviation of object width";
CM_ SG_ 429 OBJ_Length_14 "The length of the vehicle in the world. For crossing bicycles it gives the viewed length of the bicycle.";
CM_ SG_ 429 OBJ_Length_V_14 "Validator for object length.";
CM_ SG_ 429 OBJ_Length_STD_14 "Standard deviation for object length.";
CM_ SG_ 429 OBJ_Length_STD_V_14 "Validator for the standard deviation of object length.";
CM_ SG_ 429 OBJ_Height_14 "The height of the object in the world.";
CM_ SG_ 429 OBJ_Height_V_14 "Validator for object height.";
CM_ SG_ 429 OBJ_Height_STD_14 "Standard deviation for object height.";
CM_ SG_ 429 OBJ_Height_STD_V_14 "Validator for the standard deviation of object height.";
CM_ SG_ 429 OBJ_Abs_Long_Velocity_14 "Absolute longitudinal velocity.";
CM_ SG_ 429 OBJ_Abs_Long_Velocity_V_14 "Validator for absolute longitudinal velocity.";
CM_ SG_ 429 OBJ_Abs_Long_Velocity_STD_14 "Standard deviation of absolute longitudinal velocity.";
CM_ SG_ 429 OBJ_Abs_Long_Vel_STD_V_14 "Validator for the standard deviation of the absolute longitudinal velocity.";
CM_ SG_ 429 OBJ_Abs_Lat_Velocity_14 "The lateral ground speed of the object.";
CM_ SG_ 429 OBJ_Abs_Lat_Velocity_V_14 "Validator for the lateral ground speed of the object.";
CM_ SG_ 429 OBJ_Abs_Lat_Velocity_STD_14 "STD of the lateral ground speed of the object.";
CM_ SG_ 429 OBJ_Abs_Lat_Vel_STD_V_14 "Validator for the STD of the lateral ground speed of the object.";
CM_ SG_ 429 OBJ_Abs_Long_Acc_14 "The longitudinal ground acceleration of the object.";
CM_ SG_ 429 OBJ_Abs_Long_Acc_V_14 "Validator for the longitudinal ground acceleration of the object.";
CM_ SG_ 429 OBJ_Abs_Long_Acc_STD_14 "STD of the longitudinal ground acceleration of the object.";
CM_ SG_ 429 OBJ_Abs_Long_Acc_STD_V_14 "Validator for the STD of the longitudinal ground acceleration of the object.";
CM_ SG_ 429 OBJ_Abs_Lat_Acc_14 "The lateral ground acceleration of the object.";
CM_ SG_ 429 OBJ_Abs_Lat_Acc_V_14 "Validator for the lateral ground acceleration of the object.";
CM_ SG_ 429 OBJ_Abs_Lat_Acc_STD_14 "STD of the lateral ground acceleration of the object.";
CM_ SG_ 429 OBJ_Abs_Lat_Acc_STD_V_14 "Validator for the STD of the lateral ground acceleration of the object.";
CM_ SG_ 429 OBJ_Abs_Acceleration_14 "The absolute ground acceleration in the target's heading direction.";
CM_ SG_ 429 OBJ_Abs_Acceleration_V_14 "Validator for the absolute ground acceleration.";
CM_ SG_ 429 OBJ_Abs_Acc_STD_14 "STD of the absolute ground acceleration.";
CM_ SG_ 429 OBJ_Abs_Acc_STD_V_14 "Validator for the STD of the absolute ground acceleration.";
CM_ SG_ 429 OBJ_Inv_TTC_14 "Inverse TTC (time to collision).";
CM_ SG_ 429 OBJ_Inv_TTC_STD_14 "STD for inverse TTC .";
CM_ SG_ 429 OBJ_Inv_TTC_STD_V_14 "Validator for the STD for inverse TTC .";
CM_ SG_ 429 OBJ_Relative_Long_Acc_14 "The relative lateral ground acceleration of the object.";
CM_ SG_ 429 OBJ_Relative_Long_Acc_V_14 "Validator for the relative lateral ground acceleration of the object.";
CM_ SG_ 429 OBJ_Relative_Long_Acc_STD_14 "STD of the relative lateral ground acceleration of the object.";
CM_ SG_ 429 OBJ_Rel_Long_Acc_STD_V_14 "Validator for the STD of the relative lateral ground acceleration.";
CM_ SG_ 429 OBJ_Relative_Long_Velocity_14 "The relative longtitudinal speed between the target and ego vehicle.";
CM_ SG_ 429 OBJ_Relative_Long_Velocity_V_14 "Validator for the relative longtitudinal speed.";
CM_ SG_ 429 OBJ_Relative_Long_Vel_STD_14 "STD of the relative longtitudinal speed.";
CM_ SG_ 429 OBJ_Rel_Long_Vel_STD_V_14 "Validator for the STD of the relative longtitudinal speed.";
CM_ SG_ 430 OBJ_Sync_ID_14_1 "The ID of the Sync message, used to synchronize between signals in the system. Every new frame promotes the sync ID by one.";
CM_ SG_ 430 OBJ_Relative_Lat_Velocity_14 "The relative lateral speed between the target and ego vehicle.";
CM_ SG_ 430 OBJ_Relative_Lat_Velocity_V_14 "Validator for the relative lateral speed.";
CM_ SG_ 430 OBJ_Relative_Lat_Velocity_STD_14 "STD of the relative lateral speed.";
CM_ SG_ 430 OBJ_Rel_Lat_Vel_STD_V_14 "Validator for the STD of the relative lateral speed.";
CM_ SG_ 430 OBJ_Long_Distance_14 "The longtitudinal distance from the object to middle of the rear bumper (middle of the RL and RR corners) of the target.";
CM_ SG_ 430 OBJ_Long_Distance_V_14 "Validator of the longtitudinal distance field";
CM_ SG_ 430 OBJ_Long_Distance_STD_14 "STD of the  longtitudinal distance.";
CM_ SG_ 430 OBJ_Long_Distance_STD_V_14 "Validator for the STD of the  longtitudinal distance.";
CM_ SG_ 430 OBJ_Lat_Distance_14 "Lateral distance to the middle of the RL and RR corners.";
CM_ SG_ 430 OBJ_Lat_Distance_V_14 "Validator for the lateral distance of the object.";
CM_ SG_ 430 OBJ_Lat_Distance_STD_14 "STD of the lateral distance of the object.";
CM_ SG_ 430 OBJ_Lat_Distance_STD_V_14 "Validator for the STD of the lateral distance of the object.";
CM_ SG_ 430 OBJ_Absolute_Speed_14 "The absolute ground speed in the targets' heading direction.";
CM_ SG_ 430 OBJ_Absolute_Speed_V_14 "Validator for the absolute ground speed.";
CM_ SG_ 430 OBJ_Absolute_Speed_STD_14 "STD of the absolute ground speed.";
CM_ SG_ 430 OBJ_Absolute_Speed_STD_V_14 "Validator for the STD of the absolute ground speed.";
CM_ SG_ 430 OBJ_Heading_14 "The angle beetweenthe host longitudinal axis and target's heading (clockwise, e.g. PI/2 is a target crossing from left to right).";
CM_ SG_ 430 OBJ_Heading_V_14 "Validator for the object heading.";
CM_ SG_ 430 OBJ_Heading_STD_14 "STD of the object heading.";
CM_ SG_ 430 OBJ_Heading_STD_V_14 "Validator for the STD of the object heading.";
CM_ SG_ 430 OBJ_Angle_Rate_STD_14 "Standard deviation of the angular speed. (radians)";
CM_ SG_ 430 OBJ_Angle_Rate_STD_V_14 "Validator for the STD of the angular speed.";
CM_ SG_ 430 OBJ_Angle_Rate_14 "The momentary angular speed of the object. (radians)";
CM_ SG_ 430 OBJ_Angle_Rate_V_14 "Validator for the angular speed.";
CM_ SG_ 430 OBJ_Angle_Right_14 "The angle between the host longitudinal axis and the right side of the front / rear of the target (the visible one). The positive side is to the host's right.";
CM_ SG_ 430 OBJ_Angle_Right_V_14 "Validator for angleRight";
CM_ SG_ 430 OBJ_Angle_Right_STD_14 "Standard deviation of angleRight";
CM_ SG_ 430 OBJ_Angle_Right_STD_V_14 "Validator for the standard deviation of angleRight.";
CM_ SG_ 430 OBJ_Angle_Left_14 "The angle between the host longitudinal axis and the left side of the front / rear of the target (the visible one). The positive side is to the host's right.";
CM_ SG_ 430 OBJ_Angle_Left_V_14 "Validator for angleLeft.";
CM_ SG_ 430 OBJ_Angle_Left_STD_14 "Standard deviation of angleLeft.";
CM_ SG_ 430 OBJ_Angle_Left_STD_V_14 "Validator for the standard deviation of angleLeft.";
CM_ SG_ 430 OBJ_Angle_Side_14 "The angle between the host longitudinal axis and the far visible edge - the visible edge of the front / rear of the target that is not visible. Currently supported for vehicles only.";
CM_ SG_ 430 OBJ_Angle_Side_V_14 "Validator for angleSide.";
CM_ SG_ 430 OBJ_Angle_Side_STD_14 "Standard deviation of angleSide.";
CM_ SG_ 430 OBJ_Angle_Side_STD_V_14 "Validator for the STD of angleSide.";
CM_ SG_ 430 OBJ_Angle_Mid_V_14 "Validator for angleMid.";
CM_ SG_ 430 OBJ_Angle_Mid_14 "The angle between the host longitudinal axis and the middle of the front / rear of the target (the visible one). The positive side is to the host's right.";
CM_ SG_ 430 OBJ_Angle_Mid_STD_14 "Standard deviation of angleMid.";
CM_ SG_ 430 OBJ_Angle_Mid_STD_V_14 "Validator for the STD of angleMid.";
CM_ SG_ 430 OBJ_Angle_Bottom_V_14 "Validator for OBJAngle_Bottom.";
CM_ SG_ 430 OBJ_Angle_Bottom_14 "The angle between the longitudinal axis and the Bottom of the front / rear of the target (the visible one). The positive side is to the host's bottom";
CM_ SG_ 430 OBJ_Angle_Bottom_STD_14 "STD for OBJAngle_Bottom.";
CM_ SG_ 430 OBJ_Angle_Bottom_STD_V_14 "Validator for OBJAngle_Bottom_STD.";
CM_ SG_ 430 OBJ_Visibility_Side_V_14 "Currently Supported for VD only";
CM_ SG_ 430 OBJ_Visibility_Side_14 "From what car  side is the object visible";
CM_ SG_ 430 OBJ_Is_In_Drivable_Area_14 "Indicates whether the target is in a driveable area.";
CM_ SG_ 430 OBJ_Is_In_Drivable_Area_V_14 "Validator for OBJ_Is_In_Drivable_Area.";
CM_ SG_ 430 OBJ_Is_VeryClose_V_14 "Validator for OBJ_Is_VeryClose.";
CM_ SG_ 430 OBJ_Is_VeryClose_14 "Indicates whether the target is very close to the host such that it is hard to measure its distance. Currently relevant for peds only";
CM_ SG_ 430 OBJ_Is_EMERGENCY_VCL_14 "Is Object an Emergency Vehicle";
CM_ SG_ 430 OBJ_EMERGENCY_LIGHT_COLOR_14 "Emergency Color";
CM_ SG_ 430 OBJ_EMERGENCY_V_14 "Are OBJ_Is_EMERGENCY_VCL and OBJ_EMERGENCY_LIGHT_COLOR Valid";
BA_DEF_ SG_  "GenSigSendType" ENUM  "Cyclic","OnChange","OnWrite","IfActive","OnChangeWithRepetition","OnWriteWithRepetition","IfActiveWithRepetition","CA","CE","Event","NoSigSendType";
BA_DEF_ SG_  "GenSigStartValue" INT 0 0;
BA_DEF_ BO_  "VFrameFormat" ENUM  "StandardCAN","ExtendedCAN","reserved","J1939PG","reserved","reserved","reserved","reserved","reserved","reserved","reserved","reserved","reserved","reserved","StandardCAN_FD","ExtendedCAN_FD";
BA_DEF_ BO_  "FunReqGroup" INT 0 250;
BA_DEF_ BO_  "Receivers" STRING ;
BA_DEF_ BO_  "Transmitters" STRING ;
BA_DEF_ BO_  "DiagReqFun" ENUM  "NO","YES";
BA_DEF_ BO_  "DiagReqPhy" ENUM  "NO","YES";
BA_DEF_ BO_  "DiagResp" ENUM  "NO","YES";
BA_DEF_ BO_  "GenMsgTimeoutValue" INT 0 65535;
BA_DEF_ BO_  "GenMsgSendType" ENUM  "Cyclic","NoMsgSendType","IfActive","Event","CA","CE";
BA_DEF_ BO_  "GenMsgCycleTime" INT 0 10000;
BA_DEF_ BO_  "CANFD_BRS" ENUM  "0","1";
BA_DEF_ BO_  "GenMsgILSupport" ENUM  "No","Yes";
BA_DEF_DEF_  "GenSigSendType" "Cyclic";
BA_DEF_DEF_  "GenSigStartValue" 0;
BA_DEF_DEF_  "VFrameFormat" "ExtendedCAN";
BA_DEF_DEF_  "FunReqGroup" 0;
BA_DEF_DEF_  "Receivers" "Default";
BA_DEF_DEF_  "Transmitters" "Default";
BA_DEF_DEF_  "DiagReqFun" "NO";
BA_DEF_DEF_  "DiagReqPhy" "NO";
BA_DEF_DEF_  "DiagResp" "NO";
BA_DEF_DEF_  "GenMsgTimeoutValue" 200;
BA_DEF_DEF_  "GenMsgSendType" "Cyclic";
BA_DEF_DEF_  "GenMsgCycleTime" 50;
BA_DEF_DEF_  "CANFD_BRS" "1";
BA_DEF_DEF_  "GenMsgILSupport" "Yes";
BA_ "VFrameFormat" BO_ 419 14;
BA_ "VFrameFormat" BO_ 420 14;
BA_ "VFrameFormat" BO_ 421 14;
BA_ "VFrameFormat" BO_ 422 14;
BA_ "VFrameFormat" BO_ 423 14;
BA_ "VFrameFormat" BO_ 424 14;
BA_ "VFrameFormat" BO_ 425 14;
BA_ "VFrameFormat" BO_ 426 14;
BA_ "VFrameFormat" BO_ 427 14;
BA_ "VFrameFormat" BO_ 428 14;
BA_ "VFrameFormat" BO_ 429 14;
BA_ "VFrameFormat" BO_ 430 14;
VAL_ 419 OBJ_Motion_Category_9 13 "ONCOMING" 12 "PRECEEDING" 11 "MOVING" 10 "RTAP" 9 "LTAP" 8 "CROSSING" 7 "MOVING_OUT" 6 "MOVING_IN" 5 "CLOSE_CUT_IN" 4 "PASSING_OUT" 3 "PASSING_IN" 2 "PASSING" 1 "UNDEFINED" 0 "UNFILLED" ;
VAL_ 419 OBJ_Measuring_Status_9 2 "(BIT_2)NOT_VALID_OR_VALID" 1 "(BIT_1)PREDICTED_OR_MEASURED" 0 "(BIT_0)OLD_OR_NEW" ;
VAL_ 419 OBJ_Object_Class_9 8 "UNCERTAIN_VCL" 7 "ANIMAL" 6 "GENERAL_OBJECT" 5 "PEDESTRIAN" 4 "BICYCLE" 3 "MOTORBIKE" 2 "TRUCK" 1 "CAR" 0 "UNFILLED" ;
VAL_ 419 OBJ_Motion_Status_9 5 "MOVING_SLOWLY" 4 "STOPPED" 3 "STATIONARY" 2 "MOVING" 1 "UNKNOWN" 0 "INVALID" ;
VAL_ 419 OBJ_Motion_Orientation_9 13 "INVALID" 12 "NORTH" 11 "NORTH_WEST" 9 "WEST" 7 "SOUTH_WEST" 6 "SOUTH" 5 "SOUTH_EAST" 3 "EAST" 1 "NORTH_EAST" 0 "UNKNOWN" ;
VAL_ 419 OBJ_Has_Cut_Lane_9 1 "TRUE" 0 "FALSE" ;
VAL_ 419 OBJ_Has_Cut_Path_9 1 "TRUE" 0 "FALSE" ;
VAL_ 419 OBJ_Brake_Light_9 1 "TRUE" 0 "FALSE" ;
VAL_ 419 OBJ_Turn_Indicator_Right_9 1 "TRUE" 0 "FALSE" ;
VAL_ 419 OBJ_Turn_Indicator_Left_9 1 "TRUE" 0 "FALSE" ;
VAL_ 419 OBJ_Light_Indicator_Validity_9 1 "TRUE" 0 "FALSE" ;
VAL_ 419 OBJ_Right_Out_Of_Image_9 1 "TRUE" 0 "FALSE" ;
VAL_ 419 OBJ_Left_Out_Of_Image_9 1 "TRUE" 0 "FALSE" ;
VAL_ 419 OBJ_Right_Out_Of_Image_V_9 1 "TRUE" 0 "FALSE" ;
VAL_ 419 OBJ_Left_Out_Of_Image_V_9 1 "TRUE" 0 "FALSE" ;
VAL_ 419 OBJ_Top_Out_Of_Image_9 1 "TRUE" 0 "FALSE" ;
VAL_ 419 OBJ_Bottom_Out_Of_Image_9 1 "TRUE" 0 "FALSE" ;
VAL_ 419 OBJ_Top_Out_Of_Image_V_9 1 "VALID" 0 "INVALID" ;
VAL_ 419 OBJ_Bottom_Out_Of_Image_V_9 1 "VALID" 0 "INVALID" ;
VAL_ 419 OBJ_Lane_Assignment_9 5 "RIGHT_RIGHT" 4 "RIGHT" 3 "HOST" 2 "LEFT" 1 "LEFT_LEFT" 0 "UNKNOWN" ;
VAL_ 419 OBJ_Lane_Assignment_V_9 1 "VALID" 0 "INVALID" ;
VAL_ 419 OBJ_Age_Seconds_V_9 1 "VALID" 0 "INVALID" ;
VAL_ 419 OBJ_Width_V_9 1 "VALID" 0 "INVALID" ;
VAL_ 419 OBJ_Width_STD_V_9 1 "VALID" 0 "INVALID" ;
VAL_ 419 OBJ_Length_V_9 1 "VALID" 0 "INVALID" ;
VAL_ 419 OBJ_Length_STD_V_9 1 "VALID" 0 "INVALID" ;
VAL_ 419 OBJ_Height_V_9 1 "VALID" 0 "INVALID" ;
VAL_ 419 OBJ_Height_STD_V_9 1 "VALID" 0 "INVALID" ;
VAL_ 419 OBJ_Abs_Long_Velocity_V_9 1 "VALID" 0 "INVALID" ;
VAL_ 419 OBJ_Abs_Long_Vel_STD_V_9 1 "VALID" 0 "INVALID" ;
VAL_ 419 OBJ_Abs_Lat_Velocity_V_9 1 "VALID" 0 "INVALID" ;
VAL_ 419 OBJ_Abs_Lat_Vel_STD_V_9 1 "VALID" 0 "INVALID" ;
VAL_ 419 OBJ_Abs_Long_Acc_V_9 1 "VALID" 0 "INVALID" ;
VAL_ 419 OBJ_Abs_Long_Acc_STD_V_9 1 "VALID" 0 "INVALID" ;
VAL_ 419 OBJ_Abs_Lat_Acc_V_9 1 "VALID" 0 "INVALID" ;
VAL_ 419 OBJ_Abs_Lat_Acc_STD_V_9 1 "VALID" 0 "INVALID" ;
VAL_ 419 OBJ_Abs_Acceleration_V_9 1 "VALID" 0 "INVALID" ;
VAL_ 419 OBJ_Abs_Acc_STD_V_9 1 "VALID" 0 "INVALID" ;
VAL_ 419 OBJ_Inv_TTC_V_9 1 "VALID" 0 "INVALID" ;
VAL_ 419 OBJ_Inv_TTC_STD_V_9 1 "VALID" 0 "INVALID" ;
VAL_ 419 OBJ_Relative_Long_Acc_V_9 1 "VALID" 0 "INVALID" ;
VAL_ 419 OBJ_Rel_Long_Acc_STD_V_9 1 "VALID" 0 "INVALID" ;
VAL_ 419 OBJ_Relative_Long_Velocity_V_9 1 "VALID" 0 "INVALID" ;
VAL_ 419 OBJ_Rel_Long_Vel_STD_V_9 1 "VALID" 0 "INVALID" ;
VAL_ 420 OBJ_Relative_Lat_Velocity_V_9 1 "VALID" 0 "INVALID" ;
VAL_ 420 OBJ_Rel_Lat_Vel_STD_V_9 1 "VALID" 0 "INVALID" ;
VAL_ 420 OBJ_Long_Distance_V_9 1 "VALID" 0 "INVALID" ;
VAL_ 420 OBJ_Long_Distance_STD_V_9 1 "VALID" 0 "INVALID" ;
VAL_ 420 OBJ_Lat_Distance_V_9 1 "VALID" 0 "INVALID" ;
VAL_ 420 OBJ_Lat_Distance_STD_V_9 1 "VALID" 0 "INVALID" ;
VAL_ 420 OBJ_Absolute_Speed_V_9 1 "VALID" 0 "INVALID" ;
VAL_ 420 OBJ_Absolute_Speed_STD_V_9 1 "VALID" 0 "INVALID" ;
VAL_ 420 OBJ_Heading_V_9 1 "VALID" 0 "INVALID" ;
VAL_ 420 OBJ_Heading_STD_V_9 1 "VALID" 0 "INVALID" ;
VAL_ 420 OBJ_Angle_Rate_STD_V_9 1 "VALID" 0 "INVALID" ;
VAL_ 420 OBJ_Angle_Rate_V_9 1 "VALID" 0 "INVALID" ;
VAL_ 420 OBJ_Angle_Right_V_9 1 "VALID" 0 "INVALID" ;
VAL_ 420 OBJ_Angle_Right_STD_V_9 1 "VALID" 0 "INVALID" ;
VAL_ 420 OBJ_Angle_Left_V_9 1 "VALID" 0 "INVALID" ;
VAL_ 420 OBJ_Angle_Left_STD_V_9 1 "VALID" 0 "INVALID" ;
VAL_ 420 OBJ_Angle_Side_V_9 1 "VALID" 0 "INVALID" ;
VAL_ 420 OBJ_Angle_Side_STD_V_9 1 "VALID" 0 "INVALID" ;
VAL_ 420 OBJ_Angle_Mid_V_9 1 "VALID" 0 "INVALID" ;
VAL_ 420 OBJ_Angle_Mid_STD_V_9 1 "VALID" 0 "INVALID" ;
VAL_ 420 OBJ_Angle_Bottom_V_9 1 "VALID" 0 "INVALID" ;
VAL_ 420 OBJ_Angle_Bottom_STD_V_9 1 "VALID" 0 "INVALID" ;
VAL_ 420 OBJ_Visibility_Side_V_9 1 "VALID" 0 "INVALID" ;
VAL_ 420 OBJ_Visibility_Side_9 2 "REAR" 1 "FRONT" 0 "NOT_VISIBLE" ;
VAL_ 420 OBJ_Is_In_Drivable_Area_9 1 "TRUE" 0 "FALSE" ;
VAL_ 420 OBJ_Is_In_Drivable_Area_V_9 1 "VALID" 0 "INVALID" ;
VAL_ 420 OBJ_Is_VeryClose_V_9 1 "VALID" 0 "INVALID" ;
VAL_ 420 OBJ_Is_VeryClose_9 1 "TRUE" 0 "FALSE" ;
VAL_ 420 OBJ_Is_EMERGENCY_VCL_9 1 "TRUE" 0 "FALSE" ;
VAL_ 420 OBJ_EMERGENCY_LIGHT_COLOR_9 3 "(1000)ORANGE" 2 "(0100)BLUE" 1 "(0010)RED" 0 "(0001)OTHER" ;
VAL_ 420 OBJ_EMERGENCY_V_9 1 "TRUE" 0 "FALSE" ;
VAL_ 421 OBJ_Motion_Category_10 13 "ONCOMING" 12 "PRECEEDING" 11 "MOVING" 10 "RTAP" 9 "LTAP" 8 "CROSSING" 7 "MOVING_OUT" 6 "MOVING_IN" 5 "CLOSE_CUT_IN" 4 "PASSING_OUT" 3 "PASSING_IN" 2 "PASSING" 1 "UNDEFINED" 0 "UNFILLED" ;
VAL_ 421 OBJ_Measuring_Status_10 2 "(BIT_2)NOT_VALID_OR_VALID" 1 "(BIT_1)PREDICTED_OR_MEASURED" 0 "(BIT_0)OLD_OR_NEW" ;
VAL_ 421 OBJ_Object_Class_10 8 "UNCERTAIN_VCL" 7 "ANIMAL" 6 "GENERAL_OBJECT" 5 "PEDESTRIAN" 4 "BICYCLE" 3 "MOTORBIKE" 2 "TRUCK" 1 "CAR" 0 "UNFILLED" ;
VAL_ 421 OBJ_Motion_Status_10 5 "MOVING_SLOWLY" 4 "STOPPED" 3 "STATIONARY" 2 "MOVING" 1 "UNKNOWN" 0 "INVALID" ;
VAL_ 421 OBJ_Motion_Orientation_10 13 "INVALID" 12 "NORTH" 11 "NORTH_WEST" 9 "WEST" 7 "SOUTH_WEST" 6 "SOUTH" 5 "SOUTH_EAST" 3 "EAST" 1 "NORTH_EAST" 0 "UNKNOWN" ;
VAL_ 421 OBJ_Has_Cut_Lane_10 1 "TRUE" 0 "FALSE" ;
VAL_ 421 OBJ_Has_Cut_Path_10 1 "TRUE" 0 "FALSE" ;
VAL_ 421 OBJ_Brake_Light_10 1 "TRUE" 0 "FALSE" ;
VAL_ 421 OBJ_Turn_Indicator_Right_10 1 "TRUE" 0 "FALSE" ;
VAL_ 421 OBJ_Turn_Indicator_Left_10 1 "TRUE" 0 "FALSE" ;
VAL_ 421 OBJ_Light_Indicator_Validity_10 1 "TRUE" 0 "FALSE" ;
VAL_ 421 OBJ_Right_Out_Of_Image_10 1 "TRUE" 0 "FALSE" ;
VAL_ 421 OBJ_Left_Out_Of_Image_10 1 "TRUE" 0 "FALSE" ;
VAL_ 421 OBJ_Right_Out_Of_Image_V_10 1 "TRUE" 0 "FALSE" ;
VAL_ 421 OBJ_Left_Out_Of_Image_V_10 1 "TRUE" 0 "FALSE" ;
VAL_ 421 OBJ_Top_Out_Of_Image_10 1 "TRUE" 0 "FALSE" ;
VAL_ 421 OBJ_Bottom_Out_Of_Image_10 1 "TRUE" 0 "FALSE" ;
VAL_ 421 OBJ_Top_Out_Of_Image_V_10 1 "VALID" 0 "INVALID" ;
VAL_ 421 OBJ_Bottom_Out_Of_Image_V_10 1 "VALID" 0 "INVALID" ;
VAL_ 421 OBJ_Lane_Assignment_10 5 "RIGHT_RIGHT" 4 "RIGHT" 3 "HOST" 2 "LEFT" 1 "LEFT_LEFT" 0 "UNKNOWN" ;
VAL_ 421 OBJ_Lane_Assignment_V_10 1 "VALID" 0 "INVALID" ;
VAL_ 421 OBJ_Age_Seconds_V_10 1 "VALID" 0 "INVALID" ;
VAL_ 421 OBJ_Width_V_10 1 "VALID" 0 "INVALID" ;
VAL_ 421 OBJ_Width_STD_V_10 1 "VALID" 0 "INVALID" ;
VAL_ 421 OBJ_Length_V_10 1 "VALID" 0 "INVALID" ;
VAL_ 421 OBJ_Length_STD_V_10 1 "VALID" 0 "INVALID" ;
VAL_ 421 OBJ_Height_V_10 1 "VALID" 0 "INVALID" ;
VAL_ 421 OBJ_Height_STD_V_10 1 "VALID" 0 "INVALID" ;
VAL_ 421 OBJ_Abs_Long_Velocity_V_10 1 "VALID" 0 "INVALID" ;
VAL_ 421 OBJ_Abs_Long_Vel_STD_V_10 1 "VALID" 0 "INVALID" ;
VAL_ 421 OBJ_Abs_Lat_Velocity_V_10 1 "VALID" 0 "INVALID" ;
VAL_ 421 OBJ_Abs_Lat_Vel_STD_V_10 1 "VALID" 0 "INVALID" ;
VAL_ 421 OBJ_Abs_Long_Acc_V_10 1 "VALID" 0 "INVALID" ;
VAL_ 421 OBJ_Abs_Long_Acc_STD_V_10 1 "VALID" 0 "INVALID" ;
VAL_ 421 OBJ_Abs_Lat_Acc_V_10 1 "VALID" 0 "INVALID" ;
VAL_ 421 OBJ_Abs_Lat_Acc_STD_V_10 1 "VALID" 0 "INVALID" ;
VAL_ 421 OBJ_Abs_Acceleration_V_10 1 "VALID" 0 "INVALID" ;
VAL_ 421 OBJ_Abs_Acc_STD_V_10 1 "VALID" 0 "INVALID" ;
VAL_ 421 OBJ_Inv_TTC_V_10 1 "VALID" 0 "INVALID" ;
VAL_ 421 OBJ_Inv_TTC_STD_V_10 1 "VALID" 0 "INVALID" ;
VAL_ 421 OBJ_Relative_Long_Acc_V_10 1 "VALID" 0 "INVALID" ;
VAL_ 421 OBJ_Rel_Long_Acc_STD_V_10 1 "VALID" 0 "INVALID" ;
VAL_ 421 OBJ_Relative_Long_Velocity_V_10 1 "VALID" 0 "INVALID" ;
VAL_ 421 OBJ_Rel_Long_Vel_STD_V_10 1 "VALID" 0 "INVALID" ;
VAL_ 422 OBJ_Relative_Lat_Velocity_V_10 1 "VALID" 0 "INVALID" ;
VAL_ 422 OBJ_Rel_Lat_Vel_STD_V_10 1 "VALID" 0 "INVALID" ;
VAL_ 422 OBJ_Long_Distance_V_10 1 "VALID" 0 "INVALID" ;
VAL_ 422 OBJ_Long_Distance_STD_V_10 1 "VALID" 0 "INVALID" ;
VAL_ 422 OBJ_Lat_Distance_V_10 1 "VALID" 0 "INVALID" ;
VAL_ 422 OBJ_Lat_Distance_STD_V_10 1 "VALID" 0 "INVALID" ;
VAL_ 422 OBJ_Absolute_Speed_V_10 1 "VALID" 0 "INVALID" ;
VAL_ 422 OBJ_Absolute_Speed_STD_V_10 1 "VALID" 0 "INVALID" ;
VAL_ 422 OBJ_Heading_V_10 1 "VALID" 0 "INVALID" ;
VAL_ 422 OBJ_Heading_STD_V_10 1 "VALID" 0 "INVALID" ;
VAL_ 422 OBJ_Angle_Rate_STD_V_10 1 "VALID" 0 "INVALID" ;
VAL_ 422 OBJ_Angle_Rate_V_10 1 "VALID" 0 "INVALID" ;
VAL_ 422 OBJ_Angle_Right_V_10 1 "VALID" 0 "INVALID" ;
VAL_ 422 OBJ_Angle_Right_STD_V_10 1 "VALID" 0 "INVALID" ;
VAL_ 422 OBJ_Angle_Left_V_10 1 "VALID" 0 "INVALID" ;
VAL_ 422 OBJ_Angle_Left_STD_V_10 1 "VALID" 0 "INVALID" ;
VAL_ 422 OBJ_Angle_Side_V_10 1 "VALID" 0 "INVALID" ;
VAL_ 422 OBJ_Angle_Side_STD_V_10 1 "VALID" 0 "INVALID" ;
VAL_ 422 OBJ_Angle_Mid_V_10 1 "VALID" 0 "INVALID" ;
VAL_ 422 OBJ_Angle_Mid_STD_V_10 1 "VALID" 0 "INVALID" ;
VAL_ 422 OBJ_Angle_Bottom_V_10 1 "VALID" 0 "INVALID" ;
VAL_ 422 OBJ_Angle_Bottom_STD_V_10 1 "VALID" 0 "INVALID" ;
VAL_ 422 OBJ_Visibility_Side_V_10 1 "VALID" 0 "INVALID" ;
VAL_ 422 OBJ_Visibility_Side_10 2 "REAR" 1 "FRONT" 0 "NOT_VISIBLE" ;
VAL_ 422 OBJ_Is_In_Drivable_Area_10 1 "TRUE" 0 "FALSE" ;
VAL_ 422 OBJ_Is_In_Drivable_Area_V_10 1 "VALID" 0 "INVALID" ;
VAL_ 422 OBJ_Is_VeryClose_V_10 1 "VALID" 0 "INVALID" ;
VAL_ 422 OBJ_Is_VeryClose_10 1 "TRUE" 0 "FALSE" ;
VAL_ 422 OBJ_Is_EMERGENCY_VCL_10 1 "TRUE" 0 "FALSE" ;
VAL_ 422 OBJ_EMERGENCY_LIGHT_COLOR_10 3 "(1000)ORANGE" 2 "(0100)BLUE" 1 "(0010)RED" 0 "(0001)OTHER" ;
VAL_ 422 OBJ_EMERGENCY_V_10 1 "TRUE" 0 "FALSE" ;
VAL_ 423 OBJ_Motion_Category_11 13 "ONCOMING" 12 "PRECEEDING" 11 "MOVING" 10 "RTAP" 9 "LTAP" 8 "CROSSING" 7 "MOVING_OUT" 6 "MOVING_IN" 5 "CLOSE_CUT_IN" 4 "PASSING_OUT" 3 "PASSING_IN" 2 "PASSING" 1 "UNDEFINED" 0 "UNFILLED" ;
VAL_ 423 OBJ_Measuring_Status_11 2 "(BIT_2)NOT_VALID_OR_VALID" 1 "(BIT_1)PREDICTED_OR_MEASURED" 0 "(BIT_0)OLD_OR_NEW" ;
VAL_ 423 OBJ_Object_Class_11 8 "UNCERTAIN_VCL" 7 "ANIMAL" 6 "GENERAL_OBJECT" 5 "PEDESTRIAN" 4 "BICYCLE" 3 "MOTORBIKE" 2 "TRUCK" 1 "CAR" 0 "UNFILLED" ;
VAL_ 423 OBJ_Motion_Status_11 5 "MOVING_SLOWLY" 4 "STOPPED" 3 "STATIONARY" 2 "MOVING" 1 "UNKNOWN" 0 "INVALID" ;
VAL_ 423 OBJ_Motion_Orientation_11 13 "INVALID" 12 "NORTH" 11 "NORTH_WEST" 9 "WEST" 7 "SOUTH_WEST" 6 "SOUTH" 5 "SOUTH_EAST" 3 "EAST" 1 "NORTH_EAST" 0 "UNKNOWN" ;
VAL_ 423 OBJ_Has_Cut_Lane_11 1 "TRUE" 0 "FALSE" ;
VAL_ 423 OBJ_Has_Cut_Path_11 1 "TRUE" 0 "FALSE" ;
VAL_ 423 OBJ_Brake_Light_11 1 "TRUE" 0 "FALSE" ;
VAL_ 423 OBJ_Turn_Indicator_Right_11 1 "TRUE" 0 "FALSE" ;
VAL_ 423 OBJ_Turn_Indicator_Left_11 1 "TRUE" 0 "FALSE" ;
VAL_ 423 OBJ_Light_Indicator_Validity_11 1 "TRUE" 0 "FALSE" ;
VAL_ 423 OBJ_Right_Out_Of_Image_11 1 "TRUE" 0 "FALSE" ;
VAL_ 423 OBJ_Left_Out_Of_Image_11 1 "TRUE" 0 "FALSE" ;
VAL_ 423 OBJ_Right_Out_Of_Image_V_11 1 "TRUE" 0 "FALSE" ;
VAL_ 423 OBJ_Left_Out_Of_Image_V_11 1 "TRUE" 0 "FALSE" ;
VAL_ 423 OBJ_Top_Out_Of_Image_11 1 "TRUE" 0 "FALSE" ;
VAL_ 423 OBJ_Bottom_Out_Of_Image_11 1 "TRUE" 0 "FALSE" ;
VAL_ 423 OBJ_Top_Out_Of_Image_V_11 1 "VALID" 0 "INVALID" ;
VAL_ 423 OBJ_Bottom_Out_Of_Image_V_11 1 "VALID" 0 "INVALID" ;
VAL_ 423 OBJ_Lane_Assignment_11 5 "RIGHT_RIGHT" 4 "RIGHT" 3 "HOST" 2 "LEFT" 1 "LEFT_LEFT" 0 "UNKNOWN" ;
VAL_ 423 OBJ_Lane_Assignment_V_11 1 "VALID" 0 "INVALID" ;
VAL_ 423 OBJ_Age_Seconds_V_11 1 "VALID" 0 "INVALID" ;
VAL_ 423 OBJ_Width_V_11 1 "VALID" 0 "INVALID" ;
VAL_ 423 OBJ_Width_STD_V_11 1 "VALID" 0 "INVALID" ;
VAL_ 423 OBJ_Length_V_11 1 "VALID" 0 "INVALID" ;
VAL_ 423 OBJ_Length_STD_V_11 1 "VALID" 0 "INVALID" ;
VAL_ 423 OBJ_Height_V_11 1 "VALID" 0 "INVALID" ;
VAL_ 423 OBJ_Height_STD_V_11 1 "VALID" 0 "INVALID" ;
VAL_ 423 OBJ_Abs_Long_Velocity_V_11 1 "VALID" 0 "INVALID" ;
VAL_ 423 OBJ_Abs_Long_Vel_STD_V_11 1 "VALID" 0 "INVALID" ;
VAL_ 423 OBJ_Abs_Lat_Velocity_V_11 1 "VALID" 0 "INVALID" ;
VAL_ 423 OBJ_Abs_Lat_Vel_STD_V_11 1 "VALID" 0 "INVALID" ;
VAL_ 423 OBJ_Abs_Long_Acc_V_11 1 "VALID" 0 "INVALID" ;
VAL_ 423 OBJ_Abs_Long_Acc_STD_V_11 1 "VALID" 0 "INVALID" ;
VAL_ 423 OBJ_Abs_Lat_Acc_V_11 1 "VALID" 0 "INVALID" ;
VAL_ 423 OBJ_Abs_Lat_Acc_STD_V_11 1 "VALID" 0 "INVALID" ;
VAL_ 423 OBJ_Abs_Acceleration_V_11 1 "VALID" 0 "INVALID" ;
VAL_ 423 OBJ_Abs_Acc_STD_V_11 1 "VALID" 0 "INVALID" ;
VAL_ 423 OBJ_Inv_TTC_V_11 1 "VALID" 0 "INVALID" ;
VAL_ 423 OBJ_Inv_TTC_STD_V_11 1 "VALID" 0 "INVALID" ;
VAL_ 423 OBJ_Relative_Long_Acc_V_11 1 "VALID" 0 "INVALID" ;
VAL_ 423 OBJ_Rel_Long_Acc_STD_V_11 1 "VALID" 0 "INVALID" ;
VAL_ 423 OBJ_Relative_Long_Velocity_V_11 1 "VALID" 0 "INVALID" ;
VAL_ 423 OBJ_Rel_Long_Vel_STD_V_11 1 "VALID" 0 "INVALID" ;
VAL_ 424 OBJ_Relative_Lat_Velocity_V_11 1 "VALID" 0 "INVALID" ;
VAL_ 424 OBJ_Rel_Lat_Vel_STD_V_11 1 "VALID" 0 "INVALID" ;
VAL_ 424 OBJ_Long_Distance_V_11 1 "VALID" 0 "INVALID" ;
VAL_ 424 OBJ_Long_Distance_STD_V_11 1 "VALID" 0 "INVALID" ;
VAL_ 424 OBJ_Lat_Distance_V_11 1 "VALID" 0 "INVALID" ;
VAL_ 424 OBJ_Lat_Distance_STD_V_11 1 "VALID" 0 "INVALID" ;
VAL_ 424 OBJ_Absolute_Speed_V_11 1 "VALID" 0 "INVALID" ;
VAL_ 424 OBJ_Absolute_Speed_STD_V_11 1 "VALID" 0 "INVALID" ;
VAL_ 424 OBJ_Heading_V_11 1 "VALID" 0 "INVALID" ;
VAL_ 424 OBJ_Heading_STD_V_11 1 "VALID" 0 "INVALID" ;
VAL_ 424 OBJ_Angle_Rate_STD_V_11 1 "VALID" 0 "INVALID" ;
VAL_ 424 OBJ_Angle_Rate_V_11 1 "VALID" 0 "INVALID" ;
VAL_ 424 OBJ_Angle_Right_V_11 1 "VALID" 0 "INVALID" ;
VAL_ 424 OBJ_Angle_Right_STD_V_11 1 "VALID" 0 "INVALID" ;
VAL_ 424 OBJ_Angle_Left_V_11 1 "VALID" 0 "INVALID" ;
VAL_ 424 OBJ_Angle_Left_STD_V_11 1 "VALID" 0 "INVALID" ;
VAL_ 424 OBJ_Angle_Side_V_11 1 "VALID" 0 "INVALID" ;
VAL_ 424 OBJ_Angle_Side_STD_V_11 1 "VALID" 0 "INVALID" ;
VAL_ 424 OBJ_Angle_Mid_V_11 1 "VALID" 0 "INVALID" ;
VAL_ 424 OBJ_Angle_Mid_STD_V_11 1 "VALID" 0 "INVALID" ;
VAL_ 424 OBJ_Angle_Bottom_V_11 1 "VALID" 0 "INVALID" ;
VAL_ 424 OBJ_Angle_Bottom_STD_V_11 1 "VALID" 0 "INVALID" ;
VAL_ 424 OBJ_Visibility_Side_V_11 1 "VALID" 0 "INVALID" ;
VAL_ 424 OBJ_Visibility_Side_11 2 "REAR" 1 "FRONT" 0 "NOT_VISIBLE" ;
VAL_ 424 OBJ_Is_In_Drivable_Area_11 1 "TRUE" 0 "FALSE" ;
VAL_ 424 OBJ_Is_In_Drivable_Area_V_11 1 "VALID" 0 "INVALID" ;
VAL_ 424 OBJ_Is_VeryClose_V_11 1 "VALID" 0 "INVALID" ;
VAL_ 424 OBJ_Is_VeryClose_11 1 "TRUE" 0 "FALSE" ;
VAL_ 424 OBJ_Is_EMERGENCY_VCL_11 1 "TRUE" 0 "FALSE" ;
VAL_ 424 OBJ_EMERGENCY_LIGHT_COLOR_11 3 "(1000)ORANGE" 2 "(0100)BLUE" 1 "(0010)RED" 0 "(0001)OTHER" ;
VAL_ 424 OBJ_EMERGENCY_V_11 1 "TRUE" 0 "FALSE" ;
VAL_ 425 OBJ_Motion_Category_12 13 "ONCOMING" 12 "PRECEEDING" 11 "MOVING" 10 "RTAP" 9 "LTAP" 8 "CROSSING" 7 "MOVING_OUT" 6 "MOVING_IN" 5 "CLOSE_CUT_IN" 4 "PASSING_OUT" 3 "PASSING_IN" 2 "PASSING" 1 "UNDEFINED" 0 "UNFILLED" ;
VAL_ 425 OBJ_Measuring_Status_12 2 "(BIT_2)NOT_VALID_OR_VALID" 1 "(BIT_1)PREDICTED_OR_MEASURED" 0 "(BIT_0)OLD_OR_NEW" ;
VAL_ 425 OBJ_Object_Class_12 8 "UNCERTAIN_VCL" 7 "ANIMAL" 6 "GENERAL_OBJECT" 5 "PEDESTRIAN" 4 "BICYCLE" 3 "MOTORBIKE" 2 "TRUCK" 1 "CAR" 0 "UNFILLED" ;
VAL_ 425 OBJ_Motion_Status_12 5 "MOVING_SLOWLY" 4 "STOPPED" 3 "STATIONARY" 2 "MOVING" 1 "UNKNOWN" 0 "INVALID" ;
VAL_ 425 OBJ_Motion_Orientation_12 13 "INVALID" 12 "NORTH" 11 "NORTH_WEST" 9 "WEST" 7 "SOUTH_WEST" 6 "SOUTH" 5 "SOUTH_EAST" 3 "EAST" 1 "NORTH_EAST" 0 "UNKNOWN" ;
VAL_ 425 OBJ_Has_Cut_Lane_12 1 "TRUE" 0 "FALSE" ;
VAL_ 425 OBJ_Has_Cut_Path_12 1 "TRUE" 0 "FALSE" ;
VAL_ 425 OBJ_Brake_Light_12 1 "TRUE" 0 "FALSE" ;
VAL_ 425 OBJ_Turn_Indicator_Right_12 1 "TRUE" 0 "FALSE" ;
VAL_ 425 OBJ_Turn_Indicator_Left_12 1 "TRUE" 0 "FALSE" ;
VAL_ 425 OBJ_Light_Indicator_Validity_12 1 "TRUE" 0 "FALSE" ;
VAL_ 425 OBJ_Right_Out_Of_Image_12 1 "TRUE" 0 "FALSE" ;
VAL_ 425 OBJ_Left_Out_Of_Image_12 1 "TRUE" 0 "FALSE" ;
VAL_ 425 OBJ_Right_Out_Of_Image_V_12 1 "TRUE" 0 "FALSE" ;
VAL_ 425 OBJ_Left_Out_Of_Image_V_12 1 "TRUE" 0 "FALSE" ;
VAL_ 425 OBJ_Top_Out_Of_Image_12 1 "TRUE" 0 "FALSE" ;
VAL_ 425 OBJ_Bottom_Out_Of_Image_12 1 "TRUE" 0 "FALSE" ;
VAL_ 425 OBJ_Top_Out_Of_Image_V_12 1 "VALID" 0 "INVALID" ;
VAL_ 425 OBJ_Bottom_Out_Of_Image_V_12 1 "VALID" 0 "INVALID" ;
VAL_ 425 OBJ_Lane_Assignment_12 5 "RIGHT_RIGHT" 4 "RIGHT" 3 "HOST" 2 "LEFT" 1 "LEFT_LEFT" 0 "UNKNOWN" ;
VAL_ 425 OBJ_Lane_Assignment_V_12 1 "VALID" 0 "INVALID" ;
VAL_ 425 OBJ_Age_Seconds_V_12 1 "VALID" 0 "INVALID" ;
VAL_ 425 OBJ_Width_V_12 1 "VALID" 0 "INVALID" ;
VAL_ 425 OBJ_Width_STD_V_12 1 "VALID" 0 "INVALID" ;
VAL_ 425 OBJ_Length_V_12 1 "VALID" 0 "INVALID" ;
VAL_ 425 OBJ_Length_STD_V_12 1 "VALID" 0 "INVALID" ;
VAL_ 425 OBJ_Height_V_12 1 "VALID" 0 "INVALID" ;
VAL_ 425 OBJ_Height_STD_V_12 1 "VALID" 0 "INVALID" ;
VAL_ 425 OBJ_Abs_Long_Velocity_V_12 1 "VALID" 0 "INVALID" ;
VAL_ 425 OBJ_Abs_Long_Vel_STD_V_12 1 "VALID" 0 "INVALID" ;
VAL_ 425 OBJ_Abs_Lat_Velocity_V_12 1 "VALID" 0 "INVALID" ;
VAL_ 425 OBJ_Abs_Lat_Vel_STD_V_12 1 "VALID" 0 "INVALID" ;
VAL_ 425 OBJ_Abs_Long_Acc_V_12 1 "VALID" 0 "INVALID" ;
VAL_ 425 OBJ_Abs_Long_Acc_STD_V_12 1 "VALID" 0 "INVALID" ;
VAL_ 425 OBJ_Abs_Lat_Acc_V_12 1 "VALID" 0 "INVALID" ;
VAL_ 425 OBJ_Abs_Lat_Acc_STD_V_12 1 "VALID" 0 "INVALID" ;
VAL_ 425 OBJ_Abs_Acceleration_V_12 1 "VALID" 0 "INVALID" ;
VAL_ 425 OBJ_Abs_Acc_STD_V_12 1 "VALID" 0 "INVALID" ;
VAL_ 425 OBJ_Inv_TTC_V_12 1 "VALID" 0 "INVALID" ;
VAL_ 425 OBJ_Inv_TTC_STD_V_12 1 "VALID" 0 "INVALID" ;
VAL_ 425 OBJ_Relative_Long_Acc_V_12 1 "VALID" 0 "INVALID" ;
VAL_ 425 OBJ_Rel_Long_Acc_STD_V_12 1 "VALID" 0 "INVALID" ;
VAL_ 425 OBJ_Relative_Long_Velocity_V_12 1 "VALID" 0 "INVALID" ;
VAL_ 425 OBJ_Rel_Long_Vel_STD_V_12 1 "VALID" 0 "INVALID" ;
VAL_ 426 OBJ_Relative_Lat_Velocity_V_12 1 "VALID" 0 "INVALID" ;
VAL_ 426 OBJ_Rel_Lat_Vel_STD_V_12 1 "VALID" 0 "INVALID" ;
VAL_ 426 OBJ_Long_Distance_V_12 1 "VALID" 0 "INVALID" ;
VAL_ 426 OBJ_Long_Distance_STD_V_12 1 "VALID" 0 "INVALID" ;
VAL_ 426 OBJ_Lat_Distance_V_12 1 "VALID" 0 "INVALID" ;
VAL_ 426 OBJ_Lat_Distance_STD_V_12 1 "VALID" 0 "INVALID" ;
VAL_ 426 OBJ_Absolute_Speed_V_12 1 "VALID" 0 "INVALID" ;
VAL_ 426 OBJ_Absolute_Speed_STD_V_12 1 "VALID" 0 "INVALID" ;
VAL_ 426 OBJ_Heading_V_12 1 "VALID" 0 "INVALID" ;
VAL_ 426 OBJ_Heading_STD_V_12 1 "VALID" 0 "INVALID" ;
VAL_ 426 OBJ_Angle_Rate_STD_V_12 1 "VALID" 0 "INVALID" ;
VAL_ 426 OBJ_Angle_Rate_V_12 1 "VALID" 0 "INVALID" ;
VAL_ 426 OBJ_Angle_Right_V_12 1 "VALID" 0 "INVALID" ;
VAL_ 426 OBJ_Angle_Right_STD_V_12 1 "VALID" 0 "INVALID" ;
VAL_ 426 OBJ_Angle_Left_V_12 1 "VALID" 0 "INVALID" ;
VAL_ 426 OBJ_Angle_Left_STD_V_12 1 "VALID" 0 "INVALID" ;
VAL_ 426 OBJ_Angle_Side_V_12 1 "VALID" 0 "INVALID" ;
VAL_ 426 OBJ_Angle_Side_STD_V_12 1 "VALID" 0 "INVALID" ;
VAL_ 426 OBJ_Angle_Mid_V_12 1 "VALID" 0 "INVALID" ;
VAL_ 426 OBJ_Angle_Mid_STD_V_12 1 "VALID" 0 "INVALID" ;
VAL_ 426 OBJ_Angle_Bottom_V_12 1 "VALID" 0 "INVALID" ;
VAL_ 426 OBJ_Angle_Bottom_STD_V_12 1 "VALID" 0 "INVALID" ;
VAL_ 426 OBJ_Visibility_Side_V_12 1 "VALID" 0 "INVALID" ;
VAL_ 426 OBJ_Visibility_Side_12 2 "REAR" 1 "FRONT" 0 "NOT_VISIBLE" ;
VAL_ 426 OBJ_Is_In_Drivable_Area_12 1 "TRUE" 0 "FALSE" ;
VAL_ 426 OBJ_Is_In_Drivable_Area_V_12 1 "VALID" 0 "INVALID" ;
VAL_ 426 OBJ_Is_VeryClose_V_12 1 "VALID" 0 "INVALID" ;
VAL_ 426 OBJ_Is_VeryClose_12 1 "TRUE" 0 "FALSE" ;
VAL_ 426 OBJ_Is_EMERGENCY_VCL_12 1 "TRUE" 0 "FALSE" ;
VAL_ 426 OBJ_EMERGENCY_LIGHT_COLOR_12 3 "(1000)ORANGE" 2 "(0100)BLUE" 1 "(0010)RED" 0 "(0001)OTHER" ;
VAL_ 426 OBJ_EMERGENCY_V_12 1 "TRUE" 0 "FALSE" ;
VAL_ 427 OBJ_Motion_Category_13 13 "ONCOMING" 12 "PRECEEDING" 11 "MOVING" 10 "RTAP" 9 "LTAP" 8 "CROSSING" 7 "MOVING_OUT" 6 "MOVING_IN" 5 "CLOSE_CUT_IN" 4 "PASSING_OUT" 3 "PASSING_IN" 2 "PASSING" 1 "UNDEFINED" 0 "UNFILLED" ;
VAL_ 427 OBJ_Measuring_Status_13 2 "(BIT_2)NOT_VALID_OR_VALID" 1 "(BIT_1)PREDICTED_OR_MEASURED" 0 "(BIT_0)OLD_OR_NEW" ;
VAL_ 427 OBJ_Object_Class_13 8 "UNCERTAIN_VCL" 7 "ANIMAL" 6 "GENERAL_OBJECT" 5 "PEDESTRIAN" 4 "BICYCLE" 3 "MOTORBIKE" 2 "TRUCK" 1 "CAR" 0 "UNFILLED" ;
VAL_ 427 OBJ_Motion_Status_13 5 "MOVING_SLOWLY" 4 "STOPPED" 3 "STATIONARY" 2 "MOVING" 1 "UNKNOWN" 0 "INVALID" ;
VAL_ 427 OBJ_Motion_Orientation_13 13 "INVALID" 12 "NORTH" 11 "NORTH_WEST" 9 "WEST" 7 "SOUTH_WEST" 6 "SOUTH" 5 "SOUTH_EAST" 3 "EAST" 1 "NORTH_EAST" 0 "UNKNOWN" ;
VAL_ 427 OBJ_Has_Cut_Lane_13 1 "TRUE" 0 "FALSE" ;
VAL_ 427 OBJ_Has_Cut_Path_13 1 "TRUE" 0 "FALSE" ;
VAL_ 427 OBJ_Brake_Light_13 1 "TRUE" 0 "FALSE" ;
VAL_ 427 OBJ_Turn_Indicator_Right_13 1 "TRUE" 0 "FALSE" ;
VAL_ 427 OBJ_Turn_Indicator_Left_13 1 "TRUE" 0 "FALSE" ;
VAL_ 427 OBJ_Light_Indicator_Validity_13 1 "TRUE" 0 "FALSE" ;
VAL_ 427 OBJ_Right_Out_Of_Image_13 1 "TRUE" 0 "FALSE" ;
VAL_ 427 OBJ_Left_Out_Of_Image_13 1 "TRUE" 0 "FALSE" ;
VAL_ 427 OBJ_Right_Out_Of_Image_V_13 1 "TRUE" 0 "FALSE" ;
VAL_ 427 OBJ_Left_Out_Of_Image_V_13 1 "TRUE" 0 "FALSE" ;
VAL_ 427 OBJ_Top_Out_Of_Image_13 1 "TRUE" 0 "FALSE" ;
VAL_ 427 OBJ_Bottom_Out_Of_Image_13 1 "TRUE" 0 "FALSE" ;
VAL_ 427 OBJ_Top_Out_Of_Image_V_13 1 "VALID" 0 "INVALID" ;
VAL_ 427 OBJ_Bottom_Out_Of_Image_V_13 1 "VALID" 0 "INVALID" ;
VAL_ 427 OBJ_Lane_Assignment_13 5 "RIGHT_RIGHT" 4 "RIGHT" 3 "HOST" 2 "LEFT" 1 "LEFT_LEFT" 0 "UNKNOWN" ;
VAL_ 427 OBJ_Lane_Assignment_V_13 1 "VALID" 0 "INVALID" ;
VAL_ 427 OBJ_Age_Seconds_V_13 1 "VALID" 0 "INVALID" ;
VAL_ 427 OBJ_Width_V_13 1 "VALID" 0 "INVALID" ;
VAL_ 427 OBJ_Width_STD_V_13 1 "VALID" 0 "INVALID" ;
VAL_ 427 OBJ_Length_V_13 1 "VALID" 0 "INVALID" ;
VAL_ 427 OBJ_Length_STD_V_13 1 "VALID" 0 "INVALID" ;
VAL_ 427 OBJ_Height_V_13 1 "VALID" 0 "INVALID" ;
VAL_ 427 OBJ_Height_STD_V_13 1 "VALID" 0 "INVALID" ;
VAL_ 427 OBJ_Abs_Long_Velocity_V_13 1 "VALID" 0 "INVALID" ;
VAL_ 427 OBJ_Abs_Long_Vel_STD_V_13 1 "VALID" 0 "INVALID" ;
VAL_ 427 OBJ_Abs_Lat_Velocity_V_13 1 "VALID" 0 "INVALID" ;
VAL_ 427 OBJ_Abs_Lat_Vel_STD_V_13 1 "VALID" 0 "INVALID" ;
VAL_ 427 OBJ_Abs_Long_Acc_V_13 1 "VALID" 0 "INVALID" ;
VAL_ 427 OBJ_Abs_Long_Acc_STD_V_13 1 "VALID" 0 "INVALID" ;
VAL_ 427 OBJ_Abs_Lat_Acc_V_13 1 "VALID" 0 "INVALID" ;
VAL_ 427 OBJ_Abs_Lat_Acc_STD_V_13 1 "VALID" 0 "INVALID" ;
VAL_ 427 OBJ_Abs_Acceleration_V_13 1 "VALID" 0 "INVALID" ;
VAL_ 427 OBJ_Abs_Acc_STD_V_13 1 "VALID" 0 "INVALID" ;
VAL_ 427 OBJ_Inv_TTC_V_13 1 "VALID" 0 "INVALID" ;
VAL_ 427 OBJ_Inv_TTC_STD_V_13 1 "VALID" 0 "INVALID" ;
VAL_ 427 OBJ_Relative_Long_Acc_V_13 1 "VALID" 0 "INVALID" ;
VAL_ 427 OBJ_Rel_Long_Acc_STD_V_13 1 "VALID" 0 "INVALID" ;
VAL_ 427 OBJ_Relative_Long_Velocity_V_13 1 "VALID" 0 "INVALID" ;
VAL_ 427 OBJ_Rel_Long_Vel_STD_V_13 1 "VALID" 0 "INVALID" ;
VAL_ 428 OBJ_Relative_Lat_Velocity_V_13 1 "VALID" 0 "INVALID" ;
VAL_ 428 OBJ_Rel_Lat_Vel_STD_V_13 1 "VALID" 0 "INVALID" ;
VAL_ 428 OBJ_Long_Distance_V_13 1 "VALID" 0 "INVALID" ;
VAL_ 428 OBJ_Long_Distance_STD_V_13 1 "VALID" 0 "INVALID" ;
VAL_ 428 OBJ_Lat_Distance_V_13 1 "VALID" 0 "INVALID" ;
VAL_ 428 OBJ_Lat_Distance_STD_V_13 1 "VALID" 0 "INVALID" ;
VAL_ 428 OBJ_Absolute_Speed_V_13 1 "VALID" 0 "INVALID" ;
VAL_ 428 OBJ_Absolute_Speed_STD_V_13 1 "VALID" 0 "INVALID" ;
VAL_ 428 OBJ_Heading_V_13 1 "VALID" 0 "INVALID" ;
VAL_ 428 OBJ_Heading_STD_V_13 1 "VALID" 0 "INVALID" ;
VAL_ 428 OBJ_Angle_Rate_STD_V_13 1 "VALID" 0 "INVALID" ;
VAL_ 428 OBJ_Angle_Rate_V_13 1 "VALID" 0 "INVALID" ;
VAL_ 428 OBJ_Angle_Right_V_13 1 "VALID" 0 "INVALID" ;
VAL_ 428 OBJ_Angle_Right_STD_V_13 1 "VALID" 0 "INVALID" ;
VAL_ 428 OBJ_Angle_Left_V_13 1 "VALID" 0 "INVALID" ;
VAL_ 428 OBJ_Angle_Left_STD_V_13 1 "VALID" 0 "INVALID" ;
VAL_ 428 OBJ_Angle_Side_V_13 1 "VALID" 0 "INVALID" ;
VAL_ 428 OBJ_Angle_Side_STD_V_13 1 "VALID" 0 "INVALID" ;
VAL_ 428 OBJ_Angle_Mid_V_13 1 "VALID" 0 "INVALID" ;
VAL_ 428 OBJ_Angle_Mid_STD_V_13 1 "VALID" 0 "INVALID" ;
VAL_ 428 OBJ_Angle_Bottom_V_13 1 "VALID" 0 "INVALID" ;
VAL_ 428 OBJ_Angle_Bottom_STD_V_13 1 "VALID" 0 "INVALID" ;
VAL_ 428 OBJ_Visibility_Side_V_13 1 "VALID" 0 "INVALID" ;
VAL_ 428 OBJ_Visibility_Side_13 2 "REAR" 1 "FRONT" 0 "NOT_VISIBLE" ;
VAL_ 428 OBJ_Is_In_Drivable_Area_13 1 "TRUE" 0 "FALSE" ;
VAL_ 428 OBJ_Is_In_Drivable_Area_V_13 1 "VALID" 0 "INVALID" ;
VAL_ 428 OBJ_Is_VeryClose_V_13 1 "VALID" 0 "INVALID" ;
VAL_ 428 OBJ_Is_VeryClose_13 1 "TRUE" 0 "FALSE" ;
VAL_ 428 OBJ_Is_EMERGENCY_VCL_13 1 "TRUE" 0 "FALSE" ;
VAL_ 428 OBJ_EMERGENCY_LIGHT_COLOR_13 3 "(1000)ORANGE" 2 "(0100)BLUE" 1 "(0010)RED" 0 "(0001)OTHER" ;
VAL_ 428 OBJ_EMERGENCY_V_13 1 "TRUE" 0 "FALSE" ;
VAL_ 429 OBJ_Motion_Category_14 13 "ONCOMING" 12 "PRECEEDING" 11 "MOVING" 10 "RTAP" 9 "LTAP" 8 "CROSSING" 7 "MOVING_OUT" 6 "MOVING_IN" 5 "CLOSE_CUT_IN" 4 "PASSING_OUT" 3 "PASSING_IN" 2 "PASSING" 1 "UNDEFINED" 0 "UNFILLED" ;
VAL_ 429 OBJ_Measuring_Status_14 2 "(BIT_2)NOT_VALID_OR_VALID" 1 "(BIT_1)PREDICTED_OR_MEASURED" 0 "(BIT_0)OLD_OR_NEW" ;
VAL_ 429 OBJ_Object_Class_14 8 "UNCERTAIN_VCL" 7 "ANIMAL" 6 "GENERAL_OBJECT" 5 "PEDESTRIAN" 4 "BICYCLE" 3 "MOTORBIKE" 2 "TRUCK" 1 "CAR" 0 "UNFILLED" ;
VAL_ 429 OBJ_Motion_Status_14 5 "MOVING_SLOWLY" 4 "STOPPED" 3 "STATIONARY" 2 "MOVING" 1 "UNKNOWN" 0 "INVALID" ;
VAL_ 429 OBJ_Motion_Orientation_14 13 "INVALID" 12 "NORTH" 11 "NORTH_WEST" 9 "WEST" 7 "SOUTH_WEST" 6 "SOUTH" 5 "SOUTH_EAST" 3 "EAST" 1 "NORTH_EAST" 0 "UNKNOWN" ;
VAL_ 429 OBJ_Has_Cut_Lane_14 1 "TRUE" 0 "FALSE" ;
VAL_ 429 OBJ_Has_Cut_Path_14 1 "TRUE" 0 "FALSE" ;
VAL_ 429 OBJ_Brake_Light_14 1 "TRUE" 0 "FALSE" ;
VAL_ 429 OBJ_Turn_Indicator_Right_14 1 "TRUE" 0 "FALSE" ;
VAL_ 429 OBJ_Turn_Indicator_Left_14 1 "TRUE" 0 "FALSE" ;
VAL_ 429 OBJ_Light_Indicator_Validity_14 1 "TRUE" 0 "FALSE" ;
VAL_ 429 OBJ_Right_Out_Of_Image_14 1 "TRUE" 0 "FALSE" ;
VAL_ 429 OBJ_Left_Out_Of_Image_14 1 "TRUE" 0 "FALSE" ;
VAL_ 429 OBJ_Right_Out_Of_Image_V_14 1 "TRUE" 0 "FALSE" ;
VAL_ 429 OBJ_Left_Out_Of_Image_V_14 1 "TRUE" 0 "FALSE" ;
VAL_ 429 OBJ_Top_Out_Of_Image_14 1 "TRUE" 0 "FALSE" ;
VAL_ 429 OBJ_Bottom_Out_Of_Image_14 1 "TRUE" 0 "FALSE" ;
VAL_ 429 OBJ_Top_Out_Of_Image_V_14 1 "VALID" 0 "INVALID" ;
VAL_ 429 OBJ_Bottom_Out_Of_Image_V_14 1 "VALID" 0 "INVALID" ;
VAL_ 429 OBJ_Lane_Assignment_14 5 "RIGHT_RIGHT" 4 "RIGHT" 3 "HOST" 2 "LEFT" 1 "LEFT_LEFT" 0 "UNKNOWN" ;
VAL_ 429 OBJ_Lane_Assignment_V_14 1 "VALID" 0 "INVALID" ;
VAL_ 429 OBJ_Age_Seconds_V_14 1 "VALID" 0 "INVALID" ;
VAL_ 429 OBJ_Width_V_14 1 "VALID" 0 "INVALID" ;
VAL_ 429 OBJ_Width_STD_V_14 1 "VALID" 0 "INVALID" ;
VAL_ 429 OBJ_Length_V_14 1 "VALID" 0 "INVALID" ;
VAL_ 429 OBJ_Length_STD_V_14 1 "VALID" 0 "INVALID" ;
VAL_ 429 OBJ_Height_V_14 1 "VALID" 0 "INVALID" ;
VAL_ 429 OBJ_Height_STD_V_14 1 "VALID" 0 "INVALID" ;
VAL_ 429 OBJ_Abs_Long_Velocity_V_14 1 "VALID" 0 "INVALID" ;
VAL_ 429 OBJ_Abs_Long_Vel_STD_V_14 1 "VALID" 0 "INVALID" ;
VAL_ 429 OBJ_Abs_Lat_Velocity_V_14 1 "VALID" 0 "INVALID" ;
VAL_ 429 OBJ_Abs_Lat_Vel_STD_V_14 1 "VALID" 0 "INVALID" ;
VAL_ 429 OBJ_Abs_Long_Acc_V_14 1 "VALID" 0 "INVALID" ;
VAL_ 429 OBJ_Abs_Long_Acc_STD_V_14 1 "VALID" 0 "INVALID" ;
VAL_ 429 OBJ_Abs_Lat_Acc_V_14 1 "VALID" 0 "INVALID" ;
VAL_ 429 OBJ_Abs_Lat_Acc_STD_V_14 1 "VALID" 0 "INVALID" ;
VAL_ 429 OBJ_Abs_Acceleration_V_14 1 "VALID" 0 "INVALID" ;
VAL_ 429 OBJ_Abs_Acc_STD_V_14 1 "VALID" 0 "INVALID" ;
VAL_ 429 OBJ_Inv_TTC_V_14 1 "VALID" 0 "INVALID" ;
VAL_ 429 OBJ_Inv_TTC_STD_V_14 1 "VALID" 0 "INVALID" ;
VAL_ 429 OBJ_Relative_Long_Acc_V_14 1 "VALID" 0 "INVALID" ;
VAL_ 429 OBJ_Rel_Long_Acc_STD_V_14 1 "VALID" 0 "INVALID" ;
VAL_ 429 OBJ_Relative_Long_Velocity_V_14 1 "VALID" 0 "INVALID" ;
VAL_ 429 OBJ_Rel_Long_Vel_STD_V_14 1 "VALID" 0 "INVALID" ;
VAL_ 430 OBJ_Relative_Lat_Velocity_V_14 1 "VALID" 0 "INVALID" ;
VAL_ 430 OBJ_Rel_Lat_Vel_STD_V_14 1 "VALID" 0 "INVALID" ;
VAL_ 430 OBJ_Long_Distance_V_14 1 "VALID" 0 "INVALID" ;
VAL_ 430 OBJ_Long_Distance_STD_V_14 1 "VALID" 0 "INVALID" ;
VAL_ 430 OBJ_Lat_Distance_V_14 1 "VALID" 0 "INVALID" ;
VAL_ 430 OBJ_Lat_Distance_STD_V_14 1 "VALID" 0 "INVALID" ;
VAL_ 430 OBJ_Absolute_Speed_V_14 1 "VALID" 0 "INVALID" ;
VAL_ 430 OBJ_Absolute_Speed_STD_V_14 1 "VALID" 0 "INVALID" ;
VAL_ 430 OBJ_Heading_V_14 1 "VALID" 0 "INVALID" ;
VAL_ 430 OBJ_Heading_STD_V_14 1 "VALID" 0 "INVALID" ;
VAL_ 430 OBJ_Angle_Rate_STD_V_14 1 "VALID" 0 "INVALID" ;
VAL_ 430 OBJ_Angle_Rate_V_14 1 "VALID" 0 "INVALID" ;
VAL_ 430 OBJ_Angle_Right_V_14 1 "VALID" 0 "INVALID" ;
VAL_ 430 OBJ_Angle_Right_STD_V_14 1 "VALID" 0 "INVALID" ;
VAL_ 430 OBJ_Angle_Left_V_14 1 "VALID" 0 "INVALID" ;
VAL_ 430 OBJ_Angle_Left_STD_V_14 1 "VALID" 0 "INVALID" ;
VAL_ 430 OBJ_Angle_Side_V_14 1 "VALID" 0 "INVALID" ;
VAL_ 430 OBJ_Angle_Side_STD_V_14 1 "VALID" 0 "INVALID" ;
VAL_ 430 OBJ_Angle_Mid_V_14 1 "VALID" 0 "INVALID" ;
VAL_ 430 OBJ_Angle_Mid_STD_V_14 1 "VALID" 0 "INVALID" ;
VAL_ 430 OBJ_Angle_Bottom_V_14 1 "VALID" 0 "INVALID" ;
VAL_ 430 OBJ_Angle_Bottom_STD_V_14 1 "VALID" 0 "INVALID" ;
VAL_ 430 OBJ_Visibility_Side_V_14 1 "VALID" 0 "INVALID" ;
VAL_ 430 OBJ_Visibility_Side_14 2 "REAR" 1 "FRONT" 0 "NOT_VISIBLE" ;
VAL_ 430 OBJ_Is_In_Drivable_Area_14 1 "TRUE" 0 "FALSE" ;
VAL_ 430 OBJ_Is_In_Drivable_Area_V_14 1 "VALID" 0 "INVALID" ;
VAL_ 430 OBJ_Is_VeryClose_V_14 1 "VALID" 0 "INVALID" ;
VAL_ 430 OBJ_Is_VeryClose_14 1 "TRUE" 0 "FALSE" ;
VAL_ 430 OBJ_Is_EMERGENCY_VCL_14 1 "TRUE" 0 "FALSE" ;
VAL_ 430 OBJ_EMERGENCY_LIGHT_COLOR_14 3 "(1000)ORANGE" 2 "(0100)BLUE" 1 "(0010)RED" 0 "(0001)OTHER" ;
VAL_ 430 OBJ_EMERGENCY_V_14 1 "TRUE" 0 "FALSE" ;

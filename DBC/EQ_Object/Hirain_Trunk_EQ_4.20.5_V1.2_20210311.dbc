VERSION "created by canmatrix"

NS_ :

BS_:

BU_: ADAS ADU

BO_ 2015 FunRequest: 8 ADU
 SG_ Request_Fun : 0|64@1+ (1,0) [0|0] ""  ADAS

BO_ 1864 PhyResponse: 8 ADAS
 SG_ Response_Phy : 0|64@1+ (1,0) [0|0] ""  ADU

BO_ 1856 PhyRequest: 8 ADU
 SG_ Request_Phy : 0|64@1+ (1,0) [0|0] ""  ADAS

BO_ 513 RandomCodeResponse_ADU: 16 ADU
 SG_ feedback : 0|128@1+ (1,0) [0|4095] ""  ADAS

BO_ 512 RandomCodeRequest_ADAS: 16 ADAS
 SG_ randomrequestcode : 0|128@1+ (1,0) [0|4095] ""  ADU

BO_ 434 Core_Car_sensor: 48 ADAS
 SG_ CIN_Vehicle_Speed : 0|15@1+ (0.015625,0) [0|350] "kph"  ADU
 SG_ CIN_Vehicle_Speed_Valid : 15|1@1+ (1,0) [0|1] "bool"  ADU
 SG_ CIN_Vehicle_Yaw : 16|12@1+ (0.0625,-128) [-128|127.938] "deg_per_s"  ADU
 SG_ CIN_Vehicle_Yaw_Valid : 28|1@1+ (1,0) [0|1] "bool"  ADU
 SG_ CIN_Steering_Wheel_Angle : 29|16@1- (0.0625,0) [-2048|2047.94] "deg"  ADU
 SG_ CIN_Steering_Wheel_Angle_Valid : 45|1@1+ (1,0) [0|1] "bool"  ADU
 SG_ CIN_MCU_Sync_Timestamp : 46|64@1+ (1,0) [0|1.84467E+019] "us"  ADU
 SG_ CIN_MCU_Sync_Timestamp_Valid : 110|1@1+ (1,0) [0|1] "bool"  ADU

BO_ 338 Core_Common_protocol: 48 ADAS
 SG_ COM_CRC : 0|32@1+ (1,0) [0|4294970000] "NA"  ADU
 SG_ COM_Protocol_Version : 32|8@1+ (1,0) [8|8] "counter"  ADU
 SG_ COM_Sync_Frame_ID : 40|8@1+ (1,0) [0|255] "counter"  ADU
 SG_ COM_Frame_MCU_TS_Start : 48|64@1+ (1,0) [0|1.84467E+019] "us"  ADU
 SG_ COM_Last_MCU_Sync_TS : 112|64@1+ (1,0) [0|1.84467E+019] "us"  ADU
 SG_ COM_Last_Clock_Sync_Skew : 176|22@1+ (1,-100000) [-100000|100000] "ns"  ADU
 SG_ COM_Last_Clock_Sync_Error : 198|1@1+ (1,0) [0|1] "bool"  ADU
 SG_ COM_EyeQ_Frame_ID : 199|32@1+ (1,0) [0|4294970000] "counter"  ADU
 SG_ COM_Cam_Frame_ID : 231|32@1+ (1,0) [0|4294970000] "counter"  ADU
 SG_ COM_DayTime_Indicator : 263|2@1+ (1,0) [0|2] "ENUM"  ADU
 SG_ COM_HIL_Mode_Status : 265|1@1+ (1,0) [0|1] "ENUM"  ADU
 SG_ COM_Driving_Side_V : 266|1@1+ (1,0) [0|1] "bool"  ADU
 SG_ COM_Driving_Side : 267|8@1+ (1,0) [0|2] "ENUM"  ADU
 SG_ COM_Is_HighSpeed_Road_V : 275|1@1+ (1,0) [0|1] "bool"  ADU
 SG_ COM_Is_HighSpeed_Road : 276|1@1+ (1,0) [0|1] "bool"  ADU
 SG_ Reserved_1 : 277|2@1+ (1,0) [0|1] "ENUM"  ADU
 SG_ Reserved_2 : 279|32@1+ (1,0) [0|4294970000] "BITWIZE"  ADU
 SG_ Reserved_3 : 311|32@1+ (1,0) [0|4294970000] "BITWIZE"  ADU

BO_ 369 Core_Failsafe_protocol: 48 ADAS
 SG_ FS_Header_CRC : 0|32@1+ (1,0) [0|4294970000] "NA"  ADU
 SG_ FS_Protocol_Version : 32|8@1+ (1,0) [6|6] "NA"  ADU
 SG_ FS_Sync_ID : 40|8@1+ (1,0) [0|255] "counter"  ADU
 SG_ FS_Cameras_Number : 48|4@1+ (1,0) [0|15] "counter"  ADU
 SG_ FS_TSR_Out_OF_Calib : 52|8@1+ (1,0) [0|15] "BITWIZE"  ADU
 SG_ FS_Out_Of_Calib : 60|3@1+ (1,0) [0|5] "ENUM"  ADU
 SG_ FS_Impacted_Technologies : 63|16@1+ (1,0) [0|65535] "BITWIZE"  ADU
 SG_ FS_Rain : 79|3@1+ (1,0) [0|5] "ENUM"  ADU
 SG_ FS_Fog : 82|3@1+ (1,0) [0|5] "ENUM"  ADU
 SG_ FS_Calibration_Misalignment : 85|3@1+ (1,0) [0|5] "ENUM"  ADU
 SG_ FS_C2W_OOR : 88|3@1+ (1,0) [0|5] "ENUM"  ADU
 SG_ FS_CRC_0 : 91|32@1+ (1,0) [0|4294970000] "NA"  ADU
 SG_ FS_Camera_ID_0 : 123|4@1+ (1,0) [0|11] "counter"  ADU
 SG_ FS_Free_Sight_0 : 127|1@1+ (1,0) [0|1] "bool"  ADU
 SG_ FS_Splashes_0 : 128|3@1+ (1,0) [0|5] "ENUM"  ADU
 SG_ FS_Sun_Ray_0 : 131|3@1+ (1,0) [0|5] "ENUM"  ADU
 SG_ FS_Low_Sun_0 : 134|3@1+ (1,0) [0|5] "ENUM"  ADU
 SG_ FS_Blur_Image_0 : 137|3@1+ (1,0) [0|5] "ENUM"  ADU
 SG_ FS_Partial_Blockage_0 : 140|3@1+ (1,0) [0|5] "ENUM"  ADU
 SG_ FS_Full_Blockage_0 : 143|3@1+ (1,0) [0|5] "ENUM"  ADU
 SG_ FS_Frozen_Windshield_Lens_0 : 146|3@1+ (1,0) [0|5] "ENUM"  ADU
 SG_ FS_Out_Of_Focus_0 : 149|3@1+ (1,0) [0|5] "ENUM"  ADU
 SG_ FS_C2C_Out_Of_Calib_0 : 152|3@1+ (1,0) [0|5] "ENUM"  ADU

BO_ 396 Core_Lanes_Adjacent_protocol_0: 48 ADAS
 SG_ LA_Protocol_Version : 0|8@1+ (1,0) [7|7] "counter"  ADU
 SG_ LA_Sync_ID_0 : 8|8@1+ (1,0) [0|255] "counter"  ADU
 SG_ LA_Adjacent_Count : 16|4@1+ (1,0) [0|8] "counter"  ADU
 SG_ LA_Lane_Track_ID_0 : 20|8@1+ (1,0) [0|255] "counter"  ADU
 SG_ LA_Age_0 : 28|8@1+ (1,0) [0|255] "frames"  ADU
 SG_ LA_Confidence_0 : 36|7@1+ (0.01,0) [0|1] "NA"  ADU
 SG_ LA_Color_0 : 43|2@1+ (1,0) [0|3] "ENUM"  ADU
 SG_ LA_Color_Conf_0 : 45|7@1+ (0.01,0) [0|1] "NA"  ADU
 SG_ LA_Prediction_Reason_0 : 52|6@1+ (1,0) [0|63] "BITWIZE"  ADU
 SG_ LA_Availability_State_0 : 58|2@1+ (1,0) [0|2] "ENUM"  ADU
 SG_ LA_View_Range_Start_0 : 60|15@1+ (0.01,0) [0|200] "m"  ADU
 SG_ LA_View_Range_End_0 : 76|15@1+ (0.01,0) [0|200] "m"  ADU
 SG_ LA_Measured_VR_End_0 : 92|15@1+ (0.01,0) [0|200] "m"  ADU
 SG_ LA_Lanemark_Type_0 : 108|4@1+ (1,0) [0|6] "ENUM"  ADU
 SG_ LA_DLM_Type_0 : 112|3@1+ (1,0) [0|5] "ENUM"  ADU
 SG_ LA_Lanemark_Type_Conf_0 : 115|7@1+ (0.01,0) [0|1] "NA"  ADU
 SG_ LA_Line_Side_0 : 122|4@1+ (1,0) [0|6] "ENUM"  ADU
 SG_ LA_Marker_Width_0 : 126|8@1+ (0.01,0) [0|0.7] "m"  ADU
 SG_ LA_Marker_Width_STD_0 : 134|7@1+ (0.005,0) [0|0.5] "m"  ADU
 SG_ LA_Line_C3_0 : 141|32@1- (1,0) [-0.004|0.004] "INV(m2)"  ADU
 SG_ LA_Line_C2_0 : 173|32@1- (1,0) [-0.125|0.125] "INV(m)"  ADU
 SG_ LA_Line_C1_0 : 205|32@1- (1,0) [-2|2] "rad"  ADU
 SG_ LA_Line_C0_0 : 237|32@1- (1,0) [-30|30] "m"  ADU

BO_ 397 Core_Lanes_Adjacent_protocol_1: 48 ADAS
 SG_ LA_Sync_ID_1 : 0|8@1+ (1,0) [0|255] "counter"  ADU
 SG_ LA_Lane_Track_ID_1 : 8|8@1+ (1,0) [0|255] "counter"  ADU
 SG_ LA_Age_1 : 16|8@1+ (1,0) [0|255] "frames"  ADU
 SG_ LA_Confidence_1 : 24|7@1+ (0.01,0) [0|1] "NA"  ADU
 SG_ LA_Color_1 : 31|2@1+ (1,0) [0|3] "ENUM"  ADU
 SG_ LA_Color_Conf_1 : 33|7@1+ (0.01,0) [0|1] "NA"  ADU
 SG_ LA_Prediction_Reason_1 : 40|6@1+ (1,0) [0|63] "BITWIZE"  ADU
 SG_ LA_Availability_State_1 : 46|2@1+ (1,0) [0|2] "ENUM"  ADU
 SG_ LA_View_Range_Start_1 : 48|15@1+ (0.01,0) [0|200] "m"  ADU
 SG_ LA_View_Range_End_1 : 64|15@1+ (0.01,0) [0|200] "m"  ADU
 SG_ LA_Measured_VR_End_1 : 80|15@1+ (0.01,0) [0|200] "m"  ADU
 SG_ LA_Lanemark_Type_1 : 96|4@1+ (1,0) [0|6] "ENUM"  ADU
 SG_ LA_DLM_Type_1 : 100|3@1+ (1,0) [0|5] "ENUM"  ADU
 SG_ LA_Lanemark_Type_Conf_1 : 103|7@1+ (0.01,0) [0|1] "NA"  ADU
 SG_ LA_Line_Side_1 : 110|4@1+ (1,0) [0|6] "ENUM"  ADU
 SG_ LA_Marker_Width_1 : 114|8@1+ (0.01,0) [0|0.7] "m"  ADU
 SG_ LA_Marker_Width_STD_1 : 122|7@1+ (0.005,0) [0|0.5] "m"  ADU
 SG_ LA_Line_C3_1 : 129|32@1- (1,0) [-0.004|0.004] "INV(m2)"  ADU
 SG_ LA_Line_C2_1 : 161|32@1- (1,0) [-0.125|0.125] "INV(m)"  ADU
 SG_ LA_Line_C1_1 : 193|32@1- (1,0) [-2|2] "rad"  ADU
 SG_ LA_Line_C0_1 : 225|32@1- (1,0) [-30|30] "m"  ADU

BO_ 398 Core_Lanes_Host_protocol_0: 64 ADAS
 SG_ LH_Protocol_Version : 0|8@1+ (1,0) [7|7] "counter"  ADU
 SG_ LH_Sync_ID_0 : 8|8@1+ (1,0) [0|255] "counter"  ADU
 SG_ LH_Lanes_Count : 16|3@1+ (1,0) [0|6] "counter"  ADU
 SG_ LH_Estimated_Width : 19|10@1+ (0.01,0) [0|10] "m"  ADU
 SG_ LH_CRC_0 : 29|32@1+ (1,0) [0|4294970000] "NA"  ADU
 SG_ LH_Track_ID_0 : 61|8@1+ (1,0) [0|255] "counter"  ADU
 SG_ LH_Is_Triggered_SDM_Type_0 : 69|2@1+ (1,0) [0|2] "ENUM"  ADU
 SG_ LH_Is_Triggered_SDM_Model_0 : 71|2@1+ (1,0) [0|2] "ENUM"  ADU
 SG_ LH_Age_0 : 73|8@1+ (1,0) [0|255] "frames"  ADU
 SG_ LH_Confidence_0 : 81|7@1+ (0.01,0) [0|1] "NA"  ADU
 SG_ LH_Prediction_Reason_0 : 88|6@1+ (1,0) [0|63] "BITWIZE"  ADU
 SG_ LH_Availability_State_0 : 94|2@1+ (1,0) [0|2] "ENUM"  ADU
 SG_ LH_Color_0 : 96|2@1+ (1,0) [0|3] "ENUM"  ADU
 SG_ LH_Color_Confidence_0 : 98|7@1+ (0.01,0) [0|1] "NA"  ADU
 SG_ LH_Lanemark_Type_0 : 105|4@1+ (1,0) [0|6] "ENUM"  ADU
 SG_ LH_DLM_Type_0 : 109|3@1+ (1,0) [0|5] "ENUM"  ADU
 SG_ LH_DECEL_Type_0 : 112|3@1+ (1,0) [0|5] "ENUM"  ADU
 SG_ LH_Lanemark_Type_Conf_0 : 115|7@1+ (0.01,0) [0|1] "NA"  ADU
 SG_ LH_Side_0 : 122|2@1+ (1,0) [0|2] "ENUM"  ADU
 SG_ LH_Crossing_0 : 124|1@1+ (1,0) [0|1] "bool"  ADU
 SG_ LH_Marker_Width_0 : 125|8@1+ (0.01,0) [0|0.7] "m"  ADU
 SG_ LH_Marker_Width_STD_0 : 133|7@1+ (0.005,0) [0|0.5] "m"  ADU
 SG_ Reserved_4 : 140|1@1+ (1,0) [0|1] "bool"  ADU
 SG_ LH_Is_Multi_Clothoid_0 : 141|1@1+ (1,0) [0|1] "bool"  ADU
 SG_ LH_Line_First_C0_0 : 142|32@1- (1,0) [-30|30] "m"  ADU
 SG_ LH_Line_First_C1_0 : 174|32@1- (1,0) [-2|2] "rad"  ADU
 SG_ LH_Line_First_C2_0 : 206|32@1- (1,0) [-0.125|0.125] "INV(m)"  ADU
 SG_ LH_Line_First_C3_0 : 238|64@1- (1,0) [-0.004|0.004] "INV(m2)"  ADU
 SG_ LH_First_VR_Start_0 : 270|15@1+ (0.01,0) [0|200] "m"  ADU
 SG_ LH_First_VR_End_0 : 286|15@1+ (0.01,0) [0|200] "m"  ADU
 SG_ LH_First_Measured_VR_End_0 : 302|15@1+ (0.01,0) [0|200] "m"  ADU
 SG_ LH_Second_Measured_VR_End_0 : 318|15@1+ (0.01,0) [0|200] "m"  ADU
 SG_ LH_Line_Second_C0_0 : 334|32@1- (1,0) [-30|30] "m"  ADU
 SG_ LH_Line_Second_C1_0 : 366|32@1- (1,0) [-2|2] "rad"  ADU
 SG_ LH_Line_Second_C2_0 : 398|32@1- (1,0) [-0.125|0.125] "INV(m)"  ADU
 SG_ LH_Line_Second_C3_0 : 430|32@1- (1,0) [-0.004|0.004] "INV(m2)"  ADU
 SG_ LH_Second_VR_Start_0 : 462|15@1+ (0.01,0) [0|200] "m"  ADU
 SG_ LH_Second_VR_End_0 : 478|15@1+ (0.01,0) [0|200] "m"  ADU

BO_ 399 Core_Lanes_Host_protocol_1: 64 ADAS
 SG_ LH_Sync_ID_1 : 0|8@1+ (1,0) [0|255] "counter"  ADU
 SG_ LH_CRC_1 : 8|32@1+ (1,0) [0|4294970000] "NA"  ADU
 SG_ LH_Is_Triggered_SDM_Type_1 : 40|2@1+ (1,0) [0|2] "ENUM"  ADU
 SG_ LH_Is_Triggered_SDM_Model_1 : 42|2@1+ (1,0) [0|2] "ENUM"  ADU
 SG_ LH_Track_ID_1 : 44|8@1+ (1,0) [0|255] "counter"  ADU
 SG_ LH_Age_1 : 52|8@1+ (1,0) [0|255] "frames"  ADU
 SG_ LH_Confidence_1 : 60|7@1+ (0.01,0) [0|1] "NA"  ADU
 SG_ LH_Prediction_Reason_1 : 67|6@1+ (1,0) [0|63] "BITWIZE"  ADU
 SG_ LH_Availability_State_1 : 73|2@1+ (1,0) [0|2] "ENUM"  ADU
 SG_ LH_Color_1 : 75|2@1+ (1,0) [0|3] "ENUM"  ADU
 SG_ LH_Color_Confidence_1 : 77|7@1+ (0.01,0) [0|1] "NA"  ADU
 SG_ LH_Lanemark_Type_1 : 84|4@1+ (1,0) [0|6] "ENUM"  ADU
 SG_ LH_DLM_Type_1 : 88|3@1+ (1,0) [0|5] "ENUM"  ADU
 SG_ LH_DECEL_Type_1 : 91|3@1+ (1,0) [0|5] "ENUM"  ADU
 SG_ LH_Lanemark_Type_Conf_1 : 94|7@1+ (0.01,0) [0|1] "NA"  ADU
 SG_ LH_Side_1 : 101|2@1+ (1,0) [0|2] "ENUM"  ADU
 SG_ LH_Crossing_1 : 103|1@1+ (1,0) [0|1] "bool"  ADU
 SG_ LH_Marker_Width_1 : 104|8@1+ (0.01,0) [0|0.7] "m"  ADU
 SG_ LH_Marker_Width_STD_1 : 112|7@1+ (0.005,0) [0|0.5] "m"  ADU
 SG_ Reserved_5 : 119|1@1+ (1,0) [0|1] "bool"  ADU
 SG_ LH_Is_Multi_Clothoid_1 : 120|1@1+ (1,0) [0|1] "bool"  ADU
 SG_ LH_Line_First_C0_1 : 121|32@1- (1,0) [-30|30] "m"  ADU
 SG_ LH_Line_First_C1_1 : 153|32@1- (1,0) [-2|2] "rad"  ADU
 SG_ LH_Line_First_C2_1 : 185|32@1- (1,0) [-0.125|0.125] "INV(m)"  ADU
 SG_ LH_Line_First_C3_1 : 217|32@1- (1,0) [-0.004|0.004] "INV(m2)"  ADU
 SG_ LH_First_VR_Start_1 : 249|15@1+ (0.01,0) [0|200] "m"  ADU
 SG_ LH_First_VR_End_1 : 265|15@1+ (0.01,0) [0|200] "m"  ADU
 SG_ LH_First_Measured_VR_End_1 : 281|15@1+ (0.01,0) [0|200] "m"  ADU
 SG_ LH_Second_Measured_VR_End_1 : 297|15@1+ (0.01,0) [0|200] "m"  ADU
 SG_ LH_Line_Second_C0_1 : 313|32@1- (1,0) [-30|30] "m"  ADU
 SG_ LH_Line_Second_C1_1 : 345|32@1- (1,0) [-2|2] "rad"  ADU
 SG_ LH_Line_Second_C2_1 : 377|32@1- (1,0) [-0.125|0.125] "INV(m)"  ADU
 SG_ LH_Line_Second_C3_1 : 409|32@1- (1,0) [-0.004|0.004] "INV(m2)"  ADU
 SG_ LH_Second_VR_Start_1 : 441|15@1+ (0.01,0) [0|200] "m"  ADU
 SG_ LH_Second_VR_End_1 : 457|15@1+ (0.01,0) [0|200] "m"  ADU

BO_ 394 Core_Lanes_Road_Edge_protocol_0: 48 ADAS
 SG_ LRE_Header_CRC : 0|32@1+ (1,0) [0|4294970000] "NA"  ADU
 SG_ LRE_Protocol_Version : 32|8@1+ (1,0) [11|11] "counter"  ADU
 SG_ LRE_Sync_ID_0 : 40|8@1+ (1,0) [0|255] "counter"  ADU
 SG_ LRE_Count : 48|3@1+ (1,0) [0|4] "counter"  ADU
 SG_ LRE_Element_CRC_0 : 51|32@1+ (1,0) [0|4294970000] "NA"  ADU
 SG_ LRE_ID_0 : 83|8@1+ (1,0) [0|255] "counter"  ADU
 SG_ LRE_Age_0 : 91|8@1+ (1,0) [0|255] "frames"  ADU
 SG_ LRE_Confidence_0 : 99|8@1+ (0.01,-1) [-1|1] "NA"  ADU
 SG_ LRE_Prediction_Reason_0 : 107|6@1+ (1,0) [0|63] "BITWIZE"  ADU
 SG_ LRE_Availability_State_0 : 113|2@1+ (1,0) [0|2] "ENUM"  ADU
 SG_ LRE_View_Range_Start_0 : 115|15@1+ (0.01,0) [0|200] "m"  ADU
 SG_ LRE_View_Range_End_0 : 131|15@1+ (0.01,0) [0|200] "m"  ADU
 SG_ LRE_Measured_VR_End_0 : 147|15@1+ (0.01,0) [0|200] "m"  ADU
 SG_ LRE_Side_0 : 163|2@1+ (1,0) [0|2] "ENUM"  ADU
 SG_ LRE_Is_Triggered_SDM_Model_0 : 165|2@1+ (1,0) [0|2] "ENUM"  ADU
 SG_ LRE_Line_C3_0 : 167|32@1- (1,0) [-0.004|0.004] "INV(m2)"  ADU
 SG_ LRE_Line_C2_0 : 199|32@1- (1,0) [-0.125|0.125] "INV(m)"  ADU
 SG_ LRE_Line_C1_0 : 231|32@1- (1,0) [-2|2] "rad"  ADU
 SG_ LRE_Line_C0_0 : 263|32@1- (1,0) [-30|30] "m"  ADU
 SG_ Reserved_6 : 295|2@1+ (1,0) [0|2] "ENUM"  ADU

BO_ 395 Core_Lanes_Road_Edge_protocol_1: 48 ADAS
 SG_ LRE_Sync_ID_1 : 0|8@1+ (1,0) [0|255] "counter"  ADU
 SG_ LRE_Element_CRC_1 : 8|32@1+ (1,0) [0|4294970000] "NA"  ADU
 SG_ LRE_ID_1 : 40|8@1+ (1,0) [0|255] "counter"  ADU
 SG_ LRE_Age_1 : 48|8@1+ (1,0) [0|255] "frames"  ADU
 SG_ LRE_Confidence_1 : 56|8@1+ (0.01,-1) [-1|1] "NA"  ADU
 SG_ LRE_Prediction_Reason_1 : 64|6@1+ (1,0) [0|63] "BITWIZE"  ADU
 SG_ LRE_Availability_State_1 : 70|2@1+ (1,0) [0|2] "ENUM"  ADU
 SG_ LRE_View_Range_Start_1 : 72|15@1+ (0.01,0) [0|200] "m"  ADU
 SG_ LRE_View_Range_End_1 : 88|15@1+ (0.01,0) [0|200] "m"  ADU
 SG_ LRE_Measured_VR_End_1 : 104|15@1+ (0.01,0) [0|200] "m"  ADU
 SG_ LRE_Side_1 : 120|2@1+ (1,0) [0|2] "ENUM"  ADU
 SG_ LRE_Is_Triggered_SDM_Model_1 : 122|2@1+ (1,0) [0|2] "ENUM"  ADU
 SG_ LRE_Line_C3_1 : 124|32@1- (1,0) [-0.004|0.004] "INV(m2)"  ADU
 SG_ LRE_Line_C2_1 : 156|32@1- (1,0) [-0.125|0.125] "INV(m)"  ADU
 SG_ LRE_Line_C1_1 : 188|32@1- (1,0) [-2|2] "rad"  ADU
 SG_ LRE_Line_C0_1 : 220|32@1- (1,0) [-30|30] "m"  ADU
 SG_ Reserved_7 : 252|2@1+ (1,0) [0|2] "ENUM"  ADU

BO_ 342 Core_Traffic_Signs_protocol_0: 64 ADAS
 SG_ TSR_Protocol_Version : 0|8@1+ (1,0) [10|10] "counter"  ADU
 SG_ TSR_Sync_ID_0 : 8|8@1+ (1,0) [0|255] "counter"  ADU
 SG_ TSR_Approved_Sign_Count : 16|5@1+ (1,0) [0|20] "counter"  ADU
 SG_ TSR_Filtered_Sign_Count : 21|3@1+ (1,0) [0|5] "counter"  ADU
 SG_ TSR_UnderTracking_Sign_Count : 24|5@1+ (1,0) [0|20] "counter"  ADU
 SG_ TSR_ID_0 : 29|8@1+ (1,0) [0|255] "counter"  ADU
 SG_ TSR_Sign_Name_0 : 37|10@1+ (1,0) [0|1023] "NA"  ADU
 SG_ TSR_Relevancy_0 : 47|5@1+ (1,0) [0|13] "ENUM"  ADU
 SG_ TSR_Sup1_SignName_0 : 52|8@1+ (1,0) [0|255] "NA"  ADU
 SG_ TSR_Filter_Type_0 : 60|4@1+ (1,0) [0|7] "ENUM"  ADU
 SG_ TSR_Sup1_Confidence_0 : 64|7@1+ (0.01,0) [0|1] "NA"  ADU
 SG_ TSR_Sup1_Position_0 : 71|3@1+ (1,0) [0|4] "ENUM"  ADU
 SG_ TSR_Sup2_SignName_0 : 74|8@1+ (1,0) [0|255] "NA"  ADU
 SG_ TSR_Sup2_Confidence_0 : 82|7@1+ (0.01,0) [0|1] "NA"  ADU
 SG_ TSR_Sup2_Position_0 : 89|3@1+ (1,0) [0|4] "ENUM"  ADU
 SG_ TSR_Confidence_0 : 92|7@1+ (0.01,0) [0|1] "NA"  ADU
 SG_ TSR_Sign_Shape_0 : 99|4@1+ (1,0) [0|8] "ENUM"  ADU
 SG_ TSR_Sign_Structure_0 : 103|3@1+ (1,0) [0|3] "ENUM"  ADU
 SG_ TSR_Tracking_Age_0 : 106|10@1+ (1,0) [0|1000] "counter"  ADU
 SG_ TSR_Sign_Long_Distance_0 : 116|15@1+ (0.01,-50) [-50|200] "m"  ADU
 SG_ TSR_Sign_Long_Distance_STD_0 : 131|15@1+ (0.01,0) [0|200] "m"  ADU
 SG_ TSR_Sign_Lateral_Distance_0 : 146|13@1+ (0.01,-32) [-32|31] "m"  ADU
 SG_ TSR_Sign_Lat_Distance_STD_0 : 159|13@1+ (0.01,-32) [-32|31] "m"  ADU
 SG_ TSR_Sign_Height_0 : 172|15@1+ (0.01,-15) [-15|15] "m"  ADU
 SG_ TSR_Sign_Panel_Height_STD_0 : 187|10@1+ (0.01,0) [0|8] "m"  ADU
 SG_ TSR_Sign_Height_STD_0 : 197|15@1+ (0.01,-15) [-15|15] "m"  ADU
 SG_ TSR_Measurement_Status_0 : 212|3@1+ (1,0) [0|5] "ENUM"  ADU
 SG_ TSR_AngleZ_0 : 215|10@1+ (0.01,0) [0|3.14] "rad"  ADU
 SG_ TSR_Relevancy_Confidence_0 : 225|7@1+ (0.01,0) [0|1] "NA"  ADU
 SG_ TSR_ID_1 : 232|8@1+ (1,0) [0|255] "counter"  ADU
 SG_ TSR_Sign_Name_1 : 240|10@1+ (1,0) [0|1023] "NA"  ADU
 SG_ TSR_Relevancy_1 : 250|5@1+ (1,0) [0|13] "ENUM"  ADU
 SG_ TSR_Filter_Type_1 : 255|4@1+ (1,0) [0|7] "ENUM"  ADU
 SG_ TSR_Sup1_SignName_1 : 259|8@1+ (1,0) [0|255] "NA"  ADU
 SG_ TSR_Sup1_Confidence_1 : 267|7@1+ (0.01,0) [0|1] "NA"  ADU
 SG_ TSR_Sup1_Position_1 : 274|3@1+ (1,0) [0|4] "ENUM"  ADU
 SG_ TSR_Sup2_SignName_1 : 277|8@1+ (1,0) [0|255] "NA"  ADU
 SG_ TSR_Sup2_Confidence_1 : 285|7@1+ (0.01,0) [0|1] "NA"  ADU
 SG_ TSR_Sup2_Position_1 : 292|3@1+ (1,0) [0|4] "ENUM"  ADU
 SG_ TSR_Confidence_1 : 295|7@1+ (0.01,0) [0|1] "NA"  ADU
 SG_ TSR_Sign_Shape_1 : 302|4@1+ (1,0) [0|8] "ENUM"  ADU
 SG_ TSR_Sign_Structure_1 : 306|3@1+ (1,0) [0|3] "ENUM"  ADU
 SG_ TSR_Tracking_Age_1 : 309|10@1+ (1,0) [0|1000] "counter"  ADU
 SG_ TSR_Sign_Long_Distance_1 : 319|15@1+ (0.01,-50) [-50|200] "m"  ADU
 SG_ TSR_Sign_Long_Distance_STD_1 : 334|15@1+ (0.01,0) [0|200] "m"  ADU
 SG_ TSR_Sign_Lateral_Distance_1 : 349|13@1+ (0.01,-32) [-32|31] "m"  ADU
 SG_ TSR_Sign_Lat_Distance_STD_1 : 362|13@1+ (0.01,-32) [-32|31] "m"  ADU
 SG_ TSR_Sign_Height_1 : 375|15@1+ (0.01,-15) [-15|15] "m"  ADU
 SG_ TSR_Sign_Panel_Height_STD_1 : 390|10@1+ (0.01,0) [0|8] "m"  ADU
 SG_ TSR_Sign_Height_STD_1 : 400|15@1+ (0.01,-15) [-15|15] "m"  ADU
 SG_ TSR_Measurement_Status_1 : 415|3@1+ (1,0) [0|5] "ENUM"  ADU
 SG_ TSR_AngleZ_1 : 418|10@1+ (0.01,0) [0|3.14] "rad"  ADU
 SG_ TSR_Relevancy_Confidence_1 : 428|7@1+ (0.01,0) [0|1] "NA"  ADU

BO_ 343 Core_Traffic_Signs_protocol_1: 64 ADAS
 SG_ TSR_Sync_ID_1 : 0|8@1+ (1,0) [0|255] "counter"  ADU
 SG_ TSR_ID_2 : 8|8@1+ (1,0) [0|255] "counter"  ADU
 SG_ TSR_Sign_Name_2 : 16|10@1+ (1,0) [0|1023] "NA"  ADU
 SG_ TSR_Relevancy_2 : 26|5@1+ (1,0) [0|13] "ENUM"  ADU
 SG_ TSR_Filter_Type_2 : 31|4@1+ (1,0) [0|7] "ENUM"  ADU
 SG_ TSR_Sup1_SignName_2 : 35|8@1+ (1,0) [0|255] "NA"  ADU
 SG_ TSR_Sup1_Confidence_2 : 43|7@1+ (0.01,0) [0|1] "NA"  ADU
 SG_ TSR_Sup1_Position_2 : 50|3@1+ (1,0) [0|4] "ENUM"  ADU
 SG_ TSR_Sup2_SignName_2 : 53|8@1+ (1,0) [0|255] "NA"  ADU
 SG_ TSR_Sup2_Confidence_2 : 61|7@1+ (0.01,0) [0|1] "NA"  ADU
 SG_ TSR_Sup2_Position_2 : 68|3@1+ (1,0) [0|4] "ENUM"  ADU
 SG_ TSR_Confidence_2 : 71|7@1+ (0.01,0) [0|1] "NA"  ADU
 SG_ TSR_Sign_Shape_2 : 78|4@1+ (1,0) [0|8] "ENUM"  ADU
 SG_ TSR_Sign_Structure_2 : 82|3@1+ (1,0) [0|3] "ENUM"  ADU
 SG_ TSR_Tracking_Age_2 : 85|10@1+ (1,0) [0|1000] "counter"  ADU
 SG_ TSR_Sign_Long_Distance_2 : 95|15@1+ (0.01,-50) [-50|200] "m"  ADU
 SG_ TSR_Sign_Long_Distance_STD_2 : 110|15@1+ (0.01,0) [0|200] "m"  ADU
 SG_ TSR_Sign_Lateral_Distance_2 : 125|13@1+ (0.01,-32) [-32|31] "m"  ADU
 SG_ TSR_Sign_Lat_Distance_STD_2 : 138|13@1+ (0.01,-32) [-32|31] "m"  ADU
 SG_ TSR_Sign_Height_2 : 151|15@1+ (0.01,-15) [-15|15] "m"  ADU
 SG_ TSR_Sign_Panel_Height_STD_2 : 166|10@1+ (0.01,0) [0|8] "m"  ADU
 SG_ TSR_Sign_Height_STD_2 : 176|15@1+ (0.01,-15) [-15|15] "m"  ADU
 SG_ TSR_Measurement_Status_2 : 191|3@1+ (1,0) [0|5] "ENUM"  ADU
 SG_ TSR_AngleZ_2 : 194|10@1+ (0.01,0) [0|3.14] "rad"  ADU
 SG_ TSR_Relevancy_Confidence_2 : 204|7@1+ (0.01,0) [0|1] "NA"  ADU
 SG_ TSR_ID_3 : 211|8@1+ (1,0) [0|255] "counter"  ADU
 SG_ TSR_Sign_Name_3 : 219|10@1+ (1,0) [0|1023] "NA"  ADU
 SG_ TSR_Relevancy_3 : 229|5@1+ (1,0) [0|13] "ENUM"  ADU
 SG_ TSR_Filter_Type_3 : 234|4@1+ (1,0) [0|7] "ENUM"  ADU
 SG_ TSR_Sup1_SignName_3 : 238|8@1+ (1,0) [0|255] "NA"  ADU
 SG_ TSR_Sup1_Confidence_3 : 246|7@1+ (0.01,0) [0|1] "NA"  ADU
 SG_ TSR_Sup1_Position_3 : 253|3@1+ (1,0) [0|4] "ENUM"  ADU
 SG_ TSR_Sup2_SignName_3 : 256|8@1+ (1,0) [0|255] "NA"  ADU
 SG_ TSR_Sup2_Confidence_3 : 264|7@1+ (0.01,0) [0|1] "NA"  ADU
 SG_ TSR_Sup2_Position_3 : 271|3@1+ (1,0) [0|4] "ENUM"  ADU
 SG_ TSR_Confidence_3 : 274|7@1+ (0.01,0) [0|1] "NA"  ADU
 SG_ TSR_Sign_Shape_3 : 281|4@1+ (1,0) [0|8] "ENUM"  ADU
 SG_ TSR_Sign_Structure_3 : 285|3@1+ (1,0) [0|3] "ENUM"  ADU
 SG_ TSR_Tracking_Age_3 : 288|10@1+ (1,0) [0|1000] "counter"  ADU
 SG_ TSR_Sign_Long_Distance_3 : 298|15@1+ (0.01,-50) [-50|200] "m"  ADU
 SG_ TSR_Sign_Long_Distance_STD_3 : 313|15@1+ (0.01,0) [0|200] "m"  ADU
 SG_ TSR_Sign_Lateral_Distance_3 : 328|13@1+ (0.01,-32) [-32|31] "m"  ADU
 SG_ TSR_Sign_Lat_Distance_STD_3 : 341|13@1+ (0.01,-32) [-32|31] "m"  ADU
 SG_ TSR_Sign_Height_3 : 354|15@1+ (0.01,-15) [-15|15] "m"  ADU
 SG_ TSR_Sign_Panel_Height_STD_3 : 369|10@1+ (0.01,0) [0|8] "m"  ADU
 SG_ TSR_Sign_Height_STD_3 : 379|15@1+ (0.01,-15) [-15|15] "m"  ADU
 SG_ TSR_Measurement_Status_3 : 394|3@1+ (1,0) [0|5] "ENUM"  ADU
 SG_ TSR_AngleZ_3 : 397|10@1+ (0.01,0) [0|3.14] "rad"  ADU
 SG_ TSR_Relevancy_Confidence_3 : 407|7@1+ (0.01,0) [0|1] "NA"  ADU

BO_ 344 Core_Traffic_Signs_protocol_2: 64 ADAS
 SG_ TSR_Sync_ID_2 : 0|8@1+ (1,0) [0|255] "counter"  ADU
 SG_ TSR_ID_4 : 8|8@1+ (1,0) [0|255] "counter"  ADU
 SG_ TSR_Sign_Name_4 : 16|10@1+ (1,0) [0|1023] "NA"  ADU
 SG_ TSR_Relevancy_4 : 26|5@1+ (1,0) [0|13] "ENUM"  ADU
 SG_ TSR_Filter_Type_4 : 31|4@1+ (1,0) [0|7] "ENUM"  ADU
 SG_ TSR_Sup1_SignName_4 : 35|8@1+ (1,0) [0|255] "NA"  ADU
 SG_ TSR_Sup1_Confidence_4 : 43|7@1+ (0.01,0) [0|1] "NA"  ADU
 SG_ TSR_Sup1_Position_4 : 50|3@1+ (1,0) [0|4] "ENUM"  ADU
 SG_ TSR_Sup2_SignName_4 : 53|8@1+ (1,0) [0|255] "NA"  ADU
 SG_ TSR_Sup2_Confidence_4 : 61|7@1+ (0.01,0) [0|1] "NA"  ADU
 SG_ TSR_Sup2_Position_4 : 68|3@1+ (1,0) [0|4] "ENUM"  ADU
 SG_ TSR_Confidence_4 : 71|7@1+ (0.01,0) [0|1] "NA"  ADU
 SG_ TSR_Sign_Shape_4 : 78|4@1+ (1,0) [0|8] "ENUM"  ADU
 SG_ TSR_Sign_Structure_4 : 82|3@1+ (1,0) [0|3] "ENUM"  ADU
 SG_ TSR_Tracking_Age_4 : 85|10@1+ (1,0) [0|1000] "counter"  ADU
 SG_ TSR_Sign_Long_Distance_4 : 95|15@1+ (0.01,-50) [-50|200] "m"  ADU
 SG_ TSR_Sign_Long_Distance_STD_4 : 110|15@1+ (0.01,0) [0|200] "m"  ADU
 SG_ TSR_Sign_Lateral_Distance_4 : 125|13@1+ (0.01,-32) [-32|31] "m"  ADU
 SG_ TSR_Sign_Lat_Distance_STD_4 : 138|13@1+ (0.01,-32) [-32|31] "m"  ADU
 SG_ TSR_Sign_Height_4 : 151|15@1+ (0.01,-15) [-15|15] "m"  ADU
 SG_ TSR_Sign_Panel_Height_STD_4 : 166|10@1+ (0.01,0) [0|8] "m"  ADU
 SG_ TSR_Sign_Height_STD_4 : 176|15@1+ (0.01,-15) [-15|15] "m"  ADU
 SG_ TSR_Measurement_Status_4 : 191|3@1+ (1,0) [0|5] "ENUM"  ADU
 SG_ TSR_AngleZ_4 : 194|10@1+ (0.01,0) [0|3.14] "rad"  ADU
 SG_ TSR_Relevancy_Confidence_4 : 204|7@1+ (0.01,0) [0|1] "NA"  ADU
 SG_ TSR_ID_5 : 211|8@1+ (1,0) [0|255] "counter"  ADU
 SG_ TSR_Sign_Name_5 : 219|10@1+ (1,0) [0|1023] "NA"  ADU
 SG_ TSR_Relevancy_5 : 229|5@1+ (1,0) [0|13] "ENUM"  ADU
 SG_ TSR_Filter_Type_5 : 234|4@1+ (1,0) [0|7] "ENUM"  ADU
 SG_ TSR_Sup1_SignName_5 : 238|8@1+ (1,0) [0|255] "NA"  ADU
 SG_ TSR_Sup1_Confidence_5 : 246|7@1+ (0.01,0) [0|1] "NA"  ADU
 SG_ TSR_Sup1_Position_5 : 253|3@1+ (1,0) [0|4] "ENUM"  ADU
 SG_ TSR_Sup2_SignName_5 : 256|8@1+ (1,0) [0|255] "NA"  ADU
 SG_ TSR_Sup2_Confidence_5 : 264|7@1+ (0.01,0) [0|1] "NA"  ADU
 SG_ TSR_Sup2_Position_5 : 271|3@1+ (1,0) [0|4] "ENUM"  ADU
 SG_ TSR_Confidence_5 : 274|7@1+ (0.01,0) [0|1] "NA"  ADU
 SG_ TSR_Sign_Shape_5 : 281|4@1+ (1,0) [0|8] "ENUM"  ADU
 SG_ TSR_Sign_Structure_5 : 285|3@1+ (1,0) [0|3] "ENUM"  ADU
 SG_ TSR_Tracking_Age_5 : 288|10@1+ (1,0) [0|1000] "counter"  ADU
 SG_ TSR_Sign_Long_Distance_5 : 298|15@1+ (0.01,-50) [-50|200] "m"  ADU
 SG_ TSR_Sign_Long_Distance_STD_5 : 313|15@1+ (0.01,0) [0|200] "m"  ADU
 SG_ TSR_Sign_Lateral_Distance_5 : 328|13@1+ (0.01,-32) [-32|31] "m"  ADU
 SG_ TSR_Sign_Lat_Distance_STD_5 : 341|13@1+ (0.01,-32) [-32|31] "m"  ADU
 SG_ TSR_Sign_Height_5 : 354|15@1+ (0.01,-15) [-15|15] "m"  ADU
 SG_ TSR_Sign_Panel_Height_STD_5 : 369|10@1+ (0.01,0) [0|8] "m"  ADU
 SG_ TSR_Sign_Height_STD_5 : 379|15@1+ (0.01,-15) [-15|15] "m"  ADU
 SG_ TSR_Measurement_Status_5 : 394|3@1+ (1,0) [0|5] "ENUM"  ADU
 SG_ TSR_AngleZ_5 : 397|10@1+ (0.01,0) [0|3.14] "rad"  ADU
 SG_ TSR_Relevancy_Confidence_5 : 407|7@1+ (0.01,0) [0|1] "NA"  ADU

BO_ 345 Core_Traffic_Signs_protocol_3: 64 ADAS
 SG_ TSR_Sync_ID_3 : 0|8@1+ (1,0) [0|255] "counter"  ADU
 SG_ TSR_ID_6 : 8|8@1+ (1,0) [0|255] "counter"  ADU
 SG_ TSR_Sign_Name_6 : 16|10@1+ (1,0) [0|1023] "NA"  ADU
 SG_ TSR_Relevancy_6 : 26|5@1+ (1,0) [0|13] "ENUM"  ADU
 SG_ TSR_Filter_Type_6 : 31|4@1+ (1,0) [0|7] "ENUM"  ADU
 SG_ TSR_Sup1_SignName_6 : 35|8@1+ (1,0) [0|255] "NA"  ADU
 SG_ TSR_Sup1_Confidence_6 : 43|7@1+ (0.01,0) [0|1] "NA"  ADU
 SG_ TSR_Sup1_Position_6 : 50|3@1+ (1,0) [0|4] "ENUM"  ADU
 SG_ TSR_Sup2_SignName_6 : 53|8@1+ (1,0) [0|255] "NA"  ADU
 SG_ TSR_Sup2_Confidence_6 : 61|7@1+ (0.01,0) [0|1] "NA"  ADU
 SG_ TSR_Sup2_Position_6 : 68|3@1+ (1,0) [0|4] "ENUM"  ADU
 SG_ TSR_Confidence_6 : 71|7@1+ (0.01,0) [0|1] "NA"  ADU
 SG_ TSR_Sign_Shape_6 : 78|4@1+ (1,0) [0|8] "ENUM"  ADU
 SG_ TSR_Sign_Structure_6 : 82|3@1+ (1,0) [0|3] "ENUM"  ADU
 SG_ TSR_Tracking_Age_6 : 85|10@1+ (1,0) [0|1000] "counter"  ADU
 SG_ TSR_Sign_Long_Distance_6 : 95|15@1+ (0.01,-50) [-50|200] "m"  ADU
 SG_ TSR_Sign_Long_Distance_STD_6 : 110|15@1+ (0.01,0) [0|200] "m"  ADU
 SG_ TSR_Sign_Lateral_Distance_6 : 125|13@1+ (0.01,-32) [-32|31] "m"  ADU
 SG_ TSR_Sign_Lat_Distance_STD_6 : 138|13@1+ (0.01,-32) [-32|31] "m"  ADU
 SG_ TSR_Sign_Height_6 : 151|15@1+ (0.01,-15) [-15|15] "m"  ADU
 SG_ TSR_Sign_Panel_Height_STD_6 : 166|10@1+ (0.01,0) [0|8] "m"  ADU
 SG_ TSR_Sign_Height_STD_6 : 176|15@1+ (0.01,-15) [-15|15] "m"  ADU
 SG_ TSR_Measurement_Status_6 : 191|3@1+ (1,0) [0|5] "ENUM"  ADU
 SG_ TSR_AngleZ_6 : 194|10@1+ (0.01,0) [0|3.14] "rad"  ADU
 SG_ TSR_Relevancy_Confidence_6 : 204|7@1+ (0.01,0) [0|1] "NA"  ADU
 SG_ TSR_ID_7 : 211|8@1+ (1,0) [0|255] "counter"  ADU
 SG_ TSR_Sign_Name_7 : 219|10@1+ (1,0) [0|1023] "NA"  ADU
 SG_ TSR_Relevancy_7 : 229|5@1+ (1,0) [0|13] "ENUM"  ADU
 SG_ TSR_Filter_Type_7 : 234|4@1+ (1,0) [0|7] "ENUM"  ADU
 SG_ TSR_Sup1_SignName_7 : 238|8@1+ (1,0) [0|255] "NA"  ADU
 SG_ TSR_Sup1_Confidence_7 : 246|7@1+ (0.01,0) [0|1] "NA"  ADU
 SG_ TSR_Sup1_Position_7 : 253|3@1+ (1,0) [0|4] "ENUM"  ADU
 SG_ TSR_Sup2_SignName_7 : 256|8@1+ (1,0) [0|255] "NA"  ADU
 SG_ TSR_Sup2_Confidence_7 : 264|7@1+ (0.01,0) [0|1] "NA"  ADU
 SG_ TSR_Sup2_Position_7 : 271|3@1+ (1,0) [0|4] "ENUM"  ADU
 SG_ TSR_Confidence_7 : 274|7@1+ (0.01,0) [0|1] "NA"  ADU
 SG_ TSR_Sign_Shape_7 : 281|4@1+ (1,0) [0|8] "ENUM"  ADU
 SG_ TSR_Sign_Structure_7 : 285|3@1+ (1,0) [0|3] "ENUM"  ADU
 SG_ TSR_Tracking_Age_7 : 288|10@1+ (1,0) [0|1000] "counter"  ADU
 SG_ TSR_Sign_Long_Distance_7 : 298|15@1+ (0.01,-50) [-50|200] "m"  ADU
 SG_ TSR_Sign_Long_Distance_STD_7 : 313|15@1+ (0.01,0) [0|200] "m"  ADU
 SG_ TSR_Sign_Lateral_Distance_7 : 328|13@1+ (0.01,-32) [-32|31] "m"  ADU
 SG_ TSR_Sign_Lat_Distance_STD_7 : 341|13@1+ (0.01,-32) [-32|31] "m"  ADU
 SG_ TSR_Sign_Height_7 : 354|15@1+ (0.01,-15) [-15|15] "m"  ADU
 SG_ TSR_Sign_Panel_Height_STD_7 : 369|10@1+ (0.01,0) [0|8] "m"  ADU
 SG_ TSR_Sign_Height_STD_7 : 379|15@1+ (0.01,-15) [-15|15] "m"  ADU
 SG_ TSR_Measurement_Status_7 : 394|3@1+ (1,0) [0|5] "ENUM"  ADU
 SG_ TSR_AngleZ_7 : 397|10@1+ (0.01,0) [0|3.14] "rad"  ADU
 SG_ TSR_Relevancy_Confidence_7 : 407|7@1+ (0.01,0) [0|1] "NA"  ADU

BO_ 400 Core_Objects_protocol_Header: 16 ADAS
 SG_ OBJ_Header_CRC : 0|32@1+ (1,0) [0|4294970000] "NA"  ADU
 SG_ OBJ_Protocol_Version : 32|8@1+ (1,0) [12|12] "counter"  ADU
 SG_ OBJ_Sync_ID : 40|8@1+ (1,0) [0|255] "counter"  ADU
 SG_ OBJ_VRU_Count : 48|5@1+ (1,0) [0|20] "counter"  ADU
 SG_ OBJ_VD_Count : 53|5@1+ (1,0) [0|20] "counter"  ADU
 SG_ OBJ_General_OBJ_Count : 58|4@1+ (1,0) [0|10] "counter"  ADU
 SG_ OBJ_VD_NIV_Left : 62|8@1+ (1,0) [0|255] "ID"  ADU
 SG_ OBJ_Animal_Count : 70|4@1+ (1,0) [0|10] "counter"  ADU
 SG_ OBJ_VD_NIV_Right : 74|8@1+ (1,0) [0|255] "ID"  ADU
 SG_ OBJ_VD_CIPV_ID : 82|8@1+ (1,0) [0|255] "ID"  ADU
 SG_ OBJ_VD_CIPV_Lost : 90|2@1+ (1,0) [0|2] "ENUM"  ADU
 SG_ OBJ_VD_Allow_Acc : 92|2@1+ (1,0) [0|2] "ENUM"  ADU
 SG_ OBJ_Is_Blocked_Left : 94|1@1+ (1,0) [0|1] "bool"  ADU
 SG_ OBJ_Is_Blocked_Right : 95|1@1+ (1,0) [0|1] "bool"  ADU

BO_ 401 Core_Objects_protocol_0_0: 48 ADAS
 SG_ OBJ_Sync_ID_0_0 : 0|8@1+ (1,0) [0|255] "counter"  ADU
 SG_ OBJ_CRC_0 : 8|32@1+ (1,0) [0|4294970000] "NA"  ADU
 SG_ OBJ_ID_0 : 40|8@1+ (1,0) [0|255] "counter"  ADU
 SG_ OBJ_Existence_Probability_0 : 48|8@1+ (0.01,0) [0|1] "NA"  ADU
 SG_ OBJ_Motion_Category_0 : 56|4@1+ (1,0) [0|13] "ENUM"  ADU
 SG_ OBJ_Object_Age_0 : 60|11@1+ (1,0) [0|2047] "frames"  ADU
 SG_ OBJ_Measuring_Status_0 : 71|3@1+ (1,0) [0|7] "BITWIZE"  ADU
 SG_ OBJ_Object_Class_0 : 74|4@1+ (1,0) [0|8] "ENUM"  ADU
 SG_ OBJ_Class_Probability_0 : 78|7@1+ (0.01,0) [0|1] "NA"  ADU
 SG_ OBJ_Motion_Status_0 : 85|3@1+ (1,0) [0|5] "ENUM"  ADU
 SG_ OBJ_Motion_Orientation_0 : 88|4@1+ (1,0) [0|13] "ENUM"  ADU
 SG_ OBJ_Has_Cut_Lane_0 : 92|1@1+ (1,0) [0|1] "bool"  ADU
 SG_ OBJ_Has_Cut_Path_0 : 93|1@1+ (1,0) [0|1] "bool"  ADU
 SG_ OBJ_Brake_Light_0 : 94|1@1+ (1,0) [0|1] "bool"  ADU
 SG_ OBJ_Turn_Indicator_Right_0 : 95|1@1+ (1,0) [0|1] "bool"  ADU
 SG_ OBJ_Turn_Indicator_Left_0 : 96|1@1+ (1,0) [0|1] "bool"  ADU
 SG_ OBJ_Light_Indicator_Validity_0 : 97|1@1+ (1,0) [0|1] "bool"  ADU
 SG_ OBJ_Right_Out_Of_Image_0 : 98|1@1+ (1,0) [0|1] "bool"  ADU
 SG_ OBJ_Left_Out_Of_Image_0 : 99|1@1+ (1,0) [0|1] "bool"  ADU
 SG_ OBJ_Right_Out_Of_Image_V_0 : 100|1@1+ (1,0) [0|1] "bool"  ADU
 SG_ OBJ_Left_Out_Of_Image_V_0 : 101|1@1+ (1,0) [0|1] "bool"  ADU
 SG_ OBJ_Top_Out_Of_Image_0 : 102|1@1+ (1,0) [0|1] "bool"  ADU
 SG_ OBJ_Bottom_Out_Of_Image_0 : 103|1@1+ (1,0) [0|1] "bool"  ADU
 SG_ OBJ_Top_Out_Of_Image_V_0 : 104|1@1+ (1,0) [0|1] "bool"  ADU
 SG_ OBJ_Bottom_Out_Of_Image_V_0 : 105|1@1+ (1,0) [0|1] "bool"  ADU
 SG_ OBJ_Lane_Assignment_0 : 106|3@1+ (1,0) [0|5] "ENUM"  ADU
 SG_ OBJ_Lane_Assignment_V_0 : 109|1@1+ (1,0) [0|1] "bool"  ADU
 SG_ OBJ_Age_Seconds_0 : 110|7@1+ (1,0) [0|100] "s"  ADU
 SG_ OBJ_Age_Seconds_V_0 : 117|1@1+ (1,0) [0|1] "bool"  ADU
 SG_ OBJ_Width_0 : 118|9@1+ (0.01,0) [0.4|2.95] "m"  ADU
 SG_ OBJ_Width_V_0 : 127|1@1+ (1,0) [0|1] "bool"  ADU
 SG_ OBJ_Width_STD_0 : 128|11@1+ (0.001,0) [0|2] "m"  ADU
 SG_ OBJ_Width_STD_V_0 : 139|1@1+ (1,0) [0|1] "bool"  ADU
 SG_ OBJ_Length_0 : 140|9@1+ (0.05,0) [1.2|21] "m"  ADU
 SG_ OBJ_Length_V_0 : 149|1@1+ (1,0) [0|1] "bool"  ADU
 SG_ OBJ_Length_STD_0 : 150|10@1+ (0.01,0) [0|10] "m"  ADU
 SG_ OBJ_Length_STD_V_0 : 160|1@1+ (1,0) [0|1] "bool"  ADU
 SG_ OBJ_Height_0 : 161|9@1+ (0.01,0) [0|2.95] "m"  ADU
 SG_ OBJ_Height_V_0 : 170|1@1+ (1,0) [0|1] "bool"  ADU
 SG_ OBJ_Height_STD_0 : 171|11@1+ (0.001,0) [0|2] "m"  ADU
 SG_ OBJ_Height_STD_V_0 : 182|1@1+ (1,0) [0|1] "bool"  ADU
 SG_ OBJ_Abs_Long_Velocity_0 : 183|12@1+ (0.05,-100) [-100|100] "m_per_s"  ADU
 SG_ OBJ_Abs_Long_Velocity_V_0 : 195|1@1+ (1,0) [0|1] "bool"  ADU
 SG_ OBJ_Abs_Long_Velocity_STD_0 : 196|13@1+ (0.01,0) [0|65] "m_per_s"  ADU
 SG_ OBJ_Abs_Long_Vel_STD_V_0 : 209|1@1+ (1,0) [0|1] "bool"  ADU
 SG_ OBJ_Abs_Lat_Velocity_0 : 210|11@1+ (0.05,-50) [-50|50] "m_per_s"  ADU
 SG_ OBJ_Abs_Lat_Velocity_V_0 : 221|1@1+ (1,0) [0|1] "bool"  ADU
 SG_ OBJ_Abs_Lat_Velocity_STD_0 : 222|13@1+ (0.01,0) [0|50] "m_per_s"  ADU
 SG_ OBJ_Abs_Lat_Vel_STD_V_0 : 235|1@1+ (1,0) [0|1] "bool"  ADU
 SG_ OBJ_Abs_Long_Acc_0 : 236|9@1+ (0.05,-10) [-10|10] "m_per_s2"  ADU
 SG_ OBJ_Abs_Long_Acc_V_0 : 245|1@1+ (1,0) [0|1] "bool"  ADU
 SG_ OBJ_Abs_Long_Acc_STD_0 : 246|10@1+ (0.01,0) [0|7.3] "m_per_s2"  ADU
 SG_ OBJ_Abs_Long_Acc_STD_V_0 : 256|1@1+ (1,0) [0|1] "bool"  ADU
 SG_ OBJ_Abs_Lat_Acc_0 : 257|9@1+ (0.05,-10.3) [-10.3|7.3] "m_per_s2"  ADU
 SG_ OBJ_Abs_Lat_Acc_V_0 : 266|1@1+ (1,0) [0|1] "bool"  ADU
 SG_ OBJ_Abs_Lat_Acc_STD_0 : 267|10@1+ (0.01,0) [0|7.3] "m_per_s2"  ADU
 SG_ OBJ_Abs_Lat_Acc_STD_V_0 : 277|1@1+ (1,0) [0|1] "bool"  ADU
 SG_ OBJ_Abs_Acceleration_0 : 278|9@1+ (0.05,-10.3) [-10.3|7.3] "m_per_s2"  ADU
 SG_ OBJ_Abs_Acceleration_V_0 : 287|1@1+ (1,0) [0|1] "bool"  ADU
 SG_ OBJ_Abs_Acc_STD_0 : 288|10@1+ (0.01,0) [0|7.3] "m_per_s2"  ADU
 SG_ OBJ_Abs_Acc_STD_V_0 : 298|1@1+ (1,0) [0|1] "bool"  ADU
 SG_ OBJ_Inv_TTC_0 : 299|11@1+ (0.01,-8) [-8|8] "INV(s)"  ADU
 SG_ OBJ_Inv_TTC_V_0 : 310|1@1+ (1,0) [0|1] "bool"  ADU
 SG_ OBJ_Inv_TTC_STD_0 : 311|12@1+ (0.001,0) [0|4] "INV(s)"  ADU
 SG_ OBJ_Inv_TTC_STD_V_0 : 323|1@1+ (1,0) [0|1] "bool"  ADU
 SG_ OBJ_Relative_Long_Acc_0 : 324|10@1+ (0.05,-20) [-20|20] "m_per_s2"  ADU
 SG_ OBJ_Relative_Long_Acc_V_0 : 334|1@1+ (1,0) [0|1] "bool"  ADU
 SG_ OBJ_Relative_Long_Acc_STD_0 : 335|10@1+ (0.01,0) [0|7.3] "m_per_s2"  ADU
 SG_ OBJ_Rel_Long_Acc_STD_V_0 : 345|1@1+ (1,0) [0|1] "bool"  ADU
 SG_ OBJ_Relative_Long_Velocity_0 : 346|13@1+ (0.05,-120) [-120|130] "m_per_s"  ADU
 SG_ OBJ_Relative_Long_Velocity_V_0 : 359|1@1+ (1,0) [0|1] "bool"  ADU
 SG_ OBJ_Relative_Long_Vel_STD_0 : 360|14@1+ (0.01,0) [0|130] "m_per_s"  ADU
 SG_ OBJ_Rel_Long_Vel_STD_V_0 : 374|1@1+ (1,0) [0|1] "bool"  ADU

BO_ 402 Core_Objects_protocol_0_1: 48 ADAS
 SG_ OBJ_Sync_ID_0_1 : 0|8@1+ (1,0) [0|255] "counter"  ADU
 SG_ OBJ_Relative_Lat_Velocity_0 : 8|11@1+ (0.05,-50) [-50|50] "m_per_s"  ADU
 SG_ OBJ_Relative_Lat_Velocity_V_0 : 19|1@1+ (1,0) [0|1] "bool"  ADU
 SG_ OBJ_Relative_Lat_Velocity_STD_0 : 20|13@1+ (0.01,0) [0|50] "m_per_s"  ADU
 SG_ OBJ_Rel_Lat_Vel_STD_V_0 : 33|1@1+ (1,0) [0|1] "bool"  ADU
 SG_ OBJ_Long_Distance_0 : 34|14@1+ (0.05,-200) [-200|500] "m"  ADU
 SG_ OBJ_Long_Distance_V_0 : 48|1@1+ (1,0) [0|1] "bool"  ADU
 SG_ OBJ_Long_Distance_STD_0 : 49|15@1+ (0.01,0) [0|250] "m"  ADU
 SG_ OBJ_Long_Distance_STD_V_0 : 64|1@1+ (1,0) [0|1] "bool"  ADU
 SG_ OBJ_Lat_Distance_0 : 65|12@1+ (0.05,-100) [-100|100] "m"  ADU
 SG_ OBJ_Lat_Distance_V_0 : 77|1@1+ (1,0) [0|1] "bool"  ADU
 SG_ OBJ_Lat_Distance_STD_0 : 78|14@1+ (0.01,0) [0|100] "m"  ADU
 SG_ OBJ_Lat_Distance_STD_V_0 : 92|1@1+ (1,0) [0|1] "bool"  ADU
 SG_ OBJ_Absolute_Speed_0 : 93|12@1+ (0.05,-65) [-65|65] "m_per_s"  ADU
 SG_ OBJ_Absolute_Speed_V_0 : 105|1@1+ (1,0) [0|1] "bool"  ADU
 SG_ OBJ_Absolute_Speed_STD_0 : 106|13@1+ (0.01,0) [0|65] "m_per_s"  ADU
 SG_ OBJ_Absolute_Speed_STD_V_0 : 119|1@1+ (1,0) [0|1] "bool"  ADU
 SG_ OBJ_Heading_0 : 120|10@1+ (0.01,-3.14) [-3.14|3.14] "rad"  ADU
 SG_ OBJ_Heading_V_0 : 130|1@1+ (1,0) [0|1] "bool"  ADU
 SG_ OBJ_Heading_STD_0 : 131|15@1+ (0.0001,0) [0|3.14] "rad"  ADU
 SG_ OBJ_Heading_STD_V_0 : 146|1@1+ (1,0) [0|1] "bool"  ADU
 SG_ OBJ_Angle_Rate_STD_0 : 147|15@1+ (0.0001,0) [0|2.2318] "RPS"  ADU
 SG_ OBJ_Angle_Rate_STD_V_0 : 162|1@1+ (1,0) [0|1] "bool"  ADU
 SG_ OBJ_Angle_Rate_0 : 163|12@1+ (0.002,-2.234) [-2.234|2.2318] "RPS"  ADU
 SG_ OBJ_Angle_Rate_V_0 : 175|1@1+ (1,0) [0|1] "bool"  ADU
 SG_ OBJ_Angle_Right_0 : 176|14@1+ (0.0002,-1.571) [-1.571|1.571] "rad"  ADU
 SG_ OBJ_Angle_Right_V_0 : 190|1@1+ (1,0) [0|1] "bool"  ADU
 SG_ OBJ_Angle_Right_STD_0 : 191|14@1+ (0.0001,0) [0|1.571] "rad"  ADU
 SG_ OBJ_Angle_Right_STD_V_0 : 205|1@1+ (1,0) [0|1] "bool"  ADU
 SG_ OBJ_Angle_Left_0 : 206|14@1+ (0.0002,-1.571) [-1.571|1.571] "rad"  ADU
 SG_ OBJ_Angle_Left_V_0 : 220|1@1+ (1,0) [0|1] "bool"  ADU
 SG_ OBJ_Angle_Left_STD_0 : 221|14@1+ (0.0001,0) [0|1.571] "rad"  ADU
 SG_ OBJ_Angle_Left_STD_V_0 : 235|1@1+ (1,0) [0|1] "bool"  ADU
 SG_ OBJ_Angle_Side_0 : 236|14@1+ (0.0002,-1.571) [-1.571|1.571] "rad"  ADU
 SG_ OBJ_Angle_Side_V_0 : 250|1@1+ (1,0) [0|1] "bool"  ADU
 SG_ OBJ_Angle_Side_STD_0 : 251|14@1+ (0.0001,0) [0|1.571] "rad"  ADU
 SG_ OBJ_Angle_Side_STD_V_0 : 265|1@1+ (1,0) [0|1] "bool"  ADU
 SG_ OBJ_Angle_Mid_V_0 : 266|1@1+ (1,0) [0|1] "bool"  ADU
 SG_ OBJ_Angle_Mid_0 : 267|14@1+ (0.0002,-1.571) [-1.571|1.571] "rad"  ADU
 SG_ OBJ_Angle_Mid_STD_0 : 281|14@1+ (0.0001,0) [0|1.571] "rad"  ADU
 SG_ OBJ_Angle_Mid_STD_V_0 : 295|1@1+ (1,0) [0|1] "bool"  ADU
 SG_ OBJ_Angle_Bottom_V_0 : 296|1@1+ (1,0) [0|1] "bool"  ADU
 SG_ OBJ_Angle_Bottom_0 : 297|14@1+ (0.0002,-1.571) [-1.571|1.571] "rad"  ADU
 SG_ OBJ_Angle_Bottom_STD_0 : 311|14@1+ (0.0001,0) [0|1.571] "rad"  ADU
 SG_ OBJ_Angle_Bottom_STD_V_0 : 325|1@1+ (1,0) [0|1] "bool"  ADU
 SG_ OBJ_Visibility_Side_V_0 : 326|1@1+ (1,0) [0|1] "bool"  ADU
 SG_ OBJ_Visibility_Side_0 : 327|2@1+ (1,0) [0|2] "ENUM"  ADU
 SG_ OBJ_Is_In_Drivable_Area_0 : 329|1@1+ (1,0) [0|1] "bool"  ADU
 SG_ OBJ_Is_In_Drivable_Area_V_0 : 330|1@1+ (1,0) [0|1] "bool"  ADU
 SG_ OBJ_Is_VeryClose_V_0 : 331|1@1+ (1,0) [0|1] "bool"  ADU
 SG_ OBJ_Is_VeryClose_0 : 332|1@1+ (1,0) [0|1] "bool"  ADU
 SG_ OBJ_Is_EMERGENCY_VCL_0 : 333|1@1+ (1,0) [0|1] "bool"  ADU
 SG_ OBJ_EMERGENCY_LIGHT_COLOR_0 : 334|4@1+ (1,0) [0|15] "BITWIZE"  ADU
 SG_ OBJ_EMERGENCY_V_0 : 338|1@1+ (1,0) [0|1] "bool"  ADU

BO_ 403 Core_Objects_protocol_1_0: 48 ADAS
 SG_ OBJ_Sync_ID_1_0 : 0|8@1+ (1,0) [0|255] "counter"  ADU
 SG_ OBJ_CRC_1 : 8|32@1+ (1,0) [0|4294970000] "NA"  ADU
 SG_ OBJ_ID_1 : 40|8@1+ (1,0) [0|255] "counter"  ADU
 SG_ OBJ_Existence_Probability_1 : 48|8@1+ (0.01,0) [0|1] "NA"  ADU
 SG_ OBJ_Motion_Category_1 : 56|4@1+ (1,0) [0|13] "ENUM"  ADU
 SG_ OBJ_Object_Age_1 : 60|11@1+ (1,0) [0|2047] "frames"  ADU
 SG_ OBJ_Measuring_Status_1 : 71|3@1+ (1,0) [0|7] "BITWIZE"  ADU
 SG_ OBJ_Object_Class_1 : 74|4@1+ (1,0) [0|8] "ENUM"  ADU
 SG_ OBJ_Class_Probability_1 : 78|7@1+ (0.01,0) [0|1] "NA"  ADU
 SG_ OBJ_Motion_Status_1 : 85|3@1+ (1,0) [0|5] "ENUM"  ADU
 SG_ OBJ_Motion_Orientation_1 : 88|4@1+ (1,0) [0|13] "ENUM"  ADU
 SG_ OBJ_Has_Cut_Lane_1 : 92|1@1+ (1,0) [0|1] "bool"  ADU
 SG_ OBJ_Has_Cut_Path_1 : 93|1@1+ (1,0) [0|1] "bool"  ADU
 SG_ OBJ_Brake_Light_1 : 94|1@1+ (1,0) [0|1] "bool"  ADU
 SG_ OBJ_Turn_Indicator_Right_1 : 95|1@1+ (1,0) [0|1] "bool"  ADU
 SG_ OBJ_Turn_Indicator_Left_1 : 96|1@1+ (1,0) [0|1] "bool"  ADU
 SG_ OBJ_Light_Indicator_Validity_1 : 97|1@1+ (1,0) [0|1] "bool"  ADU
 SG_ OBJ_Right_Out_Of_Image_1 : 98|1@1+ (1,0) [0|1] "bool"  ADU
 SG_ OBJ_Left_Out_Of_Image_1 : 99|1@1+ (1,0) [0|1] "bool"  ADU
 SG_ OBJ_Right_Out_Of_Image_V_1 : 100|1@1+ (1,0) [0|1] "bool"  ADU
 SG_ OBJ_Left_Out_Of_Image_V_1 : 101|1@1+ (1,0) [0|1] "bool"  ADU
 SG_ OBJ_Top_Out_Of_Image_1 : 102|1@1+ (1,0) [0|1] "bool"  ADU
 SG_ OBJ_Bottom_Out_Of_Image_1 : 103|1@1+ (1,0) [0|1] "bool"  ADU
 SG_ OBJ_Top_Out_Of_Image_V_1 : 104|1@1+ (1,0) [0|1] "bool"  ADU
 SG_ OBJ_Bottom_Out_Of_Image_V_1 : 105|1@1+ (1,0) [0|1] "bool"  ADU
 SG_ OBJ_Lane_Assignment_1 : 106|3@1+ (1,0) [0|5] "ENUM"  ADU
 SG_ OBJ_Lane_Assignment_V_1 : 109|1@1+ (1,0) [0|1] "bool"  ADU
 SG_ OBJ_Age_Seconds_1 : 110|7@1+ (1,0) [0|100] "s"  ADU
 SG_ OBJ_Age_Seconds_V_1 : 117|1@1+ (1,0) [0|1] "bool"  ADU
 SG_ OBJ_Width_1 : 118|9@1+ (0.01,0) [0.4|2.95] "m"  ADU
 SG_ OBJ_Width_V_1 : 127|1@1+ (1,0) [0|1] "bool"  ADU
 SG_ OBJ_Width_STD_1 : 128|11@1+ (0.001,0) [0|2] "m"  ADU
 SG_ OBJ_Width_STD_V_1 : 139|1@1+ (1,0) [0|1] "bool"  ADU
 SG_ OBJ_Length_1 : 140|9@1+ (0.05,0) [1.2|21] "m"  ADU
 SG_ OBJ_Length_V_1 : 149|1@1+ (1,0) [0|1] "bool"  ADU
 SG_ OBJ_Length_STD_1 : 150|10@1+ (0.01,0) [0|10] "m"  ADU
 SG_ OBJ_Length_STD_V_1 : 160|1@1+ (1,0) [0|1] "bool"  ADU
 SG_ OBJ_Height_1 : 161|9@1+ (0.01,0) [0|2.95] "m"  ADU
 SG_ OBJ_Height_V_1 : 170|1@1+ (1,0) [0|1] "bool"  ADU
 SG_ OBJ_Height_STD_1 : 171|11@1+ (0.001,0) [0|2] "m"  ADU
 SG_ OBJ_Height_STD_V_1 : 182|1@1+ (1,0) [0|1] "bool"  ADU
 SG_ OBJ_Abs_Long_Velocity_1 : 183|12@1+ (0.05,-100) [-100|100] "m_per_s"  ADU
 SG_ OBJ_Abs_Long_Velocity_V_1 : 195|1@1+ (1,0) [0|1] "bool"  ADU
 SG_ OBJ_Abs_Long_Velocity_STD_1 : 196|13@1+ (0.01,0) [0|65] "m_per_s"  ADU
 SG_ OBJ_Abs_Long_Vel_STD_V_1 : 209|1@1+ (1,0) [0|1] "bool"  ADU
 SG_ OBJ_Abs_Lat_Velocity_1 : 210|11@1+ (0.05,-50) [-50|50] "m_per_s"  ADU
 SG_ OBJ_Abs_Lat_Velocity_V_1 : 221|1@1+ (1,0) [0|1] "bool"  ADU
 SG_ OBJ_Abs_Lat_Velocity_STD_1 : 222|13@1+ (0.01,0) [0|50] "m_per_s"  ADU
 SG_ OBJ_Abs_Lat_Vel_STD_V_1 : 235|1@1+ (1,0) [0|1] "bool"  ADU
 SG_ OBJ_Abs_Long_Acc_1 : 236|9@1+ (0.05,-10) [-10|10] "m_per_s2"  ADU
 SG_ OBJ_Abs_Long_Acc_V_1 : 245|1@1+ (1,0) [0|1] "bool"  ADU
 SG_ OBJ_Abs_Long_Acc_STD_1 : 246|10@1+ (0.01,0) [0|7.3] "m_per_s2"  ADU
 SG_ OBJ_Abs_Long_Acc_STD_V_1 : 256|1@1+ (1,0) [0|1] "bool"  ADU
 SG_ OBJ_Abs_Lat_Acc_1 : 257|9@1+ (0.05,-10.3) [-10.3|7.3] "m_per_s2"  ADU
 SG_ OBJ_Abs_Lat_Acc_V_1 : 266|1@1+ (1,0) [0|1] "bool"  ADU
 SG_ OBJ_Abs_Lat_Acc_STD_1 : 267|10@1+ (0.01,0) [0|7.3] "m_per_s2"  ADU
 SG_ OBJ_Abs_Lat_Acc_STD_V_1 : 277|1@1+ (1,0) [0|1] "bool"  ADU
 SG_ OBJ_Abs_Acceleration_1 : 278|9@1+ (0.05,-10.3) [-10.3|7.3] "m_per_s2"  ADU
 SG_ OBJ_Abs_Acceleration_V_1 : 287|1@1+ (1,0) [0|1] "bool"  ADU
 SG_ OBJ_Abs_Acc_STD_1 : 288|10@1+ (0.01,0) [0|7.3] "m_per_s2"  ADU
 SG_ OBJ_Abs_Acc_STD_V_1 : 298|1@1+ (1,0) [0|1] "bool"  ADU
 SG_ OBJ_Inv_TTC_1 : 299|11@1+ (0.01,-8) [-8|8] "INV(s)"  ADU
 SG_ OBJ_Inv_TTC_V_1 : 310|1@1+ (1,0) [0|1] "bool"  ADU
 SG_ OBJ_Inv_TTC_STD_1 : 311|12@1+ (0.001,0) [0|4] "INV(s)"  ADU
 SG_ OBJ_Inv_TTC_STD_V_1 : 323|1@1+ (1,0) [0|1] "bool"  ADU
 SG_ OBJ_Relative_Long_Acc_1 : 324|10@1+ (0.05,-20) [-20|20] "m_per_s2"  ADU
 SG_ OBJ_Relative_Long_Acc_V_1 : 334|1@1+ (1,0) [0|1] "bool"  ADU
 SG_ OBJ_Relative_Long_Acc_STD_1 : 335|10@1+ (0.01,0) [0|7.3] "m_per_s2"  ADU
 SG_ OBJ_Rel_Long_Acc_STD_V_1 : 345|1@1+ (1,0) [0|1] "bool"  ADU
 SG_ OBJ_Relative_Long_Velocity_1 : 346|13@1+ (0.05,-120) [-120|130] "m_per_s"  ADU
 SG_ OBJ_Relative_Long_Velocity_V_1 : 359|1@1+ (1,0) [0|1] "bool"  ADU
 SG_ OBJ_Relative_Long_Vel_STD_1 : 360|14@1+ (0.01,0) [0|130] "m_per_s"  ADU
 SG_ OBJ_Rel_Long_Vel_STD_V_1 : 374|1@1+ (1,0) [0|1] "bool"  ADU

BO_ 404 Core_Objects_protocol_1_1: 48 ADAS
 SG_ OBJ_Sync_ID_1_1 : 0|8@1+ (1,0) [0|255] "counter"  ADU
 SG_ OBJ_Relative_Lat_Velocity_1 : 8|11@1+ (0.05,-50) [-50|50] "m_per_s"  ADU
 SG_ OBJ_Relative_Lat_Velocity_V_1 : 19|1@1+ (1,0) [0|1] "bool"  ADU
 SG_ OBJ_Relative_Lat_Velocity_STD_1 : 20|13@1+ (0.01,0) [0|50] "m_per_s"  ADU
 SG_ OBJ_Rel_Lat_Vel_STD_V_1 : 33|1@1+ (1,0) [0|1] "bool"  ADU
 SG_ OBJ_Long_Distance_1 : 34|14@1+ (0.05,-200) [-200|500] "m"  ADU
 SG_ OBJ_Long_Distance_V_1 : 48|1@1+ (1,0) [0|1] "bool"  ADU
 SG_ OBJ_Long_Distance_STD_1 : 49|15@1+ (0.01,0) [0|250] "m"  ADU
 SG_ OBJ_Long_Distance_STD_V_1 : 64|1@1+ (1,0) [0|1] "bool"  ADU
 SG_ OBJ_Lat_Distance_1 : 65|12@1+ (0.05,-100) [-100|100] "m"  ADU
 SG_ OBJ_Lat_Distance_V_1 : 77|1@1+ (1,0) [0|1] "bool"  ADU
 SG_ OBJ_Lat_Distance_STD_1 : 78|14@1+ (0.01,0) [0|100] "m"  ADU
 SG_ OBJ_Lat_Distance_STD_V_1 : 92|1@1+ (1,0) [0|1] "bool"  ADU
 SG_ OBJ_Absolute_Speed_1 : 93|12@1+ (0.05,-65) [-65|65] "m_per_s"  ADU
 SG_ OBJ_Absolute_Speed_V_1 : 105|1@1+ (1,0) [0|1] "bool"  ADU
 SG_ OBJ_Absolute_Speed_STD_1 : 106|13@1+ (0.01,0) [0|65] "m_per_s"  ADU
 SG_ OBJ_Absolute_Speed_STD_V_1 : 119|1@1+ (1,0) [0|1] "bool"  ADU
 SG_ OBJ_Heading_1 : 120|10@1+ (0.01,-3.14) [-3.14|3.14] "rad"  ADU
 SG_ OBJ_Heading_V_1 : 130|1@1+ (1,0) [0|1] "bool"  ADU
 SG_ OBJ_Heading_STD_1 : 131|15@1+ (0.0001,0) [0|3.14] "rad"  ADU
 SG_ OBJ_Heading_STD_V_1 : 146|1@1+ (1,0) [0|1] "bool"  ADU
 SG_ OBJ_Angle_Rate_STD_1 : 147|15@1+ (0.0001,0) [0|2.2318] "RPS"  ADU
 SG_ OBJ_Angle_Rate_STD_V_1 : 162|1@1+ (1,0) [0|1] "bool"  ADU
 SG_ OBJ_Angle_Rate_1 : 163|12@1+ (0.002,-2.234) [-2.234|2.2318] "RPS"  ADU
 SG_ OBJ_Angle_Rate_V_1 : 175|1@1+ (1,0) [0|1] "bool"  ADU
 SG_ OBJ_Angle_Right_1 : 176|14@1+ (0.0002,-1.571) [-1.571|1.571] "rad"  ADU
 SG_ OBJ_Angle_Right_V_1 : 190|1@1+ (1,0) [0|1] "bool"  ADU
 SG_ OBJ_Angle_Right_STD_1 : 191|14@1+ (0.0001,0) [0|1.571] "rad"  ADU
 SG_ OBJ_Angle_Right_STD_V_1 : 205|1@1+ (1,0) [0|1] "bool"  ADU
 SG_ OBJ_Angle_Left_1 : 206|14@1+ (0.0002,-1.571) [-1.571|1.571] "rad"  ADU
 SG_ OBJ_Angle_Left_V_1 : 220|1@1+ (1,0) [0|1] "bool"  ADU
 SG_ OBJ_Angle_Left_STD_1 : 221|14@1+ (0.0001,0) [0|1.571] "rad"  ADU
 SG_ OBJ_Angle_Left_STD_V_1 : 235|1@1+ (1,0) [0|1] "bool"  ADU
 SG_ OBJ_Angle_Side_1 : 236|14@1+ (0.0002,-1.571) [-1.571|1.571] "rad"  ADU
 SG_ OBJ_Angle_Side_V_1 : 250|1@1+ (1,0) [0|1] "bool"  ADU
 SG_ OBJ_Angle_Side_STD_1 : 251|14@1+ (0.0001,0) [0|1.571] "rad"  ADU
 SG_ OBJ_Angle_Side_STD_V_1 : 265|1@1+ (1,0) [0|1] "bool"  ADU
 SG_ OBJ_Angle_Mid_V_1 : 266|1@1+ (1,0) [0|1] "bool"  ADU
 SG_ OBJ_Angle_Mid_1 : 267|14@1+ (0.0002,-1.571) [-1.571|1.571] "rad"  ADU
 SG_ OBJ_Angle_Mid_STD_1 : 281|14@1+ (0.0001,0) [0|1.571] "rad"  ADU
 SG_ OBJ_Angle_Mid_STD_V_1 : 295|1@1+ (1,0) [0|1] "bool"  ADU
 SG_ OBJ_Angle_Bottom_V_1 : 296|1@1+ (1,0) [0|1] "bool"  ADU
 SG_ OBJ_Angle_Bottom_1 : 297|14@1+ (0.0002,-1.571) [-1.571|1.571] "rad"  ADU
 SG_ OBJ_Angle_Bottom_STD_1 : 311|14@1+ (0.0001,0) [0|1.571] "rad"  ADU
 SG_ OBJ_Angle_Bottom_STD_V_1 : 325|1@1+ (1,0) [0|1] "bool"  ADU
 SG_ OBJ_Visibility_Side_V_1 : 326|1@1+ (1,0) [0|1] "bool"  ADU
 SG_ OBJ_Visibility_Side_1 : 327|2@1+ (1,0) [0|2] "ENUM"  ADU
 SG_ OBJ_Is_In_Drivable_Area_1 : 329|1@1+ (1,0) [0|1] "bool"  ADU
 SG_ OBJ_Is_In_Drivable_Area_V_1 : 330|1@1+ (1,0) [0|1] "bool"  ADU
 SG_ OBJ_Is_VeryClose_V_1 : 331|1@1+ (1,0) [0|1] "bool"  ADU
 SG_ OBJ_Is_VeryClose_1 : 332|1@1+ (1,0) [0|1] "bool"  ADU
 SG_ OBJ_Is_EMERGENCY_VCL_1 : 333|1@1+ (1,0) [0|1] "bool"  ADU
 SG_ OBJ_EMERGENCY_LIGHT_COLOR_1 : 334|4@1+ (1,0) [0|15] "BITWIZE"  ADU
 SG_ OBJ_EMERGENCY_V_1 : 338|1@1+ (1,0) [0|1] "bool"  ADU

BO_ 405 Core_Objects_protocol_2_0: 48 ADAS
 SG_ OBJ_Sync_ID_2_0 : 0|8@1+ (1,0) [0|255] "counter"  ADU
 SG_ OBJ_CRC_2 : 8|32@1+ (1,0) [0|4294970000] "NA"  ADU
 SG_ OBJ_ID_2 : 40|8@1+ (1,0) [0|255] "counter"  ADU
 SG_ OBJ_Existence_Probability_2 : 48|8@1+ (0.01,0) [0|1] "NA"  ADU
 SG_ OBJ_Motion_Category_2 : 56|4@1+ (1,0) [0|13] "ENUM"  ADU
 SG_ OBJ_Object_Age_2 : 60|11@1+ (1,0) [0|2047] "frames"  ADU
 SG_ OBJ_Measuring_Status_2 : 71|3@1+ (1,0) [0|7] "BITWIZE"  ADU
 SG_ OBJ_Object_Class_2 : 74|4@1+ (1,0) [0|8] "ENUM"  ADU
 SG_ OBJ_Class_Probability_2 : 78|7@1+ (0.01,0) [0|1] "NA"  ADU
 SG_ OBJ_Motion_Status_2 : 85|3@1+ (1,0) [0|5] "ENUM"  ADU
 SG_ OBJ_Motion_Orientation_2 : 88|4@1+ (1,0) [0|13] "ENUM"  ADU
 SG_ OBJ_Has_Cut_Lane_2 : 92|1@1+ (1,0) [0|1] "bool"  ADU
 SG_ OBJ_Has_Cut_Path_2 : 93|1@1+ (1,0) [0|1] "bool"  ADU
 SG_ OBJ_Brake_Light_2 : 94|1@1+ (1,0) [0|1] "bool"  ADU
 SG_ OBJ_Turn_Indicator_Right_2 : 95|1@1+ (1,0) [0|1] "bool"  ADU
 SG_ OBJ_Turn_Indicator_Left_2 : 96|1@1+ (1,0) [0|1] "bool"  ADU
 SG_ OBJ_Light_Indicator_Validity_2 : 97|1@1+ (1,0) [0|1] "bool"  ADU
 SG_ OBJ_Right_Out_Of_Image_2 : 98|1@1+ (1,0) [0|1] "bool"  ADU
 SG_ OBJ_Left_Out_Of_Image_2 : 99|1@1+ (1,0) [0|1] "bool"  ADU
 SG_ OBJ_Right_Out_Of_Image_V_2 : 100|1@1+ (1,0) [0|1] "bool"  ADU
 SG_ OBJ_Left_Out_Of_Image_V_2 : 101|1@1+ (1,0) [0|1] "bool"  ADU
 SG_ OBJ_Top_Out_Of_Image_2 : 102|1@1+ (1,0) [0|1] "bool"  ADU
 SG_ OBJ_Bottom_Out_Of_Image_2 : 103|1@1+ (1,0) [0|1] "bool"  ADU
 SG_ OBJ_Top_Out_Of_Image_V_2 : 104|1@1+ (1,0) [0|1] "bool"  ADU
 SG_ OBJ_Bottom_Out_Of_Image_V_2 : 105|1@1+ (1,0) [0|1] "bool"  ADU
 SG_ OBJ_Lane_Assignment_2 : 106|3@1+ (1,0) [0|5] "ENUM"  ADU
 SG_ OBJ_Lane_Assignment_V_2 : 109|1@1+ (1,0) [0|1] "bool"  ADU
 SG_ OBJ_Age_Seconds_2 : 110|7@1+ (1,0) [0|100] "s"  ADU
 SG_ OBJ_Age_Seconds_V_2 : 117|1@1+ (1,0) [0|1] "bool"  ADU
 SG_ OBJ_Width_2 : 118|9@1+ (0.01,0) [0.4|2.95] "m"  ADU
 SG_ OBJ_Width_V_2 : 127|1@1+ (1,0) [0|1] "bool"  ADU
 SG_ OBJ_Width_STD_2 : 128|11@1+ (0.001,0) [0|2] "m"  ADU
 SG_ OBJ_Width_STD_V_2 : 139|1@1+ (1,0) [0|1] "bool"  ADU
 SG_ OBJ_Length_2 : 140|9@1+ (0.05,0) [1.2|21] "m"  ADU
 SG_ OBJ_Length_V_2 : 149|1@1+ (1,0) [0|1] "bool"  ADU
 SG_ OBJ_Length_STD_2 : 150|10@1+ (0.01,0) [0|10] "m"  ADU
 SG_ OBJ_Length_STD_V_2 : 160|1@1+ (1,0) [0|1] "bool"  ADU
 SG_ OBJ_Height_2 : 161|9@1+ (0.01,0) [0|2.95] "m"  ADU
 SG_ OBJ_Height_V_2 : 170|1@1+ (1,0) [0|1] "bool"  ADU
 SG_ OBJ_Height_STD_2 : 171|11@1+ (0.001,0) [0|2] "m"  ADU
 SG_ OBJ_Height_STD_V_2 : 182|1@1+ (1,0) [0|1] "bool"  ADU
 SG_ OBJ_Abs_Long_Velocity_2 : 183|12@1+ (0.05,-100) [-100|100] "m_per_s"  ADU
 SG_ OBJ_Abs_Long_Velocity_V_2 : 195|1@1+ (1,0) [0|1] "bool"  ADU
 SG_ OBJ_Abs_Long_Velocity_STD_2 : 196|13@1+ (0.01,0) [0|65] "m_per_s"  ADU
 SG_ OBJ_Abs_Long_Vel_STD_V_2 : 209|1@1+ (1,0) [0|1] "bool"  ADU
 SG_ OBJ_Abs_Lat_Velocity_2 : 210|11@1+ (0.05,-50) [-50|50] "m_per_s"  ADU
 SG_ OBJ_Abs_Lat_Velocity_V_2 : 221|1@1+ (1,0) [0|1] "bool"  ADU
 SG_ OBJ_Abs_Lat_Velocity_STD_2 : 222|13@1+ (0.01,0) [0|50] "m_per_s"  ADU
 SG_ OBJ_Abs_Lat_Vel_STD_V_2 : 235|1@1+ (1,0) [0|1] "bool"  ADU
 SG_ OBJ_Abs_Long_Acc_2 : 236|9@1+ (0.05,-10) [-10|10] "m_per_s2"  ADU
 SG_ OBJ_Abs_Long_Acc_V_2 : 245|1@1+ (1,0) [0|1] "bool"  ADU
 SG_ OBJ_Abs_Long_Acc_STD_2 : 246|10@1+ (0.01,0) [0|7.3] "m_per_s2"  ADU
 SG_ OBJ_Abs_Long_Acc_STD_V_2 : 256|1@1+ (1,0) [0|1] "bool"  ADU
 SG_ OBJ_Abs_Lat_Acc_2 : 257|9@1+ (0.05,-10.3) [-10.3|7.3] "m_per_s2"  ADU
 SG_ OBJ_Abs_Lat_Acc_V_2 : 266|1@1+ (1,0) [0|1] "bool"  ADU
 SG_ OBJ_Abs_Lat_Acc_STD_2 : 267|10@1+ (0.01,0) [0|7.3] "m_per_s2"  ADU
 SG_ OBJ_Abs_Lat_Acc_STD_V_2 : 277|1@1+ (1,0) [0|1] "bool"  ADU
 SG_ OBJ_Abs_Acceleration_2 : 278|9@1+ (0.05,-10.3) [-10.3|7.3] "m_per_s2"  ADU
 SG_ OBJ_Abs_Acceleration_V_2 : 287|1@1+ (1,0) [0|1] "bool"  ADU
 SG_ OBJ_Abs_Acc_STD_2 : 288|10@1+ (0.01,0) [0|7.3] "m_per_s2"  ADU
 SG_ OBJ_Abs_Acc_STD_V_2 : 298|1@1+ (1,0) [0|1] "bool"  ADU
 SG_ OBJ_Inv_TTC_2 : 299|11@1+ (0.01,-8) [-8|8] "INV(s)"  ADU
 SG_ OBJ_Inv_TTC_V_2 : 310|1@1+ (1,0) [0|1] "bool"  ADU
 SG_ OBJ_Inv_TTC_STD_2 : 311|12@1+ (0.001,0) [0|4] "INV(s)"  ADU
 SG_ OBJ_Inv_TTC_STD_V_2 : 323|1@1+ (1,0) [0|1] "bool"  ADU
 SG_ OBJ_Relative_Long_Acc_2 : 324|10@1+ (0.05,-20) [-20|20] "m_per_s2"  ADU
 SG_ OBJ_Relative_Long_Acc_V_2 : 334|1@1+ (1,0) [0|1] "bool"  ADU
 SG_ OBJ_Relative_Long_Acc_STD_2 : 335|10@1+ (0.01,0) [0|7.3] "m_per_s2"  ADU
 SG_ OBJ_Rel_Long_Acc_STD_V_2 : 345|1@1+ (1,0) [0|1] "bool"  ADU
 SG_ OBJ_Relative_Long_Velocity_2 : 346|13@1+ (0.05,-120) [-120|130] "m_per_s"  ADU
 SG_ OBJ_Relative_Long_Velocity_V_2 : 359|1@1+ (1,0) [0|1] "bool"  ADU
 SG_ OBJ_Relative_Long_Vel_STD_2 : 360|14@1+ (0.01,0) [0|130] "m_per_s"  ADU
 SG_ OBJ_Rel_Long_Vel_STD_V_2 : 374|1@1+ (1,0) [0|1] "bool"  ADU

CM_ SG_ 513 feedback "MCU local clock timestamp at the moment clock sync occurred.";
CM_ SG_ 512 randomrequestcode "MCU local clock timestamp at the moment clock sync occurred.";
CM_ SG_ 434 CIN_Vehicle_Speed "Actual vehicle speed. In case the vehicle driving direction is backwards then use CIN_Reverse_Indicator signals to indicate the reverse direction.";
CM_ SG_ 434 CIN_Vehicle_Speed_Valid "Establishes validity of speed";
CM_ SG_ 434 CIN_Vehicle_Yaw "Positive on right turn";
CM_ SG_ 434 CIN_Vehicle_Yaw_Valid "Establishes validity of Yaw";
CM_ SG_ 434 CIN_Steering_Wheel_Angle "Angle of the steering wheel. Angle to the right is positive";
CM_ SG_ 434 CIN_Steering_Wheel_Angle_Valid "Establishes validity of steering wheel angle";
CM_ SG_ 434 CIN_MCU_Sync_Timestamp "MCU local clock timestamp at the moment clock sync occurred.";
CM_ SG_ 434 CIN_MCU_Sync_Timestamp_Valid "Establishes that the MCU is communicating to the EyeQ a timestamp related to a toggled GPIO pin";
CM_ SG_ 338 COM_CRC "Calculated over all header signals. From the signal after the CRC until the last signal in the message";
CM_ SG_ 338 COM_Protocol_Version "What version of this protocol we are up to";
CM_ SG_ 338 COM_Sync_Frame_ID "synchronizes between the messages in the same frame";
CM_ SG_ 338 COM_Frame_MCU_TS_Start "Timestamp of exposure start expressed in MCU time system";
CM_ SG_ 338 COM_Last_MCU_Sync_TS "Feedback of last clock sync timestamp that was sent to EyeQ from MCU";
CM_ SG_ 338 COM_Last_Clock_Sync_Skew "Skew between actual clock sync time that was sent to EyeQ and what EyeQ was expecting. If internal error exceeds signal limits, signal is clamped to its maximum.";
CM_ SG_ 338 COM_Last_Clock_Sync_Error "If Skew is larger than defined in configuration as error or data corruption was found this bit will be turned on to True";
CM_ SG_ 338 COM_EyeQ_Frame_ID "Index of the frame by frame processed number. Only images processed by algo are assigned a number hence the output will be sequential.";
CM_ SG_ 338 COM_Cam_Frame_ID "Actual grab index from camera. Not every image is processed by algo however. This may not be sequential as some are dropped. This is what the logger sees on the headers";
CM_ SG_ 338 COM_DayTime_Indicator "Check Enum Values";
CM_ SG_ 338 COM_Driving_Side_V "Validator set to false in case the signal is not available.";
CM_ SG_ 338 COM_Driving_Side "Indicates driving side.";
CM_ SG_ 338 COM_Is_HighSpeed_Road_V "Validator set to false in case the signal is not available.";
CM_ SG_ 338 COM_Is_HighSpeed_Road "TSR Responsibility: If detected, highway semantics and high driving speed signal will be set to true";
CM_ SG_ 338 Reserved_1 "Indicates in which FPS reporting cycle we are. The default mode is 36 FPS (0=REPORT_36) . When 9/18/36 FPS is enabled the signal will indicate (1=REPORT_9_18_36)";
CM_ SG_ 338 Reserved_2 "Indicate the protocol cycles of protocols in every frame. Reports all the output messages that can be reported in the frame, and not only the messages that are reported.";
CM_ SG_ 338 Reserved_3 "Indicate the protocol cycles of protocols in every frame. Reports all the output messages that can be reported in the frame, and not only the messages that are reported.";
CM_ SG_ 369 FS_Header_CRC "Calculated over all header signals. From the signal after the CRC until the first signal in the elements FS_CRC_0 not including";
CM_ SG_ 369 FS_Protocol_Version "Version number of failsafe message";
CM_ SG_ 369 FS_Sync_ID "The ID of the Sync message, used to synchronize between signals in the system. Every new frame promotes the sync ID by one.";
CM_ SG_ 369 FS_Cameras_Number "Number of FS available cameras";
CM_ SG_ 369 FS_TSR_Out_OF_Calib "Specific TSR Out-of-Calib Signal";
CM_ SG_ 369 FS_Out_Of_Calib "Vision detected that the calibration camera to world exceede level 0 40 px tollerance  from the baseline calibration (Auto Fix).";
CM_ SG_ 369 FS_Impacted_Technologies "Impacted technologies from detected fail safes according to the fail-safe ME schema";
CM_ SG_ 369 FS_Rain "Detection of precipitation.";
CM_ SG_ 369 FS_Fog "Detection of fog.";
CM_ SG_ 369 FS_Calibration_Misalignment "Road Model misalignment";
CM_ SG_ 369 FS_C2W_OOR "The Out Of Range (OOR) FS signal will indicate that the current Cam2World extrinsic calibration found exceeded the allowed system tolerance defined by the OEM using the min/max Yaw/Horizon and MaxRoll ranges definitions";
CM_ SG_ 369 FS_CRC_0 "Calculated over all element signals. From the signal after the CRC until the first signal in the next elements FS_CRC_N+1  not including";
CM_ SG_ 369 FS_Camera_ID_0 "The relevant camera.";
CM_ SG_ 369 FS_Free_Sight_0 "False until free sight is approved";
CM_ SG_ 369 FS_Splashes_0 "The lower edges of vehicles cannot be detected due to water spray, a.k.a. splashes.";
CM_ SG_ 369 FS_Sun_Ray_0 "Strong glare due to micro scratches on windshield.";
CM_ SG_ 369 FS_Low_Sun_0 "Sun glare which disrupts the image. The sun appears over the FOE.";
CM_ SG_ 369 FS_Blur_Image_0 "Issued when visibility on the image is lowered such that detection of objects inside the Danger Zone (in-path and next lanes up-to some level) cannot be fully performed";
CM_ SG_ 369 FS_Partial_Blockage_0 "Low visibility due to partially covered lens.";
CM_ SG_ 369 FS_Full_Blockage_0 "No visibility due to fully covered lens. Takes 50 frames with no edges. Recovery is very quick (max 50 frames). Will be on when standing at night with no headlights.";
CM_ SG_ 369 FS_Frozen_Windshield_Lens_0 "Significant failsafe indicating windshield is frozen. This will impact on all technologies.";
CM_ SG_ 369 FS_Out_Of_Focus_0 "Vision detected that the focus calibration is not correct.";
CM_ SG_ 369 FS_C2C_Out_Of_Calib_0 "Vision detected that  reported  camera to main  camera  calibration, can't be corrected (Auto Fix).";
CM_ SG_ 396 LA_Protocol_Version "Denotes protocol version";
CM_ SG_ 396 LA_Sync_ID_0 "Sync ID to be used to sync between signals in system";
CM_ SG_ 396 LA_Adjacent_Count "Maximum number of lines supported by this protocol";
CM_ SG_ 396 LA_Lane_Track_ID_0 "ID of the lane mark model. Each lane mark has its own unique ID which is kept as long as the lane mark is tracked.";
CM_ SG_ 396 LA_Age_0 "The age represents the duration of the lane mark from the first frame it was detected.";
CM_ SG_ 396 LA_Confidence_0 "The confidence indicates the probability that the lane mark actually exists.";
CM_ SG_ 396 LA_Color_0 "The color classification of the lane mark;  can be white, yellow or blue";
CM_ SG_ 396 LA_Color_Conf_0 "The confidence of the lane mark color classification";
CM_ SG_ 396 LA_Prediction_Reason_0 "Prediction_Reason [i] will be set to true if the lane mark was predicted for reason i  more than one index of the array might be set to true, since several predictions can be activated simultaneously(first segment only)";
CM_ SG_ 396 LA_Availability_State_0 "The lane mark can be detected, predicted or unavailable. The lane mark is considered predicted only if no segment is detected from the image.  Not availble for Rear camera";
CM_ SG_ 396 LA_View_Range_Start_0 "The lane mark polynomial should be used only between VR start to VR end. VR start represents the first point detected or predicted, the smaller between the two.";
CM_ SG_ 396 LA_View_Range_End_0 "The lane mark polynomial should be used only between VR start to VR end. VR end represents the last point detected or predicted, the larger between the two. The negative values support the signals from the rear camera (converted to the front camera coordinate system)";
CM_ SG_ 396 LA_Measured_VR_End_0 "Measured view range indicates the furthest detected point. Measured view range is always smaller or equal to VR end. The negative values support the signals from the rear camera (converted to the front camera coordinate system)";
CM_ SG_ 396 LA_Lanemark_Type_0 "The type classification of the lane mark.  The double lane mark (DLM) type have sub-type; see LA_DLM_Type. HOV and decceleration types are not supported for the next lanes. The negative values support the signals from the rear camera (converted to the front camera coordinate system)";
CM_ SG_ 396 LA_DLM_Type_0 "Double lane mark type is defined first by the inner lane mark (close to the vehicle) and than the outer lane mark.";
CM_ SG_ 396 LA_Lanemark_Type_Conf_0 "The confidence of the lane mark type classification";
CM_ SG_ 396 LA_Line_Side_0 "The role of the lane mark relative to the host vehicle.  Commonly the host left boundary is also the right boundary of the next left lane (and the host right boundary is also the left boundary of the next right lane)  In safety zone (hatched area) there are two lane marks that defines the next lane.   For next lane to the right of the host lane: the RIGHT_LEFT_LANEMARK is the closer line to the host lane and the RIGHT_RIGHT_LANEMARK is the further.   When no safety zone, one of the lane mark is defined by the host line and the second is by the following: RIGHT_RIGHT_LANEMARK represents the next lane mark to the right of the host, LEFT_LEFT_LANEMARK represents the next lane mark to the left of the host.";
CM_ SG_ 396 LA_Marker_Width_0 "The lane mark width is defined as the distance between the inner most edge of the inner most lane mark (with respect to vehicles driving in that lane) and the outer most edge of the outer most lane mark. The definition is also valid for multiple lane marks. The width outputted is the lane mark's average width over the lane boundary detected range.";
CM_ SG_ 396 LA_Marker_Width_STD_0 "Standard deviation of the lane mark width";
CM_ SG_ 396 LA_Line_C3_0 "Ci is coefficient corresponding to variable with power of 'i'";
CM_ SG_ 396 LA_Line_C2_0 "Ci is coefficient corresponding to variable with power of 'i'";
CM_ SG_ 396 LA_Line_C1_0 "Ci is coefficient corresponding to variable with power of 'i'";
CM_ SG_ 396 LA_Line_C0_0 "Ci is coefficient corresponding to variable with power of 'i'";
CM_ SG_ 397 LA_Sync_ID_1 "Sync ID to be used to sync between signals in system";
CM_ SG_ 397 LA_Lane_Track_ID_1 "ID of the lane mark model. Each lane mark has its own unique ID which is kept as long as the lane mark is tracked.";
CM_ SG_ 397 LA_Age_1 "The age represents the duration of the lane mark from the first frame it was detected.";
CM_ SG_ 397 LA_Confidence_1 "The confidence indicates the probability that the lane mark actually exists.";
CM_ SG_ 397 LA_Color_1 "The color classification of the lane mark;  can be white, yellow or blue";
CM_ SG_ 397 LA_Color_Conf_1 "The confidence of the lane mark color classification";
CM_ SG_ 397 LA_Prediction_Reason_1 "Prediction_Reason [i] will be set to true if the lane mark was predicted for reason i  more than one index of the array might be set to true, since several predictions can be activated simultaneously(first segment only)";
CM_ SG_ 397 LA_Availability_State_1 "The lane mark can be detected, predicted or unavailable. The lane mark is considered predicted only if no segment is detected from the image.  Not availble for Rear camera";
CM_ SG_ 397 LA_View_Range_Start_1 "The lane mark polynomial should be used only between VR start to VR end. VR start represents the first point detected or predicted, the smaller between the two.";
CM_ SG_ 397 LA_View_Range_End_1 "The lane mark polynomial should be used only between VR start to VR end. VR end represents the last point detected or predicted, the larger between the two. The negative values support the signals from the rear camera (converted to the front camera coordinate system)";
CM_ SG_ 397 LA_Measured_VR_End_1 "Measured view range indicates the furthest detected point. Measured view range is always smaller or equal to VR end. The negative values support the signals from the rear camera (converted to the front camera coordinate system)";
CM_ SG_ 397 LA_Lanemark_Type_1 "The type classification of the lane mark.  The double lane mark (DLM) type have sub-type; see LA_DLM_Type. HOV and decceleration types are not supported for the next lanes. The negative values support the signals from the rear camera (converted to the front camera coordinate system)";
CM_ SG_ 397 LA_DLM_Type_1 "Double lane mark type is defined first by the inner lane mark (close to the vehicle) and than the outer lane mark.";
CM_ SG_ 397 LA_Lanemark_Type_Conf_1 "The confidence of the lane mark type classification";
CM_ SG_ 397 LA_Line_Side_1 "The role of the lane mark relative to the host vehicle.  Commonly the host left boundary is also the right boundary of the next left lane (and the host right boundary is also the left boundary of the next right lane)  In safety zone (hatched area) there are two lane marks that defines the next lane.   For next lane to the right of the host lane: the RIGHT_LEFT_LANEMARK is the closer line to the host lane and the RIGHT_RIGHT_LANEMARK is the further.   When no safety zone, one of the lane mark is defined by the host line and the second is by the following: RIGHT_RIGHT_LANEMARK represents the next lane mark to the right of the host, LEFT_LEFT_LANEMARK represents the next lane mark to the left of the host.";
CM_ SG_ 397 LA_Marker_Width_1 "The lane mark width is defined as the distance between the inner most edge of the inner most lane mark (with respect to vehicles driving in that lane) and the outer most edge of the outer most lane mark. The definition is also valid for multiple lane marks. The width outputted is the lane mark's average width over the lane boundary detected range.";
CM_ SG_ 397 LA_Marker_Width_STD_1 "Standard deviation of the lane mark width";
CM_ SG_ 397 LA_Line_C3_1 "Ci is coefficient corresponding to variable with power of 'i'";
CM_ SG_ 397 LA_Line_C2_1 "Ci is coefficient corresponding to variable with power of 'i'";
CM_ SG_ 397 LA_Line_C1_1 "Ci is coefficient corresponding to variable with power of 'i'";
CM_ SG_ 397 LA_Line_C0_1 "Ci is coefficient corresponding to variable with power of 'i'";
CM_ SG_ 398 LH_Protocol_Version "Denotes protocol version";
CM_ SG_ 398 LH_Sync_ID_0 "Sync ID to be used to sync between signals in system";
CM_ SG_ 398 LH_Lanes_Count "Maximum number of lines supported by this protocol";
CM_ SG_ 398 LH_Estimated_Width "The host lane width is defined as the distance between the reference right edge and the reference left edge. The lane width is estimated over a few dozen of meters.";
CM_ SG_ 398 LH_CRC_0 "Calculated over all element signals. From the signal after the CRC until the first signal in the next elements LH_CRC_N+1  not including";
CM_ SG_ 398 LH_Track_ID_0 "ID of the lane mark model. Each lane mark had its own unique ID which is kept as long as the lane mark is tracked.";
CM_ SG_ 398 LH_Is_Triggered_SDM_Type_0 "This flag is turned on when the SDM is triggered on lane mark type.";
CM_ SG_ 398 LH_Is_Triggered_SDM_Model_0 "This flag is turned on when the SDM is triggered on lane mark model.";
CM_ SG_ 398 LH_Age_0 "The age represents the duration of the lane mark from the first frame it was detected.";
CM_ SG_ 398 LH_Confidence_0 "The confidence indicates the probability that the lane mark actually exists.";
CM_ SG_ 398 LH_Prediction_Reason_0 "Prediction_Reason [i] will be set to true if the lane mark was predicted for reason i  more than one index of the array might be set to true, since several predictions can be actived simultaneously. (This is valid for the first segment only)";
CM_ SG_ 398 LH_Availability_State_0 "The lane mark can be detected, predicted or unavailable. The lane mark is considered predicted only if no segment is detected from the image.";
CM_ SG_ 398 LH_Color_0 "The color classification of the lane mark;  can be white, yellow or blue";
CM_ SG_ 398 LH_Color_Confidence_0 "The confidence of the lane mark color classification";
CM_ SG_ 398 LH_Lanemark_Type_0 "The type classification of the lane mark. The double lane mark (DLM) and the decceleration types have sub-type; see LH_DLM_Type & LH_DECEL_Type";
CM_ SG_ 398 LH_DLM_Type_0 "Double lane mark type is defined first by the inner lane mark (close to the vehicle) and than the outer lane mark.";
CM_ SG_ 398 LH_DECEL_Type_0 "The decceleration area type is defined by the type of the center lane mark.";
CM_ SG_ 398 LH_Lanemark_Type_Conf_0 "The confidence of the lane mark type classification";
CM_ SG_ 398 LH_Side_0 "The side of the host lane mark ; host left ot host right";
CM_ SG_ 398 LH_Crossing_0 "The crossing signal is an indication of whether the host vehicle performed lane crossing";
CM_ SG_ 398 LH_Marker_Width_0 "The lane mark width is defined as the distance between the inner most edge of the inner most lane mark (with respect to vehicles driving in that lane) and the outer most edge of the outer most lane mark. The definition is also valid for multiple lane marks. The width outputted is the lane mark's average width over the lane boundary detected range.";
CM_ SG_ 398 LH_Marker_Width_STD_0 "Standard deviation of the lane mark width";
CM_ SG_ 398 Reserved_4 "Indicate if the Dash Average information is Available (first segment only and on Front Camera Only)";
CM_ SG_ 398 LH_Is_Multi_Clothoid_0 "The lane mark model can be represented by two consecutive segments; first segment and second segment. This representation is rare and needed only in certain scenarios where a single model cannot represent the lane mark accuratly. In those cases, this signal is turned on. Lane mark attributes, like color, type, LM width etc are relevant to the first segment only.";
CM_ SG_ 398 LH_Line_First_C0_0 "Ci is coefficient corresponding to variable with power of 'i'.  In multi-clothoid modeling, this represent the C0 of the first segment coefficient. For single model, the C0 coefficient is used to represent the entire model.";
CM_ SG_ 398 LH_Line_First_C1_0 "Ci is coefficient corresponding to variable with power of 'i'.  In multi-clothoid modeling, this represent the C1 of the first segment coefficient. For single model, the C0 coefficient is used to represent the entire model.";
CM_ SG_ 398 LH_Line_First_C2_0 "Ci is coefficient corresponding to variable with power of 'i'.  In multi-clothoid modeling, this represent the C2 of the first segment coefficient. For single model, the C0 coefficient is used to represent the entire model.";
CM_ SG_ 398 LH_Line_First_C3_0 "Ci is coefficient corresponding to variable with power of 'i'.  In multi-clothoid modeling, this represent the C3 of the first segment coefficient. For single model, the C0 coefficient is used to represent the entire model.";
CM_ SG_ 398 LH_First_VR_Start_0 "The lane mark polynomial should be used only between VR start to VR end. VR start represents the first point detected or predicted, the smaller between the two. In case of multi-chlotoid representation, this is the start VR of the first segment, otherwise (single model) this is the VR start of the model.";
CM_ SG_ 398 LH_First_VR_End_0 "The lane mark polynomial should be used only between VR start to VR end. VR end represents the last point detected or predicted, the larger between the two. In case of multi-chlotoid representation, this is the VR end of the first segment, otherwise (single model) this is the VR end of the model.";
CM_ SG_ 398 LH_First_Measured_VR_End_0 "Measured view range indicates the furthest detected point. Measured view range is always smaller or equal to VR end. Relevant only when model representation is by a single model.  (not relevant for multi-chlotoid modeling)";
CM_ SG_ 398 LH_Second_Measured_VR_End_0 "Measured view range indicates the furthest detected point. Measured view range is always smaller or equal to VR end.  (not relevant for multi-chlotoid modeling)";
CM_ SG_ 398 LH_Line_Second_C0_0 "Ci is coefficient corresponding to variable with power of 'i'.  In multi-clothoid modeling, this represent the C0 of the second segment coefficient. For single modeling, those coefficients are not relevant.";
CM_ SG_ 398 LH_Line_Second_C1_0 "Ci is coefficient corresponding to variable with power of 'i'.  In multi-clothoid modeling, this represent the C1 of the second segment coefficient. For single modeling, those coefficients are not relevant.";
CM_ SG_ 398 LH_Line_Second_C2_0 "Ci is coefficient corresponding to variable with power of 'i'.  In multi-clothoid modeling, this represent the C2 of the second segment coefficient. For single modeling, those coefficients are not relevant.";
CM_ SG_ 398 LH_Line_Second_C3_0 "Ci is coefficient corresponding to variable with power of 'i'.  In multi-clothoid modeling, this represent the C3 of the second segment coefficient. For single modeling, those coefficients are not relevant.";
CM_ SG_ 398 LH_Second_VR_Start_0 "The lane mark polynomial should be used only between VR start to VR end. VR start represents the first point detected or predicted, the smaller between the two. In case of multi-chlotoid representation, this is the start VR of the second segment (not relevant for a single modeling)";
CM_ SG_ 398 LH_Second_VR_End_0 "The lane mark polynomial should be used only between VR start to VR end. VR end represents the last point detected or predicted, the larger between the two. In case of multi-chlotoid representation, this is the VR end of the second segment. (not relevant for a single modeling)";
CM_ SG_ 399 LH_Sync_ID_1 "Sync ID to be used to sync between signals in system";
CM_ SG_ 399 LH_CRC_1 "Calculated over all element signals. From the signal after the CRC until the first signal in the next elements LH_CRC_N+1  not including";
CM_ SG_ 399 LH_Is_Triggered_SDM_Type_1 "This flag is turned on when the SDM is triggered on lane mark type.";
CM_ SG_ 399 LH_Is_Triggered_SDM_Model_1 "This flag is turned on when the SDM is triggered on lane mark model.";
CM_ SG_ 399 LH_Track_ID_1 "ID of the lane mark model. Each lane mark had its own unique ID which is kept as long as the lane mark is tracked.";
CM_ SG_ 399 LH_Age_1 "The age represents the duration of the lane mark from the first frame it was detected.";
CM_ SG_ 399 LH_Confidence_1 "The confidence indicates the probability that the lane mark actually exists.";
CM_ SG_ 399 LH_Prediction_Reason_1 "Prediction_Reason [i] will be set to true if the lane mark was predicted for reason i  more than one index of the array might be set to true, since several predictions can be actived simultaneously. (This is valid for the first segment only)";
CM_ SG_ 399 LH_Availability_State_1 "The lane mark can be detected, predicted or unavailable. The lane mark is considered predicted only if no segment is detected from the image.";
CM_ SG_ 399 LH_Color_1 "The color classification of the lane mark;  can be white, yellow or blue";
CM_ SG_ 399 LH_Color_Confidence_1 "The confidence of the lane mark color classification";
CM_ SG_ 399 LH_Lanemark_Type_1 "The type classification of the lane mark. The double lane mark (DLM) and the decceleration types have sub-type; see LH_DLM_Type & LH_DECEL_Type";
CM_ SG_ 399 LH_DLM_Type_1 "Double lane mark type is defined first by the inner lane mark (close to the vehicle) and than the outer lane mark.";
CM_ SG_ 399 LH_DECEL_Type_1 "The decceleration area type is defined by the type of the center lane mark.";
CM_ SG_ 399 LH_Lanemark_Type_Conf_1 "The confidence of the lane mark type classification";
CM_ SG_ 399 LH_Side_1 "The side of the host lane mark ; host left ot host right";
CM_ SG_ 399 LH_Crossing_1 "The crossing signal is an indication of whether the host vehicle performed lane crossing";
CM_ SG_ 399 LH_Marker_Width_1 "The lane mark width is defined as the distance between the inner most edge of the inner most lane mark (with respect to vehicles driving in that lane) and the outer most edge of the outer most lane mark. The definition is also valid for multiple lane marks. The width outputted is the lane mark's average width over the lane boundary detected range.";
CM_ SG_ 399 LH_Marker_Width_STD_1 "Standard deviation of the lane mark width";
CM_ SG_ 399 Reserved_5 "Indicate if the Dash Average information is Available (first segment only and on Front Camera Only)";
CM_ SG_ 399 LH_Is_Multi_Clothoid_1 "The lane mark model can be represented by two consecutive segments; first segment and second segment. This representation is rare and needed only in certain scenarios where a single model cannot represent the lane mark accuratly. In those cases, this signal is turned on. Lane mark attributes, like color, type, LM width etc are relevant to the first segment only.";
CM_ SG_ 399 LH_Line_First_C0_1 "Ci is coefficient corresponding to variable with power of 'i'.  In multi-clothoid modeling, this represent the C0 of the first segment coefficient. For single model, the C0 coefficient is used to represent the entire model.";
CM_ SG_ 399 LH_Line_First_C1_1 "Ci is coefficient corresponding to variable with power of 'i'.  In multi-clothoid modeling, this represent the C1 of the first segment coefficient. For single model, the C0 coefficient is used to represent the entire model.";
CM_ SG_ 399 LH_Line_First_C2_1 "Ci is coefficient corresponding to variable with power of 'i'.  In multi-clothoid modeling, this represent the C2 of the first segment coefficient. For single model, the C0 coefficient is used to represent the entire model.";
CM_ SG_ 399 LH_Line_First_C3_1 "Ci is coefficient corresponding to variable with power of 'i'.  In multi-clothoid modeling, this represent the C3 of the first segment coefficient. For single model, the C0 coefficient is used to represent the entire model.";
CM_ SG_ 399 LH_First_VR_Start_1 "The lane mark polynomial should be used only between VR start to VR end. VR start represents the first point detected or predicted, the smaller between the two. In case of multi-chlotoid representation, this is the start VR of the first segment, otherwise (single model) this is the VR start of the model.";
CM_ SG_ 399 LH_First_VR_End_1 "The lane mark polynomial should be used only between VR start to VR end. VR end represents the last point detected or predicted, the larger between the two. In case of multi-chlotoid representation, this is the VR end of the first segment, otherwise (single model) this is the VR end of the model.";
CM_ SG_ 399 LH_First_Measured_VR_End_1 "Measured view range indicates the furthest detected point. Measured view range is always smaller or equal to VR end. Relevant only when model representation is by a single model.  (not relevant for multi-chlotoid modeling)";
CM_ SG_ 399 LH_Second_Measured_VR_End_1 "Measured view range indicates the furthest detected point. Measured view range is always smaller or equal to VR end.  (not relevant for multi-chlotoid modeling)";
CM_ SG_ 399 LH_Line_Second_C0_1 "Ci is coefficient corresponding to variable with power of 'i'.  In multi-clothoid modeling, this represent the C0 of the second segment coefficient. For single modeling, those coefficients are not relevant.";
CM_ SG_ 399 LH_Line_Second_C1_1 "Ci is coefficient corresponding to variable with power of 'i'.  In multi-clothoid modeling, this represent the C1 of the second segment coefficient. For single modeling, those coefficients are not relevant.";
CM_ SG_ 399 LH_Line_Second_C2_1 "Ci is coefficient corresponding to variable with power of 'i'.  In multi-clothoid modeling, this represent the C2 of the second segment coefficient. For single modeling, those coefficients are not relevant.";
CM_ SG_ 399 LH_Line_Second_C3_1 "Ci is coefficient corresponding to variable with power of 'i'.  In multi-clothoid modeling, this represent the C3 of the second segment coefficient. For single modeling, those coefficients are not relevant.";
CM_ SG_ 399 LH_Second_VR_Start_1 "The lane mark polynomial should be used only between VR start to VR end. VR start represents the first point detected or predicted, the smaller between the two. In case of multi-chlotoid representation, this is the start VR of the second segment (not relevant for a single modeling)";
CM_ SG_ 399 LH_Second_VR_End_1 "The lane mark polynomial should be used only between VR start to VR end. VR end represents the last point detected or predicted, the larger between the two. In case of multi-chlotoid representation, this is the VR end of the second segment. (not relevant for a single modeling)";
CM_ SG_ 394 LRE_Header_CRC "Calculated over all header signals. From the signal after the CRC until the first signal in the elements LRE_Element_CRC_0 not including";
CM_ SG_ 394 LRE_Protocol_Version "Denotes the protocol version";
CM_ SG_ 394 LRE_Sync_ID_0 "The ID of the Sync message, used to synchronize between signals in the system. Every new frame promotes the sync ID by one.";
CM_ SG_ 394 LRE_Count "Number of lines reported. Front camera can output up to 4 road edges:one road edge for each side and another road edge for each side if the multiple RE package is enabled. Rear camera can output up to one road edge per each side.";
CM_ SG_ 394 LRE_Element_CRC_0 "Calculated over all element signals. From the signal after the CRC until the first signal in the next elements LRE_Element_CRC_N+1  not including";
CM_ SG_ 394 LRE_ID_0 "ID of the lane boundary model. Each lane boundary has its own unique ID which is kept as long as the lane boundary is tracked.";
CM_ SG_ 394 LRE_Age_0 "The age represents the duration of the lane boundary from the first frame it was detected.";
CM_ SG_ 394 LRE_Confidence_0 "The Confidence of the road edge. Normally values of the confidence is 0 to 1. When confidence is -1 it means that the confidence is not applicable. As oppose to low value of confidence, it does not implicate on the quality of the road edge model.";
CM_ SG_ 394 LRE_Prediction_Reason_0 "Prediction_Reason [i] will be set to true if the lane mark was predicted for reason i  more than one index of the array might be set to true, since several predictions can be activated simultaneously(first segment only)";
CM_ SG_ 394 LRE_Availability_State_0 "The lane boundary can be detected, predicted or unavailable. The lane boundary is considered predicted only if no segment is detected from the image.";
CM_ SG_ 394 LRE_View_Range_Start_0 "The lane boundary polynomial should be used only between VR start to VR end. VR start represents the first point detected or predicted, the smaller between the two.";
CM_ SG_ 394 LRE_View_Range_End_0 "The lane boundary polynomial should be used only between VR start to VR end. VR end represents the last point detected or predicted, the larger between the two.";
CM_ SG_ 394 LRE_Measured_VR_End_0 "Measured view range indicates the furthest detected point. Measured view range is always smaller or equal to VR end.";
CM_ SG_ 394 LRE_Side_0 "Indicates whether the road edge is at the left or right side of the host vehicle";
CM_ SG_ 394 LRE_Is_Triggered_SDM_Model_0 "This flag is turned on when the SDM is triggered on lane mark model.";
CM_ SG_ 394 LRE_Line_C3_0 "Ci is coefficient corresponding to variable with power of 'i' in the road edge polynomial.";
CM_ SG_ 394 LRE_Line_C2_0 "Ci is coefficient corresponding to variable with power of 'i' in the road edge polynomial.";
CM_ SG_ 394 LRE_Line_C1_0 "Ci is coefficient corresponding to variable with power of 'i' in the road edge polynomial.";
CM_ SG_ 394 LRE_Line_C0_0 "Ci is coefficient corresponding to variable with power of 'i' in the road edge polynomial.";
CM_ SG_ 394 Reserved_6 "Place holder for multiple road edge support. The second road edge is supported only for the front camera.";
CM_ SG_ 395 LRE_Sync_ID_1 "The ID of the Sync message, used to synchronize between signals in the system. Every new frame promotes the sync ID by one.";
CM_ SG_ 395 LRE_Element_CRC_1 "Calculated over all element signals. From the signal after the CRC until the first signal in the next elements LRE_Element_CRC_N+1  not including";
CM_ SG_ 395 LRE_ID_1 "ID of the lane boundary model. Each lane boundary has its own unique ID which is kept as long as the lane boundary is tracked.";
CM_ SG_ 395 LRE_Age_1 "The age represents the duration of the lane boundary from the first frame it was detected.";
CM_ SG_ 395 LRE_Confidence_1 "The Confidence of the road edge. Normally values of the confidence is 0 to 1. When confidence is -1 it means that the confidence is not applicable. As oppose to low value of confidence, it does not implicate on the quality of the road edge model.";
CM_ SG_ 395 LRE_Prediction_Reason_1 "Prediction_Reason [i] will be set to true if the lane mark was predicted for reason i  more than one index of the array might be set to true, since several predictions can be activated simultaneously(first segment only)";
CM_ SG_ 395 LRE_Availability_State_1 "The lane boundary can be detected, predicted or unavailable. The lane boundary is considered predicted only if no segment is detected from the image.";
CM_ SG_ 395 LRE_View_Range_Start_1 "The lane boundary polynomial should be used only between VR start to VR end. VR start represents the first point detected or predicted, the smaller between the two.";
CM_ SG_ 395 LRE_View_Range_End_1 "The lane boundary polynomial should be used only between VR start to VR end. VR end represents the last point detected or predicted, the larger between the two.";
CM_ SG_ 395 LRE_Measured_VR_End_1 "Measured view range indicates the furthest detected point. Measured view range is always smaller or equal to VR end. Currently, for the supported RE prediction types, the LRE_Measured_VR_End will always be equal to LRE_View_Range_End.";
CM_ SG_ 395 LRE_Side_1 "Indicates whether the road edge is at the left or right side of the host vehicle";
CM_ SG_ 395 LRE_Is_Triggered_SDM_Model_1 "This flag is turned on when the SDM is triggered on lane mark model.";
CM_ SG_ 395 LRE_Line_C3_1 "Ci is coefficient corresponding to variable with power of 'i' in the road edge polynomial.";
CM_ SG_ 395 LRE_Line_C2_1 "Ci is coefficient corresponding to variable with power of 'i' in the road edge polynomial.";
CM_ SG_ 395 LRE_Line_C1_1 "Ci is coefficient corresponding to variable with power of 'i' in the road edge polynomial.";
CM_ SG_ 395 LRE_Line_C0_1 "Ci is coefficient corresponding to variable with power of 'i' in the road edge polynomial.";
CM_ SG_ 395 Reserved_7 "Place holder for multiple road edge support. The second road edge is supported only for the front camera.";
CM_ SG_ 342 TSR_Protocol_Version "Denotes the protocol version";
CM_ SG_ 342 TSR_Sync_ID_0 "Sync ID to be used to sync between signals in system";
CM_ SG_ 342 TSR_Approved_Sign_Count "Number of approved signed in the scene";
CM_ SG_ 342 TSR_Filtered_Sign_Count "Number of filtered and Irelevant signs that were seen in the scene (TSR_Filter_Type not 0 or TSR_Relevancy not 0)";
CM_ SG_ 342 TSR_UnderTracking_Sign_Count "Number of signs that are still being tracked in the scene";
CM_ SG_ 342 TSR_ID_0 "sign ID";
CM_ SG_ 342 TSR_Sign_Name_0 "Sign descriptive name (TSR Signs ENUM)";
CM_ SG_ 342 TSR_Relevancy_0 "Each sign is considered relevant unless non relevant reason is identified. The ENUM represent those reason of reject sign from being relevant by providing the reason.";
CM_ SG_ 342 TSR_Sup1_SignName_0 "First Supplementary Sign descriptive name (TSR Signs ENUM)";
CM_ SG_ 342 TSR_Filter_Type_0 "The filter type represent a decision of the AI that this is not a considerable sign. (on truck or road number etc.)";
CM_ SG_ 342 TSR_Sup1_Confidence_0 "Supp Sign classification confidence";
CM_ SG_ 342 TSR_Sup1_Position_0 "Supplementary sign relative  position";
CM_ SG_ 342 TSR_Sup2_SignName_0 "Second Supplementary Sign descriptive name (TSR Signs ENUM)";
CM_ SG_ 342 TSR_Sup2_Confidence_0 "Supp Sign classification confidence";
CM_ SG_ 342 TSR_Sup2_Position_0 "Supplementary sign relative  position";
CM_ SG_ 342 TSR_Confidence_0 "Sign classification confidence";
CM_ SG_ 342 TSR_Sign_Shape_0 "Sign Shape (ENUM)";
CM_ SG_ 342 TSR_Sign_Structure_0 "Indicate if the Sign structure is Standard or Electronic.";
CM_ SG_ 342 TSR_Tracking_Age_0 "For now supported for under tracking objects only from multi-frame approval time. Number of frames.";
CM_ SG_ 342 TSR_Sign_Long_Distance_0 "Longitudinal distance to sign (on the ground ) in meters";
CM_ SG_ 342 TSR_Sign_Long_Distance_STD_0 "Longitudinal distance to sign (on the ground ) in meters STD Kalman";
CM_ SG_ 342 TSR_Sign_Lateral_Distance_0 "Lateral distance to sign (on the ground) in meters";
CM_ SG_ 342 TSR_Sign_Lat_Distance_STD_0 "Lateral distance to sign (on the ground) in meters STD Kalman";
CM_ SG_ 342 TSR_Sign_Height_0 "Sign height in meters from camera / refernce point";
CM_ SG_ 342 TSR_Sign_Panel_Height_STD_0 "STD";
CM_ SG_ 342 TSR_Sign_Height_STD_0 "Sign height in meters STD Kalman";
CM_ SG_ 342 TSR_Measurement_Status_0 "Visibility Measurement  status";
CM_ SG_ 342 TSR_AngleZ_0 "The sign horizontal rotation relative to the longitudinal axis of the ego car (0 when the sign is perpendicular). No polarity indication.";
CM_ SG_ 342 TSR_Relevancy_Confidence_0 "Provides score indication for how much the sign is relevant to the Ego vehicle.";
CM_ SG_ 342 TSR_ID_1 "sign ID";
CM_ SG_ 342 TSR_Sign_Name_1 "Sign descriptive name (TSR Signs ENUM)";
CM_ SG_ 342 TSR_Relevancy_1 "Each sign is considered relevant unless non relevant reason is identified. The ENUM represent those reason of reject sign from being relevant by providing the reason.";
CM_ SG_ 342 TSR_Filter_Type_1 "The filter type represent a decision of the AI that this is not a considerable sign. (on truck or road number etc.)";
CM_ SG_ 342 TSR_Sup1_SignName_1 "First Supplementary Sign descriptive name (TSR Signs ENUM)";
CM_ SG_ 342 TSR_Sup1_Confidence_1 "Supp Sign classification confidence";
CM_ SG_ 342 TSR_Sup1_Position_1 "Supplementary sign relative  position";
CM_ SG_ 342 TSR_Sup2_SignName_1 "Second Supplementary Sign descriptive name (TSR Signs ENUM)";
CM_ SG_ 342 TSR_Sup2_Confidence_1 "Supp Sign classification confidence";
CM_ SG_ 342 TSR_Sup2_Position_1 "Supplementary sign relative  position";
CM_ SG_ 342 TSR_Confidence_1 "Sign classification confidence";
CM_ SG_ 342 TSR_Sign_Shape_1 "Sign Shape (ENUM)";
CM_ SG_ 342 TSR_Sign_Structure_1 "Indicate if the Sign structure is Standard or Electronic.";
CM_ SG_ 342 TSR_Tracking_Age_1 "For now supported for under tracking objects only from multi-frame approval time. Number of frames.";
CM_ SG_ 342 TSR_Sign_Long_Distance_1 "Longitudinal distance to sign (on the ground ) in meters";
CM_ SG_ 342 TSR_Sign_Long_Distance_STD_1 "Longitudinal distance to sign (on the ground ) in meters STD Kalman";
CM_ SG_ 342 TSR_Sign_Lateral_Distance_1 "Lateral distance to sign (on the ground) in meters";
CM_ SG_ 342 TSR_Sign_Lat_Distance_STD_1 "Lateral distance to sign (on the ground) in meters STD Kalman";
CM_ SG_ 342 TSR_Sign_Height_1 "Sign height in meters from camera / refernce point";
CM_ SG_ 342 TSR_Sign_Panel_Height_STD_1 "STD";
CM_ SG_ 342 TSR_Sign_Height_STD_1 "Sign height in meters STD Kalman";
CM_ SG_ 342 TSR_Measurement_Status_1 "Visibility Measurement  status";
CM_ SG_ 342 TSR_AngleZ_1 "The sign horizontal rotation relative to the longitudinal axis of the ego car (0 when the sign is perpendicular). No polarity indication.";
CM_ SG_ 342 TSR_Relevancy_Confidence_1 "Provides score indication for how much the sign is relevant to the Ego vehicle.";
CM_ SG_ 343 TSR_Sync_ID_1 "Sync ID to be used to sync between signals in system";
CM_ SG_ 343 TSR_ID_2 "sign ID";
CM_ SG_ 343 TSR_Sign_Name_2 "Sign descriptive name (TSR Signs ENUM)";
CM_ SG_ 343 TSR_Relevancy_2 "Each sign is considered relevant unless non relevant reason is identified. The ENUM represent those reason of reject sign from being relevant by providing the reason.";
CM_ SG_ 343 TSR_Filter_Type_2 "The filter type represent a decision of the AI that this is not a considerable sign. (on truck or road number etc.)";
CM_ SG_ 343 TSR_Sup1_SignName_2 "First Supplementary Sign descriptive name (TSR Signs ENUM)";
CM_ SG_ 343 TSR_Sup1_Confidence_2 "Supp Sign classification confidence";
CM_ SG_ 343 TSR_Sup1_Position_2 "Supplementary sign relative  position";
CM_ SG_ 343 TSR_Sup2_SignName_2 "Second Supplementary Sign descriptive name (TSR Signs ENUM)";
CM_ SG_ 343 TSR_Sup2_Confidence_2 "Supp Sign classification confidence";
CM_ SG_ 343 TSR_Sup2_Position_2 "Supplementary sign relative  position";
CM_ SG_ 343 TSR_Confidence_2 "Sign classification confidence";
CM_ SG_ 343 TSR_Sign_Shape_2 "Sign Shape (ENUM)";
CM_ SG_ 343 TSR_Sign_Structure_2 "Indicate if the Sign structure is Standard or Electronic.";
CM_ SG_ 343 TSR_Tracking_Age_2 "For now supported for under tracking objects only from multi-frame approval time. Number of frames.";
CM_ SG_ 343 TSR_Sign_Long_Distance_2 "Longitudinal distance to sign (on the ground ) in meters";
CM_ SG_ 343 TSR_Sign_Long_Distance_STD_2 "Longitudinal distance to sign (on the ground ) in meters STD Kalman";
CM_ SG_ 343 TSR_Sign_Lateral_Distance_2 "Lateral distance to sign (on the ground) in meters";
CM_ SG_ 343 TSR_Sign_Lat_Distance_STD_2 "Lateral distance to sign (on the ground) in meters STD Kalman";
CM_ SG_ 343 TSR_Sign_Height_2 "Sign height in meters from camera / refernce point";
CM_ SG_ 343 TSR_Sign_Panel_Height_STD_2 "STD";
CM_ SG_ 343 TSR_Sign_Height_STD_2 "Sign height in meters STD Kalman";
CM_ SG_ 343 TSR_Measurement_Status_2 "Visibility Measurement  status";
CM_ SG_ 343 TSR_AngleZ_2 "The sign horizontal rotation relative to the longitudinal axis of the ego car (0 when the sign is perpendicular). No polarity indication.";
CM_ SG_ 343 TSR_Relevancy_Confidence_2 "Provides score indication for how much the sign is relevant to the Ego vehicle.";
CM_ SG_ 343 TSR_ID_3 "sign ID";
CM_ SG_ 343 TSR_Sign_Name_3 "Sign descriptive name (TSR Signs ENUM)";
CM_ SG_ 343 TSR_Relevancy_3 "Each sign is considered relevant unless non relevant reason is identified. The ENUM represent those reason of reject sign from being relevant by providing the reason.";
CM_ SG_ 343 TSR_Filter_Type_3 "The filter type represent a decision of the AI that this is not a considerable sign. (on truck or road number etc.)";
CM_ SG_ 343 TSR_Sup1_SignName_3 "First Supplementary Sign descriptive name (TSR Signs ENUM)";
CM_ SG_ 343 TSR_Sup1_Confidence_3 "Supp Sign classification confidence";
CM_ SG_ 343 TSR_Sup1_Position_3 "Supplementary sign relative  position";
CM_ SG_ 343 TSR_Sup2_SignName_3 "Second Supplementary Sign descriptive name (TSR Signs ENUM)";
CM_ SG_ 343 TSR_Sup2_Confidence_3 "Supp Sign classification confidence";
CM_ SG_ 343 TSR_Sup2_Position_3 "Supplementary sign relative  position";
CM_ SG_ 343 TSR_Confidence_3 "Sign classification confidence";
CM_ SG_ 343 TSR_Sign_Shape_3 "Sign Shape (ENUM)";
CM_ SG_ 343 TSR_Sign_Structure_3 "Indicate if the Sign structure is Standard or Electronic.";
CM_ SG_ 343 TSR_Tracking_Age_3 "For now supported for under tracking objects only from multi-frame approval time. Number of frames.";
CM_ SG_ 343 TSR_Sign_Long_Distance_3 "Longitudinal distance to sign (on the ground ) in meters";
CM_ SG_ 343 TSR_Sign_Long_Distance_STD_3 "Longitudinal distance to sign (on the ground ) in meters STD Kalman";
CM_ SG_ 343 TSR_Sign_Lateral_Distance_3 "Lateral distance to sign (on the ground) in meters";
CM_ SG_ 343 TSR_Sign_Lat_Distance_STD_3 "Lateral distance to sign (on the ground) in meters STD Kalman";
CM_ SG_ 343 TSR_Sign_Height_3 "Sign height in meters from camera / refernce point";
CM_ SG_ 343 TSR_Sign_Panel_Height_STD_3 "STD";
CM_ SG_ 343 TSR_Sign_Height_STD_3 "Sign height in meters STD Kalman";
CM_ SG_ 343 TSR_Measurement_Status_3 "Visibility Measurement  status";
CM_ SG_ 343 TSR_AngleZ_3 "The sign horizontal rotation relative to the longitudinal axis of the ego car (0 when the sign is perpendicular). No polarity indication.";
CM_ SG_ 343 TSR_Relevancy_Confidence_3 "Provides score indication for how much the sign is relevant to the Ego vehicle.";
CM_ SG_ 344 TSR_Sync_ID_2 "Sync ID to be used to sync between signals in system";
CM_ SG_ 344 TSR_ID_4 "sign ID";
CM_ SG_ 344 TSR_Sign_Name_4 "Sign descriptive name (TSR Signs ENUM)";
CM_ SG_ 344 TSR_Relevancy_4 "Each sign is considered relevant unless non relevant reason is identified. The ENUM represent those reason of reject sign from being relevant by providing the reason.";
CM_ SG_ 344 TSR_Filter_Type_4 "The filter type represent a decision of the AI that this is not a considerable sign. (on truck or road number etc.)";
CM_ SG_ 344 TSR_Sup1_SignName_4 "First Supplementary Sign descriptive name (TSR Signs ENUM)";
CM_ SG_ 344 TSR_Sup1_Confidence_4 "Supp Sign classification confidence";
CM_ SG_ 344 TSR_Sup1_Position_4 "Supplementary sign relative  position";
CM_ SG_ 344 TSR_Sup2_SignName_4 "Second Supplementary Sign descriptive name (TSR Signs ENUM)";
CM_ SG_ 344 TSR_Sup2_Confidence_4 "Supp Sign classification confidence";
CM_ SG_ 344 TSR_Sup2_Position_4 "Supplementary sign relative  position";
CM_ SG_ 344 TSR_Confidence_4 "Sign classification confidence";
CM_ SG_ 344 TSR_Sign_Shape_4 "Sign Shape (ENUM)";
CM_ SG_ 344 TSR_Sign_Structure_4 "Indicate if the Sign structure is Standard or Electronic.";
CM_ SG_ 344 TSR_Tracking_Age_4 "For now supported for under tracking objects only from multi-frame approval time. Number of frames.";
CM_ SG_ 344 TSR_Sign_Long_Distance_4 "Longitudinal distance to sign (on the ground ) in meters";
CM_ SG_ 344 TSR_Sign_Long_Distance_STD_4 "Longitudinal distance to sign (on the ground ) in meters STD Kalman";
CM_ SG_ 344 TSR_Sign_Lateral_Distance_4 "Lateral distance to sign (on the ground) in meters";
CM_ SG_ 344 TSR_Sign_Lat_Distance_STD_4 "Lateral distance to sign (on the ground) in meters STD Kalman";
CM_ SG_ 344 TSR_Sign_Height_4 "Sign height in meters from camera / refernce point";
CM_ SG_ 344 TSR_Sign_Panel_Height_STD_4 "STD";
CM_ SG_ 344 TSR_Sign_Height_STD_4 "Sign height in meters STD Kalman";
CM_ SG_ 344 TSR_Measurement_Status_4 "Visibility Measurement  status";
CM_ SG_ 344 TSR_AngleZ_4 "The sign horizontal rotation relative to the longitudinal axis of the ego car (0 when the sign is perpendicular). No polarity indication.";
CM_ SG_ 344 TSR_Relevancy_Confidence_4 "Provides score indication for how much the sign is relevant to the Ego vehicle.";
CM_ SG_ 344 TSR_ID_5 "sign ID";
CM_ SG_ 344 TSR_Sign_Name_5 "Sign descriptive name (TSR Signs ENUM)";
CM_ SG_ 344 TSR_Relevancy_5 "Each sign is considered relevant unless non relevant reason is identified. The ENUM represent those reason of reject sign from being relevant by providing the reason.";
CM_ SG_ 344 TSR_Filter_Type_5 "The filter type represent a decision of the AI that this is not a considerable sign. (on truck or road number etc.)";
CM_ SG_ 344 TSR_Sup1_SignName_5 "First Supplementary Sign descriptive name (TSR Signs ENUM)";
CM_ SG_ 344 TSR_Sup1_Confidence_5 "Supp Sign classification confidence";
CM_ SG_ 344 TSR_Sup1_Position_5 "Supplementary sign relative  position";
CM_ SG_ 344 TSR_Sup2_SignName_5 "Second Supplementary Sign descriptive name (TSR Signs ENUM)";
CM_ SG_ 344 TSR_Sup2_Confidence_5 "Supp Sign classification confidence";
CM_ SG_ 344 TSR_Sup2_Position_5 "Supplementary sign relative  position";
CM_ SG_ 344 TSR_Confidence_5 "Sign classification confidence";
CM_ SG_ 344 TSR_Sign_Shape_5 "Sign Shape (ENUM)";
CM_ SG_ 344 TSR_Sign_Structure_5 "Indicate if the Sign structure is Standard or Electronic.";
CM_ SG_ 344 TSR_Tracking_Age_5 "For now supported for under tracking objects only from multi-frame approval time. Number of frames.";
CM_ SG_ 344 TSR_Sign_Long_Distance_5 "Longitudinal distance to sign (on the ground ) in meters";
CM_ SG_ 344 TSR_Sign_Long_Distance_STD_5 "Longitudinal distance to sign (on the ground ) in meters STD Kalman";
CM_ SG_ 344 TSR_Sign_Lateral_Distance_5 "Lateral distance to sign (on the ground) in meters";
CM_ SG_ 344 TSR_Sign_Lat_Distance_STD_5 "Lateral distance to sign (on the ground) in meters STD Kalman";
CM_ SG_ 344 TSR_Sign_Height_5 "Sign height in meters from camera / refernce point";
CM_ SG_ 344 TSR_Sign_Panel_Height_STD_5 "STD";
CM_ SG_ 344 TSR_Sign_Height_STD_5 "Sign height in meters STD Kalman";
CM_ SG_ 344 TSR_Measurement_Status_5 "Visibility Measurement  status";
CM_ SG_ 344 TSR_AngleZ_5 "The sign horizontal rotation relative to the longitudinal axis of the ego car (0 when the sign is perpendicular). No polarity indication.";
CM_ SG_ 344 TSR_Relevancy_Confidence_5 "Provides score indication for how much the sign is relevant to the Ego vehicle.";
CM_ SG_ 345 TSR_Sync_ID_3 "Sync ID to be used to sync between signals in system";
CM_ SG_ 345 TSR_ID_6 "sign ID";
CM_ SG_ 345 TSR_Sign_Name_6 "Sign descriptive name (TSR Signs ENUM)";
CM_ SG_ 345 TSR_Relevancy_6 "Each sign is considered relevant unless non relevant reason is identified. The ENUM represent those reason of reject sign from being relevant by providing the reason.";
CM_ SG_ 345 TSR_Filter_Type_6 "The filter type represent a decision of the AI that this is not a considerable sign. (on truck or road number etc.)";
CM_ SG_ 345 TSR_Sup1_SignName_6 "First Supplementary Sign descriptive name (TSR Signs ENUM)";
CM_ SG_ 345 TSR_Sup1_Confidence_6 "Supp Sign classification confidence";
CM_ SG_ 345 TSR_Sup1_Position_6 "Supplementary sign relative  position";
CM_ SG_ 345 TSR_Sup2_SignName_6 "Second Supplementary Sign descriptive name (TSR Signs ENUM)";
CM_ SG_ 345 TSR_Sup2_Confidence_6 "Supp Sign classification confidence";
CM_ SG_ 345 TSR_Sup2_Position_6 "Supplementary sign relative  position";
CM_ SG_ 345 TSR_Confidence_6 "Sign classification confidence";
CM_ SG_ 345 TSR_Sign_Shape_6 "Sign Shape (ENUM)";
CM_ SG_ 345 TSR_Sign_Structure_6 "Indicate if the Sign structure is Standard or Electronic.";
CM_ SG_ 345 TSR_Tracking_Age_6 "For now supported for under tracking objects only from multi-frame approval time. Number of frames.";
CM_ SG_ 345 TSR_Sign_Long_Distance_6 "Longitudinal distance to sign (on the ground ) in meters";
CM_ SG_ 345 TSR_Sign_Long_Distance_STD_6 "Longitudinal distance to sign (on the ground ) in meters STD Kalman";
CM_ SG_ 345 TSR_Sign_Lateral_Distance_6 "Lateral distance to sign (on the ground) in meters";
CM_ SG_ 345 TSR_Sign_Lat_Distance_STD_6 "Lateral distance to sign (on the ground) in meters STD Kalman";
CM_ SG_ 345 TSR_Sign_Height_6 "Sign height in meters from camera / refernce point";
CM_ SG_ 345 TSR_Sign_Panel_Height_STD_6 "STD";
CM_ SG_ 345 TSR_Sign_Height_STD_6 "Sign height in meters STD Kalman";
CM_ SG_ 345 TSR_Measurement_Status_6 "Visibility Measurement  status";
CM_ SG_ 345 TSR_AngleZ_6 "The sign horizontal rotation relative to the longitudinal axis of the ego car (0 when the sign is perpendicular). No polarity indication.";
CM_ SG_ 345 TSR_Relevancy_Confidence_6 "Provides score indication for how much the sign is relevant to the Ego vehicle.";
CM_ SG_ 345 TSR_ID_7 "sign ID";
CM_ SG_ 345 TSR_Sign_Name_7 "Sign descriptive name (TSR Signs ENUM)";
CM_ SG_ 345 TSR_Relevancy_7 "Each sign is considered relevant unless non relevant reason is identified. The ENUM represent those reason of reject sign from being relevant by providing the reason.";
CM_ SG_ 345 TSR_Filter_Type_7 "The filter type represent a decision of the AI that this is not a considerable sign. (on truck or road number etc.)";
CM_ SG_ 345 TSR_Sup1_SignName_7 "First Supplementary Sign descriptive name (TSR Signs ENUM)";
CM_ SG_ 345 TSR_Sup1_Confidence_7 "Supp Sign classification confidence";
CM_ SG_ 345 TSR_Sup1_Position_7 "Supplementary sign relative  position";
CM_ SG_ 345 TSR_Sup2_SignName_7 "Second Supplementary Sign descriptive name (TSR Signs ENUM)";
CM_ SG_ 345 TSR_Sup2_Confidence_7 "Supp Sign classification confidence";
CM_ SG_ 345 TSR_Sup2_Position_7 "Supplementary sign relative  position";
CM_ SG_ 345 TSR_Confidence_7 "Sign classification confidence";
CM_ SG_ 345 TSR_Sign_Shape_7 "Sign Shape (ENUM)";
CM_ SG_ 345 TSR_Sign_Structure_7 "Indicate if the Sign structure is Standard or Electronic.";
CM_ SG_ 345 TSR_Tracking_Age_7 "For now supported for under tracking objects only from multi-frame approval time. Number of frames.";
CM_ SG_ 345 TSR_Sign_Long_Distance_7 "Longitudinal distance to sign (on the ground ) in meters";
CM_ SG_ 345 TSR_Sign_Long_Distance_STD_7 "Longitudinal distance to sign (on the ground ) in meters STD Kalman";
CM_ SG_ 345 TSR_Sign_Lateral_Distance_7 "Lateral distance to sign (on the ground) in meters";
CM_ SG_ 345 TSR_Sign_Lat_Distance_STD_7 "Lateral distance to sign (on the ground) in meters STD Kalman";
CM_ SG_ 345 TSR_Sign_Height_7 "Sign height in meters from camera / refernce point";
CM_ SG_ 345 TSR_Sign_Panel_Height_STD_7 "STD";
CM_ SG_ 345 TSR_Sign_Height_STD_7 "Sign height in meters STD Kalman";
CM_ SG_ 345 TSR_Measurement_Status_7 "Visibility Measurement  status";
CM_ SG_ 345 TSR_AngleZ_7 "The sign horizontal rotation relative to the longitudinal axis of the ego car (0 when the sign is perpendicular). No polarity indication.";
CM_ SG_ 345 TSR_Relevancy_Confidence_7 "Provides score indication for how much the sign is relevant to the Ego vehicle.";
CM_ SG_ 400 OBJ_Header_CRC "Calculated over all header signals. From the signal after the CRC until the first signal in the elements OBJ_CRC_0  not including";
CM_ SG_ 400 OBJ_Protocol_Version "Denotes the protocol version";
CM_ SG_ 400 OBJ_Sync_ID "The ID of the Sync message, used to synchronize between signals in the system. Every new frame promotes the sync ID by one.";
CM_ SG_ 400 OBJ_VRU_Count "The number of recognized Vulnerable Road Users (pedestrians, bicycles) in the scene.";
CM_ SG_ 400 OBJ_VD_Count "The number of recognized vehicles in the scene.";
CM_ SG_ 400 OBJ_General_OBJ_Count "The number of recognized General Objects in the scene.";
CM_ SG_ 400 OBJ_VD_NIV_Left "The ID of the closet VD object to the left of the host.";
CM_ SG_ 400 OBJ_Animal_Count "The number of recognized animals in the scene.";
CM_ SG_ 400 OBJ_VD_NIV_Right "The ID of the closet VD object to the right of the host.";
CM_ SG_ 400 OBJ_VD_CIPV_ID "The Current In Path Vehicle (CIPV) object ID.";
CM_ SG_ 400 OBJ_VD_CIPV_Lost "Reports a CIPV loss that cannot be explained to initiate a take over request.";
CM_ SG_ 400 OBJ_VD_Allow_Acc "This signal is intended to suppress acceleration in stop and go ACC scenarios when we suspect something is in our way.";
CM_ SG_ 400 OBJ_Is_Blocked_Left "Indicates whether the left side is blocked for lane change.";
CM_ SG_ 400 OBJ_Is_Blocked_Right "Indicates whether the right side is blocked for lane change.";
CM_ SG_ 401 OBJ_Sync_ID_0_0 "The ID of the Sync message, used to synchronize between signals in the system. Every new frame promotes the sync ID by one.";
CM_ SG_ 401 OBJ_CRC_0 "Calculated over all element signals. From the signal after the CRC until the first signal in the next elements OBJ_CRC_N+1  not including";
CM_ SG_ 401 OBJ_ID_0 "The detected object ID. Range is 1-255, while 0 indicates that the field in unfilled.";
CM_ SG_ 401 OBJ_Existence_Probability_0 "The existence probability of the vehicle";
CM_ SG_ 401 OBJ_Motion_Category_0 "Relevant for VD only. Full description of values can be found at the ACC guide.";
CM_ SG_ 401 OBJ_Object_Age_0 "The number of frames in which the object was recognized.";
CM_ SG_ 401 OBJ_Measuring_Status_0 "Measurment status. Old vs New marks if this is the first frame in which the object is reported. Predicted vs Measured marks if the report is raw or has been predicted forward in time using the measured dynamics and ego motion.";
CM_ SG_ 401 OBJ_Object_Class_0 "Indicates the object type. Uncertain is outputted in case the probability that a vehicle is a truck is very similar to the probability that it is a car.";
CM_ SG_ 401 OBJ_Class_Probability_0 "The probability of this type classification.";
CM_ SG_ 401 OBJ_Motion_Status_0 "MOVING - the object is moving STATIONARY - the object was never seen moving STOPPED -  the object was moving and has stopped MOVING_SLOWLY - the object is moving very slowly";
CM_ SG_ 401 OBJ_Motion_Orientation_0 "The direction of the targets heading compared to the host.";
CM_ SG_ 401 OBJ_Has_Cut_Lane_0 "Indicates whether the object cut the host's (right or left) lane. In case there are no lanes, indicates whether the objects is at most 1 meters away from the host.";
CM_ SG_ 401 OBJ_Has_Cut_Path_0 "Indicates whether the object is in the host's path.";
CM_ SG_ 401 OBJ_Brake_Light_0 "Indication for brake lights";
CM_ SG_ 401 OBJ_Turn_Indicator_Right_0 "Indication for blinking right light.";
CM_ SG_ 401 OBJ_Turn_Indicator_Left_0 "Indication for blinking left light";
CM_ SG_ 401 OBJ_Light_Indicator_Validity_0 "Validator for light indicators";
CM_ SG_ 401 OBJ_Right_Out_Of_Image_0 "Indicates whether the measurment are predicted out of the right side of the image bounderies.";
CM_ SG_ 401 OBJ_Left_Out_Of_Image_0 "Indicates whether if measurment are predicted out of  the left side of the image bounderies";
CM_ SG_ 401 OBJ_Right_Out_Of_Image_V_0 "validator";
CM_ SG_ 401 OBJ_Left_Out_Of_Image_V_0 "validator";
CM_ SG_ 401 OBJ_Top_Out_Of_Image_0 "Indicates whether if measurment are predicted out of  the top of the image bounderies";
CM_ SG_ 401 OBJ_Bottom_Out_Of_Image_0 "Indicates whether if measurment are predicted out of  the bottom of the image bounderies";
CM_ SG_ 401 OBJ_Top_Out_Of_Image_V_0 "validator";
CM_ SG_ 401 OBJ_Bottom_Out_Of_Image_V_0 "validator";
CM_ SG_ 401 OBJ_Lane_Assignment_0 "The object's lane relative to the host lane.";
CM_ SG_ 401 OBJ_Lane_Assignment_V_0 "Validator for lane assignment";
CM_ SG_ 401 OBJ_Age_Seconds_0 "Time in seconds in which the object was recognized.";
CM_ SG_ 401 OBJ_Age_Seconds_V_0 "Validator for object age";
CM_ SG_ 401 OBJ_Width_0 "The width of the target vehicle in the world (not to be mistaken with the width of the visible part of the vehicle).";
CM_ SG_ 401 OBJ_Width_V_0 "Validator for object width";
CM_ SG_ 401 OBJ_Width_STD_0 "Standard deviation for object width";
CM_ SG_ 401 OBJ_Width_STD_V_0 "Validator for the standard deviation of object width";
CM_ SG_ 401 OBJ_Length_0 "The length of the vehicle in the world. For crossing bicycles it gives the viewed length of the bicycle.";
CM_ SG_ 401 OBJ_Length_V_0 "Validator for object length.";
CM_ SG_ 401 OBJ_Length_STD_0 "Standard deviation for object length.";
CM_ SG_ 401 OBJ_Length_STD_V_0 "Validator for the standard deviation of object length.";
CM_ SG_ 401 OBJ_Height_0 "The height of the object in the world.";
CM_ SG_ 401 OBJ_Height_V_0 "Validator for object height.";
CM_ SG_ 401 OBJ_Height_STD_0 "Standard deviation for object height.";
CM_ SG_ 401 OBJ_Height_STD_V_0 "Validator for the standard deviation of object height.";
CM_ SG_ 401 OBJ_Abs_Long_Velocity_0 "Absolute longitudinal velocity.";
CM_ SG_ 401 OBJ_Abs_Long_Velocity_V_0 "Validator for absolute longitudinal velocity.";
CM_ SG_ 401 OBJ_Abs_Long_Velocity_STD_0 "Standard deviation of absolute longitudinal velocity.";
CM_ SG_ 401 OBJ_Abs_Long_Vel_STD_V_0 "Validator for the standard deviation of the absolute longitudinal velocity.";
CM_ SG_ 401 OBJ_Abs_Lat_Velocity_0 "The lateral ground speed of the object.";
CM_ SG_ 401 OBJ_Abs_Lat_Velocity_V_0 "Validator for the lateral ground speed of the object.";
CM_ SG_ 401 OBJ_Abs_Lat_Velocity_STD_0 "STD of the lateral ground speed of the object.";
CM_ SG_ 401 OBJ_Abs_Lat_Vel_STD_V_0 "Validator for the STD of the lateral ground speed of the object.";
CM_ SG_ 401 OBJ_Abs_Long_Acc_0 "The longitudinal ground acceleration of the object.";
CM_ SG_ 401 OBJ_Abs_Long_Acc_V_0 "Validator for the longitudinal ground acceleration of the object.";
CM_ SG_ 401 OBJ_Abs_Long_Acc_STD_0 "STD of the longitudinal ground acceleration of the object.";
CM_ SG_ 401 OBJ_Abs_Long_Acc_STD_V_0 "Validator for the STD of the longitudinal ground acceleration of the object.";
CM_ SG_ 401 OBJ_Abs_Lat_Acc_0 "The lateral ground acceleration of the object.";
CM_ SG_ 401 OBJ_Abs_Lat_Acc_V_0 "Validator for the lateral ground acceleration of the object.";
CM_ SG_ 401 OBJ_Abs_Lat_Acc_STD_0 "STD of the lateral ground acceleration of the object.";
CM_ SG_ 401 OBJ_Abs_Lat_Acc_STD_V_0 "Validator for the STD of the lateral ground acceleration of the object.";
CM_ SG_ 401 OBJ_Abs_Acceleration_0 "The absolute ground acceleration in the target's heading direction.";
CM_ SG_ 401 OBJ_Abs_Acceleration_V_0 "Validator for the absolute ground acceleration.";
CM_ SG_ 401 OBJ_Abs_Acc_STD_0 "STD of the absolute ground acceleration.";
CM_ SG_ 401 OBJ_Abs_Acc_STD_V_0 "Validator for the STD of the absolute ground acceleration.";
CM_ SG_ 401 OBJ_Inv_TTC_0 "Inverse TTC (time to collision).";
CM_ SG_ 401 OBJ_Inv_TTC_STD_0 "STD for inverse TTC .";
CM_ SG_ 401 OBJ_Inv_TTC_STD_V_0 "Validator for the STD for inverse TTC .";
CM_ SG_ 401 OBJ_Relative_Long_Acc_0 "The relative lateral ground acceleration of the object.";
CM_ SG_ 401 OBJ_Relative_Long_Acc_V_0 "Validator for the relative lateral ground acceleration of the object.";
CM_ SG_ 401 OBJ_Relative_Long_Acc_STD_0 "STD of the relative lateral ground acceleration of the object.";
CM_ SG_ 401 OBJ_Rel_Long_Acc_STD_V_0 "Validator for the STD of the relative lateral ground acceleration.";
CM_ SG_ 401 OBJ_Relative_Long_Velocity_0 "The relative longtitudinal speed between the target and ego vehicle.";
CM_ SG_ 401 OBJ_Relative_Long_Velocity_V_0 "Validator for the relative longtitudinal speed.";
CM_ SG_ 401 OBJ_Relative_Long_Vel_STD_0 "STD of the relative longtitudinal speed.";
CM_ SG_ 401 OBJ_Rel_Long_Vel_STD_V_0 "Validator for the STD of the relative longtitudinal speed.";
CM_ SG_ 402 OBJ_Sync_ID_0_1 "The ID of the Sync message, used to synchronize between signals in the system. Every new frame promotes the sync ID by one.";
CM_ SG_ 402 OBJ_Relative_Lat_Velocity_0 "The relative lateral speed between the target and ego vehicle.";
CM_ SG_ 402 OBJ_Relative_Lat_Velocity_V_0 "Validator for the relative lateral speed.";
CM_ SG_ 402 OBJ_Relative_Lat_Velocity_STD_0 "STD of the relative lateral speed.";
CM_ SG_ 402 OBJ_Rel_Lat_Vel_STD_V_0 "Validator for the STD of the relative lateral speed.";
CM_ SG_ 402 OBJ_Long_Distance_0 "The longtitudinal distance from the object to middle of the rear bumper (middle of the RL and RR corners) of the target.";
CM_ SG_ 402 OBJ_Long_Distance_V_0 "Validator of the longtitudinal distance field";
CM_ SG_ 402 OBJ_Long_Distance_STD_0 "STD of the  longtitudinal distance.";
CM_ SG_ 402 OBJ_Long_Distance_STD_V_0 "Validator for the STD of the  longtitudinal distance.";
CM_ SG_ 402 OBJ_Lat_Distance_0 "Lateral distance to the middle of the RL and RR corners.";
CM_ SG_ 402 OBJ_Lat_Distance_V_0 "Validator for the lateral distance of the object.";
CM_ SG_ 402 OBJ_Lat_Distance_STD_0 "STD of the lateral distance of the object.";
CM_ SG_ 402 OBJ_Lat_Distance_STD_V_0 "Validator for the STD of the lateral distance of the object.";
CM_ SG_ 402 OBJ_Absolute_Speed_0 "The absolute ground speed in the targets' heading direction.";
CM_ SG_ 402 OBJ_Absolute_Speed_V_0 "Validator for the absolute ground speed.";
CM_ SG_ 402 OBJ_Absolute_Speed_STD_0 "STD of the absolute ground speed.";
CM_ SG_ 402 OBJ_Absolute_Speed_STD_V_0 "Validator for the STD of the absolute ground speed.";
CM_ SG_ 402 OBJ_Heading_0 "The angle beetweenthe host longitudinal axis and target's heading (clockwise, e.g. PI/2 is a target crossing from left to right).";
CM_ SG_ 402 OBJ_Heading_V_0 "Validator for the object heading.";
CM_ SG_ 402 OBJ_Heading_STD_0 "STD of the object heading.";
CM_ SG_ 402 OBJ_Heading_STD_V_0 "Validator for the STD of the object heading.";
CM_ SG_ 402 OBJ_Angle_Rate_STD_0 "Standard deviation of the angular speed. (radians)";
CM_ SG_ 402 OBJ_Angle_Rate_STD_V_0 "Validator for the STD of the angular speed.";
CM_ SG_ 402 OBJ_Angle_Rate_0 "The momentary angular speed of the object. (radians)";
CM_ SG_ 402 OBJ_Angle_Rate_V_0 "Validator for the angular speed.";
CM_ SG_ 402 OBJ_Angle_Right_0 "The angle between the host longitudinal axis and the right side of the front / rear of the target (the visible one). The positive side is to the host's right.";
CM_ SG_ 402 OBJ_Angle_Right_V_0 "Validator for angleRight";
CM_ SG_ 402 OBJ_Angle_Right_STD_0 "Standard deviation of angleRight";
CM_ SG_ 402 OBJ_Angle_Right_STD_V_0 "Validator for the standard deviation of angleRight.";
CM_ SG_ 402 OBJ_Angle_Left_0 "The angle between the host longitudinal axis and the left side of the front / rear of the target (the visible one). The positive side is to the host's right.";
CM_ SG_ 402 OBJ_Angle_Left_V_0 "Validator for angleLeft.";
CM_ SG_ 402 OBJ_Angle_Left_STD_0 "Standard deviation of angleLeft.";
CM_ SG_ 402 OBJ_Angle_Left_STD_V_0 "Validator for the standard deviation of angleLeft.";
CM_ SG_ 402 OBJ_Angle_Side_0 "The angle between the host longitudinal axis and the far visible edge - the visible edge of the front / rear of the target that is not visible. Currently supported for vehicles only.";
CM_ SG_ 402 OBJ_Angle_Side_V_0 "Validator for angleSide.";
CM_ SG_ 402 OBJ_Angle_Side_STD_0 "Standard deviation of angleSide.";
CM_ SG_ 402 OBJ_Angle_Side_STD_V_0 "Validator for the STD of angleSide.";
CM_ SG_ 402 OBJ_Angle_Mid_V_0 "Validator for angleMid.";
CM_ SG_ 402 OBJ_Angle_Mid_0 "The angle between the host longitudinal axis and the middle of the front / rear of the target (the visible one). The positive side is to the host's right.";
CM_ SG_ 402 OBJ_Angle_Mid_STD_0 "Standard deviation of angleMid.";
CM_ SG_ 402 OBJ_Angle_Mid_STD_V_0 "Validator for the STD of angleMid.";
CM_ SG_ 402 OBJ_Angle_Bottom_V_0 "Validator for OBJAngle_Bottom.";
CM_ SG_ 402 OBJ_Angle_Bottom_0 "The angle between the longitudinal axis and the Bottom of the front / rear of the target (the visible one). The positive side is to the host's bottom";
CM_ SG_ 402 OBJ_Angle_Bottom_STD_0 "STD for OBJAngle_Bottom.";
CM_ SG_ 402 OBJ_Angle_Bottom_STD_V_0 "Validator for OBJAngle_Bottom_STD.";
CM_ SG_ 402 OBJ_Visibility_Side_V_0 "Currently Supported for VD only";
CM_ SG_ 402 OBJ_Visibility_Side_0 "From what car  side is the object visible";
CM_ SG_ 402 OBJ_Is_In_Drivable_Area_0 "Indicates whether the target is in a driveable area.";
CM_ SG_ 402 OBJ_Is_In_Drivable_Area_V_0 "Validator for OBJ_Is_In_Drivable_Area.";
CM_ SG_ 402 OBJ_Is_VeryClose_V_0 "Validator for OBJ_Is_VeryClose.";
CM_ SG_ 402 OBJ_Is_VeryClose_0 "Indicates whether the target is very close to the host such that it is hard to measure its distance. Currently relevant for peds only";
CM_ SG_ 402 OBJ_Is_EMERGENCY_VCL_0 "Is Object an Emergency Vehicle";
CM_ SG_ 402 OBJ_EMERGENCY_LIGHT_COLOR_0 "Emergency Color";
CM_ SG_ 402 OBJ_EMERGENCY_V_0 "Are OBJ_Is_EMERGENCY_VCL and OBJ_EMERGENCY_LIGHT_COLOR Valid";
CM_ SG_ 403 OBJ_Sync_ID_1_0 "The ID of the Sync message, used to synchronize between signals in the system. Every new frame promotes the sync ID by one.";
CM_ SG_ 403 OBJ_CRC_1 "Calculated over all element signals. From the signal after the CRC until the first signal in the next elements OBJ_CRC_N+1  not including";
CM_ SG_ 403 OBJ_ID_1 "The detected object ID. Range is 1-255, while 0 indicates that the field in unfilled.";
CM_ SG_ 403 OBJ_Existence_Probability_1 "The existence probability of the vehicle";
CM_ SG_ 403 OBJ_Motion_Category_1 "Relevant for VD only. Full description of values can be found at the ACC guide.";
CM_ SG_ 403 OBJ_Object_Age_1 "The number of frames in which the object was recognized.";
CM_ SG_ 403 OBJ_Measuring_Status_1 "Measurment status. Old vs New marks if this is the first frame in which the object is reported. Predicted vs Measured marks if the report is raw or has been predicted forward in time using the measured dynamics and ego motion.";
CM_ SG_ 403 OBJ_Object_Class_1 "Indicates the object type. Uncertain is outputted in case the probability that a vehicle is a truck is very similar to the probability that it is a car.";
CM_ SG_ 403 OBJ_Class_Probability_1 "The probability of this type classification.";
CM_ SG_ 403 OBJ_Motion_Status_1 "MOVING - the object is moving STATIONARY - the object was never seen moving STOPPED -  the object was moving and has stopped MOVING_SLOWLY - the object is moving very slowly";
CM_ SG_ 403 OBJ_Motion_Orientation_1 "The direction of the targets heading compared to the host.";
CM_ SG_ 403 OBJ_Has_Cut_Lane_1 "Indicates whether the object cut the host's (right or left) lane. In case there are no lanes, indicates whether the objects is at most 1 meters away from the host.";
CM_ SG_ 403 OBJ_Has_Cut_Path_1 "Indicates whether the object is in the host's path.";
CM_ SG_ 403 OBJ_Brake_Light_1 "Indication for brake lights";
CM_ SG_ 403 OBJ_Turn_Indicator_Right_1 "Indication for blinking right light.";
CM_ SG_ 403 OBJ_Turn_Indicator_Left_1 "Indication for blinking left light";
CM_ SG_ 403 OBJ_Light_Indicator_Validity_1 "Validator for light indicators";
CM_ SG_ 403 OBJ_Right_Out_Of_Image_1 "Indicates whether the measurment are predicted out of the right side of the image bounderies.";
CM_ SG_ 403 OBJ_Left_Out_Of_Image_1 "Indicates whether if measurment are predicted out of  the left side of the image bounderies";
CM_ SG_ 403 OBJ_Right_Out_Of_Image_V_1 "validator";
CM_ SG_ 403 OBJ_Left_Out_Of_Image_V_1 "validator";
CM_ SG_ 403 OBJ_Top_Out_Of_Image_1 "Indicates whether if measurment are predicted out of  the top of the image bounderies";
CM_ SG_ 403 OBJ_Bottom_Out_Of_Image_1 "Indicates whether if measurment are predicted out of  the bottom of the image bounderies";
CM_ SG_ 403 OBJ_Top_Out_Of_Image_V_1 "validator";
CM_ SG_ 403 OBJ_Bottom_Out_Of_Image_V_1 "validator";
CM_ SG_ 403 OBJ_Lane_Assignment_1 "The object's lane relative to the host lane.";
CM_ SG_ 403 OBJ_Lane_Assignment_V_1 "Validator for lane assignment";
CM_ SG_ 403 OBJ_Age_Seconds_1 "Time in seconds in which the object was recognized.";
CM_ SG_ 403 OBJ_Age_Seconds_V_1 "Validator for object age";
CM_ SG_ 403 OBJ_Width_1 "The width of the target vehicle in the world (not to be mistaken with the width of the visible part of the vehicle).";
CM_ SG_ 403 OBJ_Width_V_1 "Validator for object width";
CM_ SG_ 403 OBJ_Width_STD_1 "Standard deviation for object width";
CM_ SG_ 403 OBJ_Width_STD_V_1 "Validator for the standard deviation of object width";
CM_ SG_ 403 OBJ_Length_1 "The length of the vehicle in the world. For crossing bicycles it gives the viewed length of the bicycle.";
CM_ SG_ 403 OBJ_Length_V_1 "Validator for object length.";
CM_ SG_ 403 OBJ_Length_STD_1 "Standard deviation for object length.";
CM_ SG_ 403 OBJ_Length_STD_V_1 "Validator for the standard deviation of object length.";
CM_ SG_ 403 OBJ_Height_1 "The height of the object in the world.";
CM_ SG_ 403 OBJ_Height_V_1 "Validator for object height.";
CM_ SG_ 403 OBJ_Height_STD_1 "Standard deviation for object height.";
CM_ SG_ 403 OBJ_Height_STD_V_1 "Validator for the standard deviation of object height.";
CM_ SG_ 403 OBJ_Abs_Long_Velocity_1 "Absolute longitudinal velocity.";
CM_ SG_ 403 OBJ_Abs_Long_Velocity_V_1 "Validator for absolute longitudinal velocity.";
CM_ SG_ 403 OBJ_Abs_Long_Velocity_STD_1 "Standard deviation of absolute longitudinal velocity.";
CM_ SG_ 403 OBJ_Abs_Long_Vel_STD_V_1 "Validator for the standard deviation of the absolute longitudinal velocity.";
CM_ SG_ 403 OBJ_Abs_Lat_Velocity_1 "The lateral ground speed of the object.";
CM_ SG_ 403 OBJ_Abs_Lat_Velocity_V_1 "Validator for the lateral ground speed of the object.";
CM_ SG_ 403 OBJ_Abs_Lat_Velocity_STD_1 "STD of the lateral ground speed of the object.";
CM_ SG_ 403 OBJ_Abs_Lat_Vel_STD_V_1 "Validator for the STD of the lateral ground speed of the object.";
CM_ SG_ 403 OBJ_Abs_Long_Acc_1 "The longitudinal ground acceleration of the object.";
CM_ SG_ 403 OBJ_Abs_Long_Acc_V_1 "Validator for the longitudinal ground acceleration of the object.";
CM_ SG_ 403 OBJ_Abs_Long_Acc_STD_1 "STD of the longitudinal ground acceleration of the object.";
CM_ SG_ 403 OBJ_Abs_Long_Acc_STD_V_1 "Validator for the STD of the longitudinal ground acceleration of the object.";
CM_ SG_ 403 OBJ_Abs_Lat_Acc_1 "The lateral ground acceleration of the object.";
CM_ SG_ 403 OBJ_Abs_Lat_Acc_V_1 "Validator for the lateral ground acceleration of the object.";
CM_ SG_ 403 OBJ_Abs_Lat_Acc_STD_1 "STD of the lateral ground acceleration of the object.";
CM_ SG_ 403 OBJ_Abs_Lat_Acc_STD_V_1 "Validator for the STD of the lateral ground acceleration of the object.";
CM_ SG_ 403 OBJ_Abs_Acceleration_1 "The absolute ground acceleration in the target's heading direction.";
CM_ SG_ 403 OBJ_Abs_Acceleration_V_1 "Validator for the absolute ground acceleration.";
CM_ SG_ 403 OBJ_Abs_Acc_STD_1 "STD of the absolute ground acceleration.";
CM_ SG_ 403 OBJ_Abs_Acc_STD_V_1 "Validator for the STD of the absolute ground acceleration.";
CM_ SG_ 403 OBJ_Inv_TTC_1 "Inverse TTC (time to collision).";
CM_ SG_ 403 OBJ_Inv_TTC_STD_1 "STD for inverse TTC .";
CM_ SG_ 403 OBJ_Inv_TTC_STD_V_1 "Validator for the STD for inverse TTC .";
CM_ SG_ 403 OBJ_Relative_Long_Acc_1 "The relative lateral ground acceleration of the object.";
CM_ SG_ 403 OBJ_Relative_Long_Acc_V_1 "Validator for the relative lateral ground acceleration of the object.";
CM_ SG_ 403 OBJ_Relative_Long_Acc_STD_1 "STD of the relative lateral ground acceleration of the object.";
CM_ SG_ 403 OBJ_Rel_Long_Acc_STD_V_1 "Validator for the STD of the relative lateral ground acceleration.";
CM_ SG_ 403 OBJ_Relative_Long_Velocity_1 "The relative longtitudinal speed between the target and ego vehicle.";
CM_ SG_ 403 OBJ_Relative_Long_Velocity_V_1 "Validator for the relative longtitudinal speed.";
CM_ SG_ 403 OBJ_Relative_Long_Vel_STD_1 "STD of the relative longtitudinal speed.";
CM_ SG_ 403 OBJ_Rel_Long_Vel_STD_V_1 "Validator for the STD of the relative longtitudinal speed.";
CM_ SG_ 404 OBJ_Sync_ID_1_1 "The ID of the Sync message, used to synchronize between signals in the system. Every new frame promotes the sync ID by one.";
CM_ SG_ 404 OBJ_Relative_Lat_Velocity_1 "The relative lateral speed between the target and ego vehicle.";
CM_ SG_ 404 OBJ_Relative_Lat_Velocity_V_1 "Validator for the relative lateral speed.";
CM_ SG_ 404 OBJ_Relative_Lat_Velocity_STD_1 "STD of the relative lateral speed.";
CM_ SG_ 404 OBJ_Rel_Lat_Vel_STD_V_1 "Validator for the STD of the relative lateral speed.";
CM_ SG_ 404 OBJ_Long_Distance_1 "The longtitudinal distance from the object to middle of the rear bumper (middle of the RL and RR corners) of the target.";
CM_ SG_ 404 OBJ_Long_Distance_V_1 "Validator of the longtitudinal distance field";
CM_ SG_ 404 OBJ_Long_Distance_STD_1 "STD of the  longtitudinal distance.";
CM_ SG_ 404 OBJ_Long_Distance_STD_V_1 "Validator for the STD of the  longtitudinal distance.";
CM_ SG_ 404 OBJ_Lat_Distance_1 "Lateral distance to the middle of the RL and RR corners.";
CM_ SG_ 404 OBJ_Lat_Distance_V_1 "Validator for the lateral distance of the object.";
CM_ SG_ 404 OBJ_Lat_Distance_STD_1 "STD of the lateral distance of the object.";
CM_ SG_ 404 OBJ_Lat_Distance_STD_V_1 "Validator for the STD of the lateral distance of the object.";
CM_ SG_ 404 OBJ_Absolute_Speed_1 "The absolute ground speed in the targets' heading direction.";
CM_ SG_ 404 OBJ_Absolute_Speed_V_1 "Validator for the absolute ground speed.";
CM_ SG_ 404 OBJ_Absolute_Speed_STD_1 "STD of the absolute ground speed.";
CM_ SG_ 404 OBJ_Absolute_Speed_STD_V_1 "Validator for the STD of the absolute ground speed.";
CM_ SG_ 404 OBJ_Heading_1 "The angle beetweenthe host longitudinal axis and target's heading (clockwise, e.g. PI/2 is a target crossing from left to right).";
CM_ SG_ 404 OBJ_Heading_V_1 "Validator for the object heading.";
CM_ SG_ 404 OBJ_Heading_STD_1 "STD of the object heading.";
CM_ SG_ 404 OBJ_Heading_STD_V_1 "Validator for the STD of the object heading.";
CM_ SG_ 404 OBJ_Angle_Rate_STD_1 "Standard deviation of the angular speed. (radians)";
CM_ SG_ 404 OBJ_Angle_Rate_STD_V_1 "Validator for the STD of the angular speed.";
CM_ SG_ 404 OBJ_Angle_Rate_1 "The momentary angular speed of the object. (radians)";
CM_ SG_ 404 OBJ_Angle_Rate_V_1 "Validator for the angular speed.";
CM_ SG_ 404 OBJ_Angle_Right_1 "The angle between the host longitudinal axis and the right side of the front / rear of the target (the visible one). The positive side is to the host's right.";
CM_ SG_ 404 OBJ_Angle_Right_V_1 "Validator for angleRight";
CM_ SG_ 404 OBJ_Angle_Right_STD_1 "Standard deviation of angleRight";
CM_ SG_ 404 OBJ_Angle_Right_STD_V_1 "Validator for the standard deviation of angleRight.";
CM_ SG_ 404 OBJ_Angle_Left_1 "The angle between the host longitudinal axis and the left side of the front / rear of the target (the visible one). The positive side is to the host's right.";
CM_ SG_ 404 OBJ_Angle_Left_V_1 "Validator for angleLeft.";
CM_ SG_ 404 OBJ_Angle_Left_STD_1 "Standard deviation of angleLeft.";
CM_ SG_ 404 OBJ_Angle_Left_STD_V_1 "Validator for the standard deviation of angleLeft.";
CM_ SG_ 404 OBJ_Angle_Side_1 "The angle between the host longitudinal axis and the far visible edge - the visible edge of the front / rear of the target that is not visible. Currently supported for vehicles only.";
CM_ SG_ 404 OBJ_Angle_Side_V_1 "Validator for angleSide.";
CM_ SG_ 404 OBJ_Angle_Side_STD_1 "Standard deviation of angleSide.";
CM_ SG_ 404 OBJ_Angle_Side_STD_V_1 "Validator for the STD of angleSide.";
CM_ SG_ 404 OBJ_Angle_Mid_V_1 "Validator for angleMid.";
CM_ SG_ 404 OBJ_Angle_Mid_1 "The angle between the host longitudinal axis and the middle of the front / rear of the target (the visible one). The positive side is to the host's right.";
CM_ SG_ 404 OBJ_Angle_Mid_STD_1 "Standard deviation of angleMid.";
CM_ SG_ 404 OBJ_Angle_Mid_STD_V_1 "Validator for the STD of angleMid.";
CM_ SG_ 404 OBJ_Angle_Bottom_V_1 "Validator for OBJAngle_Bottom.";
CM_ SG_ 404 OBJ_Angle_Bottom_1 "The angle between the longitudinal axis and the Bottom of the front / rear of the target (the visible one). The positive side is to the host's bottom";
CM_ SG_ 404 OBJ_Angle_Bottom_STD_1 "STD for OBJAngle_Bottom.";
CM_ SG_ 404 OBJ_Angle_Bottom_STD_V_1 "Validator for OBJAngle_Bottom_STD.";
CM_ SG_ 404 OBJ_Visibility_Side_V_1 "Currently Supported for VD only";
CM_ SG_ 404 OBJ_Visibility_Side_1 "From what car  side is the object visible";
CM_ SG_ 404 OBJ_Is_In_Drivable_Area_1 "Indicates whether the target is in a driveable area.";
CM_ SG_ 404 OBJ_Is_In_Drivable_Area_V_1 "Validator for OBJ_Is_In_Drivable_Area.";
CM_ SG_ 404 OBJ_Is_VeryClose_V_1 "Validator for OBJ_Is_VeryClose.";
CM_ SG_ 404 OBJ_Is_VeryClose_1 "Indicates whether the target is very close to the host such that it is hard to measure its distance. Currently relevant for peds only";
CM_ SG_ 404 OBJ_Is_EMERGENCY_VCL_1 "Is Object an Emergency Vehicle";
CM_ SG_ 404 OBJ_EMERGENCY_LIGHT_COLOR_1 "Emergency Color";
CM_ SG_ 404 OBJ_EMERGENCY_V_1 "Are OBJ_Is_EMERGENCY_VCL and OBJ_EMERGENCY_LIGHT_COLOR Valid";
CM_ SG_ 405 OBJ_Sync_ID_2_0 "The ID of the Sync message, used to synchronize between signals in the system. Every new frame promotes the sync ID by one.";
CM_ SG_ 405 OBJ_CRC_2 "Calculated over all element signals. From the signal after the CRC until the first signal in the next elements OBJ_CRC_N+1  not including";
CM_ SG_ 405 OBJ_ID_2 "The detected object ID. Range is 1-255, while 0 indicates that the field in unfilled.";
CM_ SG_ 405 OBJ_Existence_Probability_2 "The existence probability of the vehicle";
CM_ SG_ 405 OBJ_Motion_Category_2 "Relevant for VD only. Full description of values can be found at the ACC guide.";
CM_ SG_ 405 OBJ_Object_Age_2 "The number of frames in which the object was recognized.";
CM_ SG_ 405 OBJ_Measuring_Status_2 "Measurment status. Old vs New marks if this is the first frame in which the object is reported. Predicted vs Measured marks if the report is raw or has been predicted forward in time using the measured dynamics and ego motion.";
CM_ SG_ 405 OBJ_Object_Class_2 "Indicates the object type. Uncertain is outputted in case the probability that a vehicle is a truck is very similar to the probability that it is a car.";
CM_ SG_ 405 OBJ_Class_Probability_2 "The probability of this type classification.";
CM_ SG_ 405 OBJ_Motion_Status_2 "MOVING - the object is moving STATIONARY - the object was never seen moving STOPPED -  the object was moving and has stopped MOVING_SLOWLY - the object is moving very slowly";
CM_ SG_ 405 OBJ_Motion_Orientation_2 "The direction of the targets heading compared to the host.";
CM_ SG_ 405 OBJ_Has_Cut_Lane_2 "Indicates whether the object cut the host's (right or left) lane. In case there are no lanes, indicates whether the objects is at most 1 meters away from the host.";
CM_ SG_ 405 OBJ_Has_Cut_Path_2 "Indicates whether the object is in the host's path.";
CM_ SG_ 405 OBJ_Brake_Light_2 "Indication for brake lights";
CM_ SG_ 405 OBJ_Turn_Indicator_Right_2 "Indication for blinking right light.";
CM_ SG_ 405 OBJ_Turn_Indicator_Left_2 "Indication for blinking left light";
CM_ SG_ 405 OBJ_Light_Indicator_Validity_2 "Validator for light indicators";
CM_ SG_ 405 OBJ_Right_Out_Of_Image_2 "Indicates whether the measurment are predicted out of the right side of the image bounderies.";
CM_ SG_ 405 OBJ_Left_Out_Of_Image_2 "Indicates whether if measurment are predicted out of  the left side of the image bounderies";
CM_ SG_ 405 OBJ_Right_Out_Of_Image_V_2 "validator";
CM_ SG_ 405 OBJ_Left_Out_Of_Image_V_2 "validator";
CM_ SG_ 405 OBJ_Top_Out_Of_Image_2 "Indicates whether if measurment are predicted out of  the top of the image bounderies";
CM_ SG_ 405 OBJ_Bottom_Out_Of_Image_2 "Indicates whether if measurment are predicted out of  the bottom of the image bounderies";
CM_ SG_ 405 OBJ_Top_Out_Of_Image_V_2 "validator";
CM_ SG_ 405 OBJ_Bottom_Out_Of_Image_V_2 "validator";
CM_ SG_ 405 OBJ_Lane_Assignment_2 "The object's lane relative to the host lane.";
CM_ SG_ 405 OBJ_Lane_Assignment_V_2 "Validator for lane assignment";
CM_ SG_ 405 OBJ_Age_Seconds_2 "Time in seconds in which the object was recognized.";
CM_ SG_ 405 OBJ_Age_Seconds_V_2 "Validator for object age";
CM_ SG_ 405 OBJ_Width_2 "The width of the target vehicle in the world (not to be mistaken with the width of the visible part of the vehicle).";
CM_ SG_ 405 OBJ_Width_V_2 "Validator for object width";
CM_ SG_ 405 OBJ_Width_STD_2 "Standard deviation for object width";
CM_ SG_ 405 OBJ_Width_STD_V_2 "Validator for the standard deviation of object width";
CM_ SG_ 405 OBJ_Length_2 "The length of the vehicle in the world. For crossing bicycles it gives the viewed length of the bicycle.";
CM_ SG_ 405 OBJ_Length_V_2 "Validator for object length.";
CM_ SG_ 405 OBJ_Length_STD_2 "Standard deviation for object length.";
CM_ SG_ 405 OBJ_Length_STD_V_2 "Validator for the standard deviation of object length.";
CM_ SG_ 405 OBJ_Height_2 "The height of the object in the world.";
CM_ SG_ 405 OBJ_Height_V_2 "Validator for object height.";
CM_ SG_ 405 OBJ_Height_STD_2 "Standard deviation for object height.";
CM_ SG_ 405 OBJ_Height_STD_V_2 "Validator for the standard deviation of object height.";
CM_ SG_ 405 OBJ_Abs_Long_Velocity_2 "Absolute longitudinal velocity.";
CM_ SG_ 405 OBJ_Abs_Long_Velocity_V_2 "Validator for absolute longitudinal velocity.";
CM_ SG_ 405 OBJ_Abs_Long_Velocity_STD_2 "Standard deviation of absolute longitudinal velocity.";
CM_ SG_ 405 OBJ_Abs_Long_Vel_STD_V_2 "Validator for the standard deviation of the absolute longitudinal velocity.";
CM_ SG_ 405 OBJ_Abs_Lat_Velocity_2 "The lateral ground speed of the object.";
CM_ SG_ 405 OBJ_Abs_Lat_Velocity_V_2 "Validator for the lateral ground speed of the object.";
CM_ SG_ 405 OBJ_Abs_Lat_Velocity_STD_2 "STD of the lateral ground speed of the object.";
CM_ SG_ 405 OBJ_Abs_Lat_Vel_STD_V_2 "Validator for the STD of the lateral ground speed of the object.";
CM_ SG_ 405 OBJ_Abs_Long_Acc_2 "The longitudinal ground acceleration of the object.";
CM_ SG_ 405 OBJ_Abs_Long_Acc_V_2 "Validator for the longitudinal ground acceleration of the object.";
CM_ SG_ 405 OBJ_Abs_Long_Acc_STD_2 "STD of the longitudinal ground acceleration of the object.";
CM_ SG_ 405 OBJ_Abs_Long_Acc_STD_V_2 "Validator for the STD of the longitudinal ground acceleration of the object.";
CM_ SG_ 405 OBJ_Abs_Lat_Acc_2 "The lateral ground acceleration of the object.";
CM_ SG_ 405 OBJ_Abs_Lat_Acc_V_2 "Validator for the lateral ground acceleration of the object.";
CM_ SG_ 405 OBJ_Abs_Lat_Acc_STD_2 "STD of the lateral ground acceleration of the object.";
CM_ SG_ 405 OBJ_Abs_Lat_Acc_STD_V_2 "Validator for the STD of the lateral ground acceleration of the object.";
CM_ SG_ 405 OBJ_Abs_Acceleration_2 "The absolute ground acceleration in the target's heading direction.";
CM_ SG_ 405 OBJ_Abs_Acceleration_V_2 "Validator for the absolute ground acceleration.";
CM_ SG_ 405 OBJ_Abs_Acc_STD_2 "STD of the absolute ground acceleration.";
CM_ SG_ 405 OBJ_Abs_Acc_STD_V_2 "Validator for the STD of the absolute ground acceleration.";
CM_ SG_ 405 OBJ_Inv_TTC_2 "Inverse TTC (time to collision).";
CM_ SG_ 405 OBJ_Inv_TTC_STD_2 "STD for inverse TTC .";
CM_ SG_ 405 OBJ_Inv_TTC_STD_V_2 "Validator for the STD for inverse TTC .";
CM_ SG_ 405 OBJ_Relative_Long_Acc_2 "The relative lateral ground acceleration of the object.";
CM_ SG_ 405 OBJ_Relative_Long_Acc_V_2 "Validator for the relative lateral ground acceleration of the object.";
CM_ SG_ 405 OBJ_Relative_Long_Acc_STD_2 "STD of the relative lateral ground acceleration of the object.";
CM_ SG_ 405 OBJ_Rel_Long_Acc_STD_V_2 "Validator for the STD of the relative lateral ground acceleration.";
CM_ SG_ 405 OBJ_Relative_Long_Velocity_2 "The relative longtitudinal speed between the target and ego vehicle.";
CM_ SG_ 405 OBJ_Relative_Long_Velocity_V_2 "Validator for the relative longtitudinal speed.";
CM_ SG_ 405 OBJ_Relative_Long_Vel_STD_2 "STD of the relative longtitudinal speed.";
CM_ SG_ 405 OBJ_Rel_Long_Vel_STD_V_2 "Validator for the STD of the relative longtitudinal speed.";
BA_DEF_ EV_  "NmMessageCount" INT 2 128;
BA_DEF_ EV_  "NmType" STRING ;
BA_DEF_ SG_  "GenSigSendType" ENUM  "Cyclic","OnChange","OnWrite","IfActive","OnChangeWithRepetition","OnWriteWithRepetition","IfActiveWithRepetition","CA","CE","Event","NoSigSendType";
BA_DEF_ SG_  "GenSigStartValue" INT 0 0;
BA_DEF_ BO_  "VFrameFormat" ENUM  "StandardCAN","ExtendedCAN","reserved","J1939PG","reserved","reserved","reserved","reserved","reserved","reserved","reserved","reserved","reserved","reserved","StandardCAN_FD","ExtendedCAN_FD";
BA_DEF_ BO_  "FunReqGroup" INT 0 250;
BA_DEF_ BO_  "Receivers" STRING ;
BA_DEF_ BO_  "Transmitters" STRING ;
BA_DEF_ BO_  "DiagReqFun" ENUM  "NO","YES";
BA_DEF_ BO_  "DiagReqPhy" ENUM  "NO","YES";
BA_DEF_ BO_  "DiagResp" ENUM  "NO","YES";
BA_DEF_ BO_  "GenMsgTimeoutValue" INT 0 65535;
BA_DEF_ BO_  "GenMsgSendType" ENUM  "Cyclic","NoMsgSendType","IfActive","Event","CA","CE";
BA_DEF_ BO_  "GenMsgCycleTime" INT 0 10000;
BA_DEF_ BO_  "CANFD_BRS" ENUM  "0","1";
BA_DEF_ BO_  "GenMsgILSupport" ENUM  "No","Yes";
BA_DEF_ BU_  "BitOrder" ENUM  "LSB","MSB";
BA_DEF_  "NmBaseAddress" HEX 1024 1087;
BA_DEF_  "BusType" STRING ;
BA_DEF_  "DBName" STRING ;
BA_DEF_DEF_  "NmMessageCount" 32;
BA_DEF_DEF_  "NmType" "Default";
BA_DEF_DEF_  "GenSigSendType" "Cyclic";
BA_DEF_DEF_  "GenSigStartValue" 0;
BA_DEF_DEF_  "VFrameFormat" "ExtendedCAN";
BA_DEF_DEF_  "FunReqGroup" 0;
BA_DEF_DEF_  "Receivers" "Default";
BA_DEF_DEF_  "Transmitters" "Default";
BA_DEF_DEF_  "DiagReqFun" "NO";
BA_DEF_DEF_  "DiagReqPhy" "NO";
BA_DEF_DEF_  "DiagResp" "NO";
BA_DEF_DEF_  "GenMsgTimeoutValue" 200;
BA_DEF_DEF_  "GenMsgSendType" "Cyclic";
BA_DEF_DEF_  "GenMsgCycleTime" 50;
BA_DEF_DEF_  "CANFD_BRS" "1";
BA_DEF_DEF_  "GenMsgILSupport" "Yes";
BA_DEF_DEF_  "BitOrder" "LSB";
BA_DEF_DEF_  "NmBaseAddress" 1024;
BA_DEF_DEF_  "BusType" "CAN FD";
BA_DEF_DEF_  "DBName" "";
BA_ "DBName" "Hirain_Trunk_EQ";
BA_ "GenMsgILSupport" BO_ 2015 0;
BA_ "GenMsgSendType" BO_ 2015 1;
BA_ "FunReqGroup" BO_ 2015 1;
BA_ "VFrameFormat" BO_ 2015 0;
BA_ "DiagReqFun" BO_ 2015 1;
BA_ "DiagResp" BO_ 1864 1;
BA_ "GenMsgILSupport" BO_ 1864 0;
BA_ "GenMsgSendType" BO_ 1864 1;
BA_ "FunReqGroup" BO_ 1864 1;
BA_ "VFrameFormat" BO_ 1864 0;
BA_ "FunReqGroup" BO_ 1856 1;
BA_ "GenMsgILSupport" BO_ 1856 0;
BA_ "GenMsgSendType" BO_ 1856 1;
BA_ "DiagReqPhy" BO_ 1856 1;
BA_ "VFrameFormat" BO_ 1856 0;
BA_ "GenMsgTimeoutValue" BO_ 513 50000;
BA_ "GenMsgCycleTime" BO_ 513 10000;
BA_ "GenMsgSendType" BO_ 513 1;
BA_ "VFrameFormat" BO_ 513 14;
BA_ "GenMsgTimeoutValue" BO_ 512 50000;
BA_ "GenMsgCycleTime" BO_ 512 10000;
BA_ "GenMsgSendType" BO_ 512 1;
BA_ "VFrameFormat" BO_ 512 14;
BA_ "VFrameFormat" BO_ 434 14;
BA_ "VFrameFormat" BO_ 338 14;
BA_ "VFrameFormat" BO_ 369 14;
BA_ "VFrameFormat" BO_ 396 14;
BA_ "VFrameFormat" BO_ 397 14;
BA_ "VFrameFormat" BO_ 398 14;
BA_ "VFrameFormat" BO_ 399 14;
BA_ "VFrameFormat" BO_ 394 14;
BA_ "VFrameFormat" BO_ 395 14;
BA_ "VFrameFormat" BO_ 342 14;
BA_ "VFrameFormat" BO_ 343 14;
BA_ "VFrameFormat" BO_ 344 14;
BA_ "VFrameFormat" BO_ 345 14;
BA_ "VFrameFormat" BO_ 400 14;
BA_ "VFrameFormat" BO_ 401 14;
BA_ "VFrameFormat" BO_ 402 14;
BA_ "VFrameFormat" BO_ 403 14;
BA_ "VFrameFormat" BO_ 404 14;
BA_ "VFrameFormat" BO_ 405 14;
BA_ "GenSigStartValue" SG_ 338 COM_Protocol_Version 8;
BA_ "GenSigStartValue" SG_ 369 FS_Protocol_Version 6;
BA_ "GenSigStartValue" SG_ 396 LA_Protocol_Version 7;
BA_ "GenSigStartValue" SG_ 398 LH_Protocol_Version 7;
BA_ "GenSigStartValue" SG_ 394 LRE_Protocol_Version 11;
BA_ "GenSigStartValue" SG_ 400 OBJ_Protocol_Version 12;
VAL_ 434 CIN_Vehicle_Speed_Valid 1 "VALID" 0 "NOT_VALID" ;
VAL_ 434 CIN_Vehicle_Yaw_Valid 1 "VALID" 0 "NOT_VALID" ;
VAL_ 434 CIN_Steering_Wheel_Angle_Valid 1 "VALID" 0 "NOT_VALID" ;
VAL_ 434 CIN_MCU_Sync_Timestamp_Valid 1 "VALID" 0 "NOT_VALID" ;
VAL_ 338 COM_Last_Clock_Sync_Error 1 "TRUE" 0 "FALSE" ;
VAL_ 338 COM_DayTime_Indicator 2 "NIGHT" 1 "NA" 0 "DAY" ;
VAL_ 338 COM_HIL_Mode_Status 1 "ACTIVE" 0 "NOT_ACTIVE" ;
VAL_ 338 COM_Driving_Side_V 1 "TRUE" 0 "FALSE" ;
VAL_ 338 COM_Driving_Side 2 "RIGHT" 1 "LEFT" 0 "UNKNOWN" ;
VAL_ 338 COM_Is_HighSpeed_Road_V 1 "TRUE" 0 "FALSE" ;
VAL_ 338 COM_Is_HighSpeed_Road 1 "TRUE" 0 "FALSE" ;
VAL_ 338 Reserved_1 1 "REPORT_9_18_36" 0 "REPORT_36" ;
VAL_ 338 Reserved_2 31 "(BIT_31)SAFETY_DIAGNOSTICS" 30 "(BIT_30)ROAD_PROFILE" 29 "(BIT_29)ROAD_MODEL" 28 "(BIT_28)ROAD_GEOMETRY_APPS" 27 "(BIT_27)OCR" 26 "(BIT_26)OBJECTS_ADVANCED" 25 "(BIT_25)OBJECTS" 24 "(BIT_24)LIGHT_SCENE_VCL" 23 "(BIT_23)LIGHT_SCENE_STL" 22 "(BIT_22)LIGHT_SCENE_RFL" 21 "(BIT_21)LDW" 20 "(BIT_20)LANES_ROAD_EDGE" 19 "(BIT_19)LANES_HOST" 18 "(BIT_18)LANES_APPLICATIONS" 17 "(BIT_17)LANES_ADJACENT" 16 "(BIT_16)LAND_MARKS" 15 "(BIT_15)HLB" 14 "(BIT_14)HAZARDS" 13 "(BIT_13)FREE_SPACE" 12 "(BIT_12)FCF_VRU" 11 "(BIT_11)FCF_VD" 10 "(BIT_10)FCF_CV" 9 "(BIT_9)FAIL_SAFE" 8 "(BIT_8)EGO_MOTION" 7 "(BIT_7)DS_TRAFFIC_SIGNS" 6 "(BIT_6)DFA" 5 "(BIT_5)DEBUG" 4 "(BIT_4)CONSTRUCTION_AREA" 3 "(BIT_3)COMMON" 2 "(BIT_2)CAR_OUTPUT" 1 "(BIT_1)CALIBRATION_DYNAMIC_MC" 0 "(BIT_0)CALIBRATION_DYNAMIC" ;
VAL_ 338 Reserved_3 31 "(BIT_31)RESERVED" 30 "(BIT_30)RESERVED" 29 "(BIT_29)RESERVED" 28 "(BIT_28)RESERVED" 27 "(BIT_27)RESERVED" 26 "(BIT_26)RESERVED" 25 "(BIT_25)RESERVED" 24 "(BIT_24)RESERVED" 23 "(BIT_23)RESERVED" 22 "(BIT_22)RESERVED" 21 "(BIT_21)RESERVED" 20 "(BIT_20)RESERVED" 19 "(BIT_19)RESERVED" 18 "(BIT_18)RESERVED" 17 "(BIT_17)RESERVED" 16 "(BIT_16)RESERVED" 15 "(BIT_15)RESERVED" 14 "(BIT_14)RESERVED" 13 "(BIT_13)RESERVED" 12 "(BIT_12)RESERVED" 11 "(BIT_11)ACCURATE_SPEED" 10 "(BIT_10)Lanes_CCM" 9 "(BIT_9)FCF_VRU_DYN" 8 "(BIT_8)FCF_VD_DYN" 7 "(BIT_7)FCF_CV_DYN" 6 "(BIT_6)TRAFFIC_SIGNS" 5 "(BIT_5)TFL_STRUCTURE" 4 "(BIT_4)TFL_SPOTS" 3 "(BIT_3)SEMANTIC_MARKS" 2 "(BIT_2)SEMANTIC_LINES" 1 "(BIT_1)SEMANTIC_LANES_DESCRIPTION" 0 "(BIT_0)SEMANTIC_JUNCTION" ;
VAL_ 369 FS_TSR_Out_OF_Calib 4 "TSR_OUT_OF_CALIB_HORIZON" 3 "TSR_OUT_OF_CALIB_YAW" 2 "TSR_OUT_OF_CALIB_AEB" 1 "TSR_OUT_OF_CALIB" ;
VAL_ 369 FS_Out_Of_Calib 5 "99" 4 "75" 3 "50" 2 "25" 1 "NONE" 0 "NOT_READY" ;
VAL_ 369 FS_Impacted_Technologies 15 "RESERVED_7" 14 "RESERVED_6" 13 "RESERVED_5" 12 "RESERVED_4" 11 "RESERVED_3" 10 "(BIT_10)VD-FCW" 9 "(BIT_9)PED_FCW" 8 "(BIT_8)HEATER" 7 "(BIT_7)FREE_SPACE" 6 "(BIT_6)RPE" 5 "(BIT_5)VD-AEB" 4 "(BIT_4)LD-LC" 3 "(BIT_3)PED-AEB" 2 "(BIT_2)HLB" 1 "(BIT_1)TSR" 0 "(BIT_0)VBACC" ;
VAL_ 369 FS_Rain 5 "99" 4 "75" 3 "50" 2 "25" 1 "NONE" 0 "NOT_READY" ;
VAL_ 369 FS_Fog 5 "99" 4 "75" 3 "50" 2 "25" 1 "NONE" 0 "NOT_READY" ;
VAL_ 369 FS_Calibration_Misalignment 5 "99" 4 "75" 3 "50" 2 "25" 1 "NONE" 0 "NOT_READY" ;
VAL_ 369 FS_C2W_OOR 5 "OOR_STATE" 4 "SUSPECTED_STATE" 3 "RESERVED" 2 "UNVALIDATED_STATE" 1 "CALIBRATED_STATE" 0 "NOT_READY" ;
VAL_ 369 FS_Camera_ID_0 11 "PARKING_RIGHT" 10 "PARKING_LEFT" 9 "PARKING_REAR" 8 "PARKING_FRONT" 7 "FRONT_CORNER_RIGHT" 6 "FRONT_CORNER_LEFT" 5 "REAR_CORNER_RIGHT" 4 "REAR_CORNER_LEFT" 3 "REAR" 2 "FRONT_FISHEYE" 1 "FRONT_NARROW" 0 "FRONT_MAIN" ;
VAL_ 369 FS_Free_Sight_0 1 "TRUE" 0 "FALSE" ;
VAL_ 369 FS_Splashes_0 5 "99" 4 "75" 3 "50" 2 "25" 1 "NONE" 0 "NOT_READY" ;
VAL_ 369 FS_Sun_Ray_0 5 "99" 4 "75" 3 "50" 2 "25" 1 "NONE" 0 "NOT_READY" ;
VAL_ 369 FS_Low_Sun_0 5 "99" 4 "75" 3 "50" 2 "25" 1 "NONE" 0 "NOT_READY" ;
VAL_ 369 FS_Blur_Image_0 5 "99" 4 "75" 3 "50" 2 "25" 1 "NONE" 0 "NOT_READY" ;
VAL_ 369 FS_Partial_Blockage_0 5 "99" 4 "75" 3 "50" 2 "25" 1 "NONE" 0 "NOT_READY" ;
VAL_ 369 FS_Full_Blockage_0 5 "99" 4 "75" 3 "50" 2 "25" 1 "NONE" 0 "NOT_READY" ;
VAL_ 369 FS_Frozen_Windshield_Lens_0 5 "99" 4 "75" 3 "50" 2 "25" 1 "NONE" 0 "NOT_READY" ;
VAL_ 369 FS_Out_Of_Focus_0 5 "99" 4 "75" 3 "50" 2 "25" 1 "NONE" 0 "NOT_READY" ;
VAL_ 369 FS_C2C_Out_Of_Calib_0 5 "99" 4 "75" 3 "50" 2 "25" 1 "NONE" 0 "NOT_READY" ;
VAL_ 396 LA_Color_0 3 "BLUE" 2 "YELLOW" 1 "WHITE" 0 "UNDECIDED" ;
VAL_ 396 LA_Prediction_Reason_0 5 "(100000)HEADWAY" 4 "(010000)OCCLUDED" 3 "(001000)DIVERGING" 2 "(000100)SHADOW" 1 "(000010)MERGE" 0 "(0000001)LOSS" ;
VAL_ 396 LA_Availability_State_0 2 "DETECTED" 1 "PREDICATED" 0 "NOT_AVAILABLE" ;
VAL_ 396 LA_Lanemark_Type_0 5 "HOV_LANE" 4 "BOTTS" 3 "DLM" 2 "DASHED" 1 "SOLID" 0 "UNDECIDED" ;
VAL_ 396 LA_DLM_Type_0 5 "UNDECIDED" 4 "DASHED_DASHED" 3 "SOLID_SOLID" 2 "DASHED_SOLID" 1 "SOLID_DASHED" 0 "NOT_DLM" ;
VAL_ 396 LA_Line_Side_0 4 "RIGHT_RIGHT_LANEMARK" 3 "RIGHT_LEFT_LANEMARK" 2 "LEFT_RIGHT_LANEMARK" 1 "LEFT_LEFT_LANEMARK" 0 "NONE" ;
VAL_ 397 LA_Color_1 3 "BLUE" 2 "YELLOW" 1 "WHITE" 0 "UNDECIDED" ;
VAL_ 397 LA_Prediction_Reason_1 5 "(100000)HEADWAY" 4 "(010000)OCCLUDED" 3 "(001000)DIVERGING" 2 "(000100)SHADOW" 1 "(000010)MERGE" 0 "(0000001)LOSS" ;
VAL_ 397 LA_Availability_State_1 2 "DETECTED" 1 "PREDICATED" 0 "NOT_AVAILABLE" ;
VAL_ 397 LA_Lanemark_Type_1 5 "HOV_LANE" 4 "BOTTS" 3 "DLM" 2 "DASHED" 1 "SOLID" 0 "UNDECIDED" ;
VAL_ 397 LA_DLM_Type_1 5 "UNDECIDED" 4 "DASHED_DASHED" 3 "SOLID_SOLID" 2 "DASHED_SOLID" 1 "SOLID_DASHED" 0 "NOT_DLM" ;
VAL_ 397 LA_Line_Side_1 4 "RIGHT_RIGHT_LANEMARK" 3 "RIGHT_LEFT_LANEMARK" 2 "LEFT_RIGHT_LANEMARK" 1 "LEFT_LEFT_LANEMARK" 0 "NONE" ;
VAL_ 398 LH_Is_Triggered_SDM_Type_0 2 "NOT_TRIGGERED" 1 "TRIGGERED" 0 "NOT_AVAILABLE" ;
VAL_ 398 LH_Is_Triggered_SDM_Model_0 2 "NOT_TRIGGERED" 1 "TRIGGERED" 0 "NOT_AVAILABLE" ;
VAL_ 398 LH_Prediction_Reason_0 5 "(BIT_5)HEADWAY" 4 "(BIT_4)OCCLUDED" 3 "(BIT_3)DIVERGING" 2 "(BIT_2)SHADOW" 1 "(BIT_1)MERGE" 0 "(BIT_0)LOSS" ;
VAL_ 398 LH_Availability_State_0 2 "DETECTED" 1 "PREDICATED" 0 "NOT_AVAILABLE" ;
VAL_ 398 LH_Color_0 3 "BLUE" 2 "YELLOW" 1 "WHITE" 0 "UNDECIDED" ;
VAL_ 398 LH_Lanemark_Type_0 6 "HOV_LANE" 5 "DECELERATION" 4 "BOTTS" 3 "DLM" 2 "DASHED" 1 "SOLID" 0 "UNDECIDED" ;
VAL_ 398 LH_DLM_Type_0 5 "UNDECIDED" 4 "DASHED_DASHED" 3 "SOLID_SOLID" 2 "DASHED_SOLID" 1 "SOLID_DASHED" 0 "NOT_DLM" ;
VAL_ 398 LH_DECEL_Type_0 5 "RESERVED_3" 4 "RESERVED_2" 3 "UNDECIDED" 2 "DASHED" 1 "SOLID" 0 "NO_DECEL" ;
VAL_ 398 LH_Side_0 2 "RIGHT" 1 "LEFT" 0 "UNKNOWN" ;
VAL_ 398 LH_Crossing_0 1 "TRUE" 0 "FALSE" ;
VAL_ 398 Reserved_4 1 "TRUE" 0 "FALSE" ;
VAL_ 398 LH_Is_Multi_Clothoid_0 1 "TRUE" 0 "FALSE" ;
VAL_ 399 LH_Is_Triggered_SDM_Type_1 2 "NOT_TRIGGERED" 1 "TRIGGERED" 0 "NOT_AVAILABLE" ;
VAL_ 399 LH_Is_Triggered_SDM_Model_1 2 "NOT_TRIGGERED" 1 "TRIGGERED" 0 "NOT_AVAILABLE" ;
VAL_ 399 LH_Prediction_Reason_1 5 "(BIT_5)HEADWAY" 4 "(BIT_4)OCCLUDED" 3 "(BIT_3)DIVERGING" 2 "(BIT_2)SHADOW" 1 "(BIT_1)MERGE" 0 "(BIT_0)LOSS" ;
VAL_ 399 LH_Availability_State_1 2 "DETECTED" 1 "PREDICATED" 0 "NOT_AVAILABLE" ;
VAL_ 399 LH_Color_1 3 "BLUE" 2 "YELLOW" 1 "WHITE" 0 "UNDECIDED" ;
VAL_ 399 LH_Lanemark_Type_1 6 "HOV_LANE" 5 "DECELERATION" 4 "BOTTS" 3 "DLM" 2 "DASHED" 1 "SOLID" 0 "UNDECIDED" ;
VAL_ 399 LH_DLM_Type_1 5 "UNDECIDED" 4 "DASHED_DASHED" 3 "SOLID_SOLID" 2 "DASHED_SOLID" 1 "SOLID_DASHED" 0 "NOT_DLM" ;
VAL_ 399 LH_DECEL_Type_1 5 "RESERVED_3" 4 "RESERVED_2" 3 "UNDECIDED" 2 "DASHED" 1 "SOLID" 0 "NO_DECEL" ;
VAL_ 399 LH_Side_1 2 "RIGHT" 1 "LEFT" 0 "UNKNOWN" ;
VAL_ 399 LH_Crossing_1 1 "TRUE" 0 "FALSE" ;
VAL_ 399 Reserved_5 1 "TRUE" 0 "FALSE" ;
VAL_ 399 LH_Is_Multi_Clothoid_1 1 "TRUE" 0 "FALSE" ;
VAL_ 394 LRE_Prediction_Reason_0 5 "(BIT_5)HEADWAY" 4 "(BIT_4)OCCLUDED" 3 "(BIT_3)DIVERGING" 2 "(BIT_2)SHADOW" 1 "(BIT_1)MERGE" 0 "(BIT_0)LOSS" ;
VAL_ 394 LRE_Availability_State_0 2 "DETECTED" 1 "PREDICATED" 0 "NOT_AVAILABLE" ;
VAL_ 394 LRE_Side_0 2 "RIGHT" 1 "LEFT" 0 "UNFILLED" ;
VAL_ 394 LRE_Is_Triggered_SDM_Model_0 2 "NOT_TRIGGERED" 1 "TRIGGERED" 0 "NOT_AVAILABLE" ;
VAL_ 394 Reserved_6 2 "SECOND" 1 "FIRST" 0 "UNFILLED" ;
VAL_ 395 LRE_Prediction_Reason_1 5 "(BIT_5)HEADWAY" 4 "(BIT_4)OCCLUDED" 3 "(BIT_3)DIVERGING" 2 "(BIT_2)SHADOW" 1 "(BIT_1)MERGE" 0 "(BIT_0)LOSS" ;
VAL_ 395 LRE_Availability_State_1 2 "DETECTED" 1 "PREDICATED" 0 "NOT_AVAILABLE" ;
VAL_ 395 LRE_Side_1 2 "RIGHT" 1 "LEFT" 0 "UNFILLED" ;
VAL_ 395 LRE_Is_Triggered_SDM_Model_1 2 "NOT_TRIGGERED" 1 "TRIGGERED" 0 "NOT_AVAILABLE" ;
VAL_ 395 Reserved_7 2 "SECOND" 1 "FIRST" 0 "UNFILLED" ;
VAL_ 342 TSR_Relevancy_0 10 "OTHER_FILTER_REASON" 9 "CONTRADICT_ARROW_SIGN" 8 "CIPV_IN_FRONT" 7 "ERROR_SIGN_CODE" 6 "INTERNAL_SIGN_CONTRADICTION" 5 "FAR_IRRELEVANT_SIGN" 4 "SIGN_ON_TURN" 3 "PARALLEL_ROAD_SIGN" 2 "LANE_ASSIGNMENT_SIGN" 1 "HIGHWAY_EXIT_SIGN" 0 "RELEVANT_SIGN" ;
VAL_ 342 TSR_Filter_Type_0 7 "RESERVED_3" 6 "RESERVED_2" 5 "RESERVED_1" 4 "ROAD_NUMBER" 3 "MINIMUM" 2 "EMBEDDED" 1 "TRUCK" 0 "NO_SLI_FILTER" ;
VAL_ 342 TSR_Sup1_Position_0 4 "BOTTOM" 3 "TOP" 2 "RIGHT" 1 "LEFT" 0 "INVALID" ;
VAL_ 342 TSR_Sup2_Position_0 4 "BOTTOM" 3 "TOP" 2 "RIGHT" 1 "LEFT" 0 "INVALID" ;
VAL_ 342 TSR_Sign_Shape_0 8 "RESERVED_3" 7 "RESERVED_2" 6 "PENTAGON" 5 "DIAMOND" 4 "TRIANGLE_DOWN" 3 "TRIANGLE_UP" 2 "RECTANGLE" 1 "CIRCLE" 0 "UNKNOWN" ;
VAL_ 342 TSR_Sign_Structure_0 3 "ELECTRONIC" 2 "RESERVED" 1 "STANDARD" 0 "UNKNOWN" ;
VAL_ 342 TSR_Measurement_Status_0 5 "EXPELLED" 4 "OUT_OF_IMAGE" 3 "OCCLUDED" 2 "RESERVED" 1 "VISIBLE" 0 "INVALID" ;
VAL_ 342 TSR_Relevancy_1 10 "OTHER_FILTER_REASON" 9 "CONTRADICT_ARROW_SIGN" 8 "CIPV_IN_FRONT" 7 "ERROR_SIGN_CODE" 6 "INTERNAL_SIGN_CONTRADICTION" 5 "FAR_IRRELEVANT_SIGN" 4 "SIGN_ON_TURN" 3 "PARALLEL_ROAD_SIGN" 2 "LANE_ASSIGNMENT_SIGN" 1 "HIGHWAY_EXIT_SIGN" 0 "RELEVANT_SIGN" ;
VAL_ 342 TSR_Filter_Type_1 7 "RESERVED_3" 6 "RESERVED_2" 5 "RESERVED_1" 4 "ROAD_NUMBER" 3 "MINIMUM" 2 "EMBEDDED" 1 "TRUCK" 0 "NO_SLI_FILTER" ;
VAL_ 342 TSR_Sup1_Position_1 4 "BOTTOM" 3 "TOP" 2 "RIGHT" 1 "LEFT" 0 "INVALID" ;
VAL_ 342 TSR_Sup2_Position_1 4 "BOTTOM" 3 "TOP" 2 "RIGHT" 1 "LEFT" 0 "INVALID" ;
VAL_ 342 TSR_Sign_Shape_1 8 "RESERVED_3" 7 "RESERVED_2" 6 "PENTAGON" 5 "DIAMOND" 4 "TRIANGLE_DOWN" 3 "TRIANGLE_UP" 2 "RECTANGLE" 1 "CIRCLE" 0 "UNKNOWN" ;
VAL_ 342 TSR_Sign_Structure_1 3 "ELECTRONIC" 2 "RESERVED" 1 "STANDARD" 0 "UNKNOWN" ;
VAL_ 342 TSR_Measurement_Status_1 5 "EXPELLED" 4 "OUT_OF_IMAGE" 3 "OCCLUDED" 2 "RESERVED" 1 "VISIBLE" 0 "INVALID" ;
VAL_ 343 TSR_Relevancy_2 10 "OTHER_FILTER_REASON" 9 "CONTRADICT_ARROW_SIGN" 8 "CIPV_IN_FRONT" 7 "ERROR_SIGN_CODE" 6 "INTERNAL_SIGN_CONTRADICTION" 5 "FAR_IRRELEVANT_SIGN" 4 "SIGN_ON_TURN" 3 "PARALLEL_ROAD_SIGN" 2 "LANE_ASSIGNMENT_SIGN" 1 "HIGHWAY_EXIT_SIGN" 0 "RELEVANT_SIGN" ;
VAL_ 343 TSR_Filter_Type_2 7 "RESERVED_3" 6 "RESERVED_2" 5 "RESERVED_1" 4 "ROAD_NUMBER" 3 "MINIMUM" 2 "EMBEDDED" 1 "TRUCK" 0 "NO_SLI_FILTER" ;
VAL_ 343 TSR_Sup1_Position_2 4 "BOTTOM" 3 "TOP" 2 "RIGHT" 1 "LEFT" 0 "INVALID" ;
VAL_ 343 TSR_Sup2_Position_2 4 "BOTTOM" 3 "TOP" 2 "RIGHT" 1 "LEFT" 0 "INVALID" ;
VAL_ 343 TSR_Sign_Shape_2 8 "RESERVED_3" 7 "RESERVED_2" 6 "PENTAGON" 5 "DIAMOND" 4 "TRIANGLE_DOWN" 3 "TRIANGLE_UP" 2 "RECTANGLE" 1 "CIRCLE" 0 "UNKNOWN" ;
VAL_ 343 TSR_Sign_Structure_2 3 "ELECTRONIC" 2 "RESERVED" 1 "STANDARD" 0 "UNKNOWN" ;
VAL_ 343 TSR_Measurement_Status_2 5 "EXPELLED" 4 "OUT_OF_IMAGE" 3 "OCCLUDED" 2 "RESERVED" 1 "VISIBLE" 0 "INVALID" ;
VAL_ 343 TSR_Relevancy_3 10 "OTHER_FILTER_REASON" 9 "CONTRADICT_ARROW_SIGN" 8 "CIPV_IN_FRONT" 7 "ERROR_SIGN_CODE" 6 "INTERNAL_SIGN_CONTRADICTION" 5 "FAR_IRRELEVANT_SIGN" 4 "SIGN_ON_TURN" 3 "PARALLEL_ROAD_SIGN" 2 "LANE_ASSIGNMENT_SIGN" 1 "HIGHWAY_EXIT_SIGN" 0 "RELEVANT_SIGN" ;
VAL_ 343 TSR_Filter_Type_3 7 "RESERVED_3" 6 "RESERVED_2" 5 "RESERVED_1" 4 "ROAD_NUMBER" 3 "MINIMUM" 2 "EMBEDDED" 1 "TRUCK" 0 "NO_SLI_FILTER" ;
VAL_ 343 TSR_Sup1_Position_3 4 "BOTTOM" 3 "TOP" 2 "RIGHT" 1 "LEFT" 0 "INVALID" ;
VAL_ 343 TSR_Sup2_Position_3 4 "BOTTOM" 3 "TOP" 2 "RIGHT" 1 "LEFT" 0 "INVALID" ;
VAL_ 343 TSR_Sign_Shape_3 8 "RESERVED_3" 7 "RESERVED_2" 6 "PENTAGON" 5 "DIAMOND" 4 "TRIANGLE_DOWN" 3 "TRIANGLE_UP" 2 "RECTANGLE" 1 "CIRCLE" 0 "UNKNOWN" ;
VAL_ 343 TSR_Sign_Structure_3 3 "ELECTRONIC" 2 "RESERVED" 1 "STANDARD" 0 "UNKNOWN" ;
VAL_ 343 TSR_Measurement_Status_3 5 "EXPELLED" 4 "OUT_OF_IMAGE" 3 "OCCLUDED" 2 "RESERVED" 1 "VISIBLE" 0 "INVALID" ;
VAL_ 344 TSR_Relevancy_4 10 "OTHER_FILTER_REASON" 9 "CONTRADICT_ARROW_SIGN" 8 "CIPV_IN_FRONT" 7 "ERROR_SIGN_CODE" 6 "INTERNAL_SIGN_CONTRADICTION" 5 "FAR_IRRELEVANT_SIGN" 4 "SIGN_ON_TURN" 3 "PARALLEL_ROAD_SIGN" 2 "LANE_ASSIGNMENT_SIGN" 1 "HIGHWAY_EXIT_SIGN" 0 "RELEVANT_SIGN" ;
VAL_ 344 TSR_Filter_Type_4 7 "RESERVED_3" 6 "RESERVED_2" 5 "RESERVED_1" 4 "ROAD_NUMBER" 3 "MINIMUM" 2 "EMBEDDED" 1 "TRUCK" 0 "NO_SLI_FILTER" ;
VAL_ 344 TSR_Sup1_Position_4 4 "BOTTOM" 3 "TOP" 2 "RIGHT" 1 "LEFT" 0 "INVALID" ;
VAL_ 344 TSR_Sup2_Position_4 4 "BOTTOM" 3 "TOP" 2 "RIGHT" 1 "LEFT" 0 "INVALID" ;
VAL_ 344 TSR_Sign_Shape_4 8 "RESERVED_3" 7 "RESERVED_2" 6 "PENTAGON" 5 "DIAMOND" 4 "TRIANGLE_DOWN" 3 "TRIANGLE_UP" 2 "RECTANGLE" 1 "CIRCLE" 0 "UNKNOWN" ;
VAL_ 344 TSR_Sign_Structure_4 3 "ELECTRONIC" 2 "RESERVED" 1 "STANDARD" 0 "UNKNOWN" ;
VAL_ 344 TSR_Measurement_Status_4 5 "EXPELLED" 4 "OUT_OF_IMAGE" 3 "OCCLUDED" 2 "RESERVED" 1 "VISIBLE" 0 "INVALID" ;
VAL_ 344 TSR_Relevancy_5 10 "OTHER_FILTER_REASON" 9 "CONTRADICT_ARROW_SIGN" 8 "CIPV_IN_FRONT" 7 "ERROR_SIGN_CODE" 6 "INTERNAL_SIGN_CONTRADICTION" 5 "FAR_IRRELEVANT_SIGN" 4 "SIGN_ON_TURN" 3 "PARALLEL_ROAD_SIGN" 2 "LANE_ASSIGNMENT_SIGN" 1 "HIGHWAY_EXIT_SIGN" 0 "RELEVANT_SIGN" ;
VAL_ 344 TSR_Filter_Type_5 7 "RESERVED_3" 6 "RESERVED_2" 5 "RESERVED_1" 4 "ROAD_NUMBER" 3 "MINIMUM" 2 "EMBEDDED" 1 "TRUCK" 0 "NO_SLI_FILTER" ;
VAL_ 344 TSR_Sup1_Position_5 4 "BOTTOM" 3 "TOP" 2 "RIGHT" 1 "LEFT" 0 "INVALID" ;
VAL_ 344 TSR_Sup2_Position_5 4 "BOTTOM" 3 "TOP" 2 "RIGHT" 1 "LEFT" 0 "INVALID" ;
VAL_ 344 TSR_Sign_Shape_5 8 "RESERVED_3" 7 "RESERVED_2" 6 "PENTAGON" 5 "DIAMOND" 4 "TRIANGLE_DOWN" 3 "TRIANGLE_UP" 2 "RECTANGLE" 1 "CIRCLE" 0 "UNKNOWN" ;
VAL_ 344 TSR_Sign_Structure_5 3 "ELECTRONIC" 2 "RESERVED" 1 "STANDARD" 0 "UNKNOWN" ;
VAL_ 344 TSR_Measurement_Status_5 5 "EXPELLED" 4 "OUT_OF_IMAGE" 3 "OCCLUDED" 2 "RESERVED" 1 "VISIBLE" 0 "INVALID" ;
VAL_ 345 TSR_Relevancy_6 10 "OTHER_FILTER_REASON" 9 "CONTRADICT_ARROW_SIGN" 8 "CIPV_IN_FRONT" 7 "ERROR_SIGN_CODE" 6 "INTERNAL_SIGN_CONTRADICTION" 5 "FAR_IRRELEVANT_SIGN" 4 "SIGN_ON_TURN" 3 "PARALLEL_ROAD_SIGN" 2 "LANE_ASSIGNMENT_SIGN" 1 "HIGHWAY_EXIT_SIGN" 0 "RELEVANT_SIGN" ;
VAL_ 345 TSR_Filter_Type_6 7 "RESERVED_3" 6 "RESERVED_2" 5 "RESERVED_1" 4 "ROAD_NUMBER" 3 "MINIMUM" 2 "EMBEDDED" 1 "TRUCK" 0 "NO_SLI_FILTER" ;
VAL_ 345 TSR_Sup1_Position_6 4 "BOTTOM" 3 "TOP" 2 "RIGHT" 1 "LEFT" 0 "INVALID" ;
VAL_ 345 TSR_Sup2_Position_6 4 "BOTTOM" 3 "TOP" 2 "RIGHT" 1 "LEFT" 0 "INVALID" ;
VAL_ 345 TSR_Sign_Shape_6 8 "RESERVED_3" 7 "RESERVED_2" 6 "PENTAGON" 5 "DIAMOND" 4 "TRIANGLE_DOWN" 3 "TRIANGLE_UP" 2 "RECTANGLE" 1 "CIRCLE" 0 "UNKNOWN" ;
VAL_ 345 TSR_Sign_Structure_6 3 "ELECTRONIC" 2 "RESERVED" 1 "STANDARD" 0 "UNKNOWN" ;
VAL_ 345 TSR_Measurement_Status_6 5 "EXPELLED" 4 "OUT_OF_IMAGE" 3 "OCCLUDED" 2 "RESERVED" 1 "VISIBLE" 0 "INVALID" ;
VAL_ 345 TSR_Relevancy_7 10 "OTHER_FILTER_REASON" 9 "CONTRADICT_ARROW_SIGN" 8 "CIPV_IN_FRONT" 7 "ERROR_SIGN_CODE" 6 "INTERNAL_SIGN_CONTRADICTION" 5 "FAR_IRRELEVANT_SIGN" 4 "SIGN_ON_TURN" 3 "PARALLEL_ROAD_SIGN" 2 "LANE_ASSIGNMENT_SIGN" 1 "HIGHWAY_EXIT_SIGN" 0 "RELEVANT_SIGN" ;
VAL_ 345 TSR_Filter_Type_7 7 "RESERVED_3" 6 "RESERVED_2" 5 "RESERVED_1" 4 "ROAD_NUMBER" 3 "MINIMUM" 2 "EMBEDDED" 1 "TRUCK" 0 "NO_SLI_FILTER" ;
VAL_ 345 TSR_Sup1_Position_7 4 "BOTTOM" 3 "TOP" 2 "RIGHT" 1 "LEFT" 0 "INVALID" ;
VAL_ 345 TSR_Sup2_Position_7 4 "BOTTOM" 3 "TOP" 2 "RIGHT" 1 "LEFT" 0 "INVALID" ;
VAL_ 345 TSR_Sign_Shape_7 8 "RESERVED_3" 7 "RESERVED_2" 6 "PENTAGON" 5 "DIAMOND" 4 "TRIANGLE_DOWN" 3 "TRIANGLE_UP" 2 "RECTANGLE" 1 "CIRCLE" 0 "UNKNOWN" ;
VAL_ 345 TSR_Sign_Structure_7 3 "ELECTRONIC" 2 "RESERVED" 1 "STANDARD" 0 "UNKNOWN" ;
VAL_ 345 TSR_Measurement_Status_7 5 "EXPELLED" 4 "OUT_OF_IMAGE" 3 "OCCLUDED" 2 "RESERVED" 1 "VISIBLE" 0 "INVALID" ;
VAL_ 400 OBJ_VD_CIPV_Lost 2 "LOST_TARGET_FOV_IN" 1 "LOST_TARGET_FOV_OUT" 0 "NO_LOSS" ;
VAL_ 400 OBJ_VD_Allow_Acc 2 "FREE_SPACE_UNKNOWN" 1 "SPACE_NOT_FREE" 0 "FREE_SPACE" ;
VAL_ 400 OBJ_Is_Blocked_Left 1 "TRUE" 0 "FALSE" ;
VAL_ 400 OBJ_Is_Blocked_Right 1 "TRUE" 0 "FALSE" ;
VAL_ 401 OBJ_Motion_Category_0 13 "ONCOMING" 12 "PRECEEDING" 11 "MOVING" 10 "RTAP" 9 "LTAP" 8 "CROSSING" 7 "MOVING_OUT" 6 "MOVING_IN" 5 "CLOSE_CUT_IN" 4 "PASSING_OUT" 3 "PASSING_IN" 2 "PASSING" 1 "UNDEFINED" 0 "UNFILLED" ;
VAL_ 401 OBJ_Measuring_Status_0 2 "(BIT_2)NOT_VALID_OR_VALID" 1 "(BIT_1)PREDICTED_OR_MEASURED" 0 "(BIT_0)OLD_OR_NEW" ;
VAL_ 401 OBJ_Object_Class_0 8 "UNCERTAIN_VCL" 7 "ANIMAL" 6 "GENERAL_OBJECT" 5 "PEDESTRIAN" 4 "BICYCLE" 3 "MOTORBIKE" 2 "TRUCK" 1 "CAR" 0 "UNFILLED" ;
VAL_ 401 OBJ_Motion_Status_0 5 "MOVING_SLOWLY" 4 "STOPPED" 3 "STATIONARY" 2 "MOVING" 1 "UNKNOWN" 0 "INVALID" ;
VAL_ 401 OBJ_Motion_Orientation_0 13 "INVALID" 12 "NORTH" 11 "NORTH_WEST" 9 "WEST" 7 "SOUTH_WEST" 6 "SOUTH" 5 "SOUTH_EAST" 3 "EAST" 1 "NORTH_EAST" 0 "UNKNOWN" ;
VAL_ 401 OBJ_Has_Cut_Lane_0 1 "TRUE" 0 "FALSE" ;
VAL_ 401 OBJ_Has_Cut_Path_0 1 "TRUE" 0 "FALSE" ;
VAL_ 401 OBJ_Brake_Light_0 1 "TRUE" 0 "FALSE" ;
VAL_ 401 OBJ_Turn_Indicator_Right_0 1 "TRUE" 0 "FALSE" ;
VAL_ 401 OBJ_Turn_Indicator_Left_0 1 "TRUE" 0 "FALSE" ;
VAL_ 401 OBJ_Light_Indicator_Validity_0 1 "TRUE" 0 "FALSE" ;
VAL_ 401 OBJ_Right_Out_Of_Image_0 1 "TRUE" 0 "FALSE" ;
VAL_ 401 OBJ_Left_Out_Of_Image_0 1 "TRUE" 0 "FALSE" ;
VAL_ 401 OBJ_Right_Out_Of_Image_V_0 1 "TRUE" 0 "FALSE" ;
VAL_ 401 OBJ_Left_Out_Of_Image_V_0 1 "TRUE" 0 "FALSE" ;
VAL_ 401 OBJ_Top_Out_Of_Image_0 1 "TRUE" 0 "FALSE" ;
VAL_ 401 OBJ_Bottom_Out_Of_Image_0 1 "TRUE" 0 "FALSE" ;
VAL_ 401 OBJ_Top_Out_Of_Image_V_0 1 "VALID" 0 "INVALID" ;
VAL_ 401 OBJ_Bottom_Out_Of_Image_V_0 1 "VALID" 0 "INVALID" ;
VAL_ 401 OBJ_Lane_Assignment_0 5 "RIGHT_RIGHT" 4 "RIGHT" 3 "HOST" 2 "LEFT" 1 "LEFT_LEFT" 0 "UNKNOWN" ;
VAL_ 401 OBJ_Lane_Assignment_V_0 1 "VALID" 0 "INVALID" ;
VAL_ 401 OBJ_Age_Seconds_V_0 1 "VALID" 0 "INVALID" ;
VAL_ 401 OBJ_Width_V_0 1 "VALID" 0 "INVALID" ;
VAL_ 401 OBJ_Width_STD_V_0 1 "VALID" 0 "INVALID" ;
VAL_ 401 OBJ_Length_V_0 1 "VALID" 0 "INVALID" ;
VAL_ 401 OBJ_Length_STD_V_0 1 "VALID" 0 "INVALID" ;
VAL_ 401 OBJ_Height_V_0 1 "VALID" 0 "INVALID" ;
VAL_ 401 OBJ_Height_STD_V_0 1 "VALID" 0 "INVALID" ;
VAL_ 401 OBJ_Abs_Long_Velocity_V_0 1 "VALID" 0 "INVALID" ;
VAL_ 401 OBJ_Abs_Long_Vel_STD_V_0 1 "VALID" 0 "INVALID" ;
VAL_ 401 OBJ_Abs_Lat_Velocity_V_0 1 "VALID" 0 "INVALID" ;
VAL_ 401 OBJ_Abs_Lat_Vel_STD_V_0 1 "VALID" 0 "INVALID" ;
VAL_ 401 OBJ_Abs_Long_Acc_V_0 1 "VALID" 0 "INVALID" ;
VAL_ 401 OBJ_Abs_Long_Acc_STD_V_0 1 "VALID" 0 "INVALID" ;
VAL_ 401 OBJ_Abs_Lat_Acc_V_0 1 "VALID" 0 "INVALID" ;
VAL_ 401 OBJ_Abs_Lat_Acc_STD_V_0 1 "VALID" 0 "INVALID" ;
VAL_ 401 OBJ_Abs_Acceleration_V_0 1 "VALID" 0 "INVALID" ;
VAL_ 401 OBJ_Abs_Acc_STD_V_0 1 "VALID" 0 "INVALID" ;
VAL_ 401 OBJ_Inv_TTC_V_0 1 "VALID" 0 "INVALID" ;
VAL_ 401 OBJ_Inv_TTC_STD_V_0 1 "VALID" 0 "INVALID" ;
VAL_ 401 OBJ_Relative_Long_Acc_V_0 1 "VALID" 0 "INVALID" ;
VAL_ 401 OBJ_Rel_Long_Acc_STD_V_0 1 "VALID" 0 "INVALID" ;
VAL_ 401 OBJ_Relative_Long_Velocity_V_0 1 "VALID" 0 "INVALID" ;
VAL_ 401 OBJ_Rel_Long_Vel_STD_V_0 1 "VALID" 0 "INVALID" ;
VAL_ 402 OBJ_Relative_Lat_Velocity_V_0 1 "VALID" 0 "INVALID" ;
VAL_ 402 OBJ_Rel_Lat_Vel_STD_V_0 1 "VALID" 0 "INVALID" ;
VAL_ 402 OBJ_Long_Distance_V_0 1 "VALID" 0 "INVALID" ;
VAL_ 402 OBJ_Long_Distance_STD_V_0 1 "VALID" 0 "INVALID" ;
VAL_ 402 OBJ_Lat_Distance_V_0 1 "VALID" 0 "INVALID" ;
VAL_ 402 OBJ_Lat_Distance_STD_V_0 1 "VALID" 0 "INVALID" ;
VAL_ 402 OBJ_Absolute_Speed_V_0 1 "VALID" 0 "INVALID" ;
VAL_ 402 OBJ_Absolute_Speed_STD_V_0 1 "VALID" 0 "INVALID" ;
VAL_ 402 OBJ_Heading_V_0 1 "VALID" 0 "INVALID" ;
VAL_ 402 OBJ_Heading_STD_V_0 1 "VALID" 0 "INVALID" ;
VAL_ 402 OBJ_Angle_Rate_STD_V_0 1 "VALID" 0 "INVALID" ;
VAL_ 402 OBJ_Angle_Rate_V_0 1 "VALID" 0 "INVALID" ;
VAL_ 402 OBJ_Angle_Right_V_0 1 "VALID" 0 "INVALID" ;
VAL_ 402 OBJ_Angle_Right_STD_V_0 1 "VALID" 0 "INVALID" ;
VAL_ 402 OBJ_Angle_Left_V_0 1 "VALID" 0 "INVALID" ;
VAL_ 402 OBJ_Angle_Left_STD_V_0 1 "VALID" 0 "INVALID" ;
VAL_ 402 OBJ_Angle_Side_V_0 1 "VALID" 0 "INVALID" ;
VAL_ 402 OBJ_Angle_Side_STD_V_0 1 "VALID" 0 "INVALID" ;
VAL_ 402 OBJ_Angle_Mid_V_0 1 "VALID" 0 "INVALID" ;
VAL_ 402 OBJ_Angle_Mid_STD_V_0 1 "VALID" 0 "INVALID" ;
VAL_ 402 OBJ_Angle_Bottom_V_0 1 "VALID" 0 "INVALID" ;
VAL_ 402 OBJ_Angle_Bottom_STD_V_0 1 "VALID" 0 "INVALID" ;
VAL_ 402 OBJ_Visibility_Side_V_0 1 "VALID" 0 "INVALID" ;
VAL_ 402 OBJ_Visibility_Side_0 2 "REAR" 1 "FRONT" 0 "NOT_VISIBLE" ;
VAL_ 402 OBJ_Is_In_Drivable_Area_0 1 "TRUE" 0 "FALSE" ;
VAL_ 402 OBJ_Is_In_Drivable_Area_V_0 1 "VALID" 0 "INVALID" ;
VAL_ 402 OBJ_Is_VeryClose_V_0 1 "VALID" 0 "INVALID" ;
VAL_ 402 OBJ_Is_VeryClose_0 1 "TRUE" 0 "FALSE" ;
VAL_ 402 OBJ_Is_EMERGENCY_VCL_0 1 "TRUE" 0 "FALSE" ;
VAL_ 402 OBJ_EMERGENCY_LIGHT_COLOR_0 3 "(1000)ORANGE" 2 "(0100)BLUE" 1 "(0010)RED" 0 "(0001)OTHER" ;
VAL_ 402 OBJ_EMERGENCY_V_0 1 "TRUE" 0 "FALSE" ;
VAL_ 403 OBJ_Motion_Category_1 13 "ONCOMING" 12 "PRECEEDING" 11 "MOVING" 10 "RTAP" 9 "LTAP" 8 "CROSSING" 7 "MOVING_OUT" 6 "MOVING_IN" 5 "CLOSE_CUT_IN" 4 "PASSING_OUT" 3 "PASSING_IN" 2 "PASSING" 1 "UNDEFINED" 0 "UNFILLED" ;
VAL_ 403 OBJ_Measuring_Status_1 2 "(BIT_2)NOT_VALID_OR_VALID" 1 "(BIT_1)PREDICTED_OR_MEASURED" 0 "(BIT_0)OLD_OR_NEW" ;
VAL_ 403 OBJ_Object_Class_1 8 "UNCERTAIN_VCL" 7 "ANIMAL" 6 "GENERAL_OBJECT" 5 "PEDESTRIAN" 4 "BICYCLE" 3 "MOTORBIKE" 2 "TRUCK" 1 "CAR" 0 "UNFILLED" ;
VAL_ 403 OBJ_Motion_Status_1 5 "MOVING_SLOWLY" 4 "STOPPED" 3 "STATIONARY" 2 "MOVING" 1 "UNKNOWN" 0 "INVALID" ;
VAL_ 403 OBJ_Motion_Orientation_1 13 "INVALID" 12 "NORTH" 11 "NORTH_WEST" 9 "WEST" 7 "SOUTH_WEST" 6 "SOUTH" 5 "SOUTH_EAST" 3 "EAST" 1 "NORTH_EAST" 0 "UNKNOWN" ;
VAL_ 403 OBJ_Has_Cut_Lane_1 1 "TRUE" 0 "FALSE" ;
VAL_ 403 OBJ_Has_Cut_Path_1 1 "TRUE" 0 "FALSE" ;
VAL_ 403 OBJ_Brake_Light_1 1 "TRUE" 0 "FALSE" ;
VAL_ 403 OBJ_Turn_Indicator_Right_1 1 "TRUE" 0 "FALSE" ;
VAL_ 403 OBJ_Turn_Indicator_Left_1 1 "TRUE" 0 "FALSE" ;
VAL_ 403 OBJ_Light_Indicator_Validity_1 1 "TRUE" 0 "FALSE" ;
VAL_ 403 OBJ_Right_Out_Of_Image_1 1 "TRUE" 0 "FALSE" ;
VAL_ 403 OBJ_Left_Out_Of_Image_1 1 "TRUE" 0 "FALSE" ;
VAL_ 403 OBJ_Right_Out_Of_Image_V_1 1 "TRUE" 0 "FALSE" ;
VAL_ 403 OBJ_Left_Out_Of_Image_V_1 1 "TRUE" 0 "FALSE" ;
VAL_ 403 OBJ_Top_Out_Of_Image_1 1 "TRUE" 0 "FALSE" ;
VAL_ 403 OBJ_Bottom_Out_Of_Image_1 1 "TRUE" 0 "FALSE" ;
VAL_ 403 OBJ_Top_Out_Of_Image_V_1 1 "VALID" 0 "INVALID" ;
VAL_ 403 OBJ_Bottom_Out_Of_Image_V_1 1 "VALID" 0 "INVALID" ;
VAL_ 403 OBJ_Lane_Assignment_1 5 "RIGHT_RIGHT" 4 "RIGHT" 3 "HOST" 2 "LEFT" 1 "LEFT_LEFT" 0 "UNKNOWN" ;
VAL_ 403 OBJ_Lane_Assignment_V_1 1 "VALID" 0 "INVALID" ;
VAL_ 403 OBJ_Age_Seconds_V_1 1 "VALID" 0 "INVALID" ;
VAL_ 403 OBJ_Width_V_1 1 "VALID" 0 "INVALID" ;
VAL_ 403 OBJ_Width_STD_V_1 1 "VALID" 0 "INVALID" ;
VAL_ 403 OBJ_Length_V_1 1 "VALID" 0 "INVALID" ;
VAL_ 403 OBJ_Length_STD_V_1 1 "VALID" 0 "INVALID" ;
VAL_ 403 OBJ_Height_V_1 1 "VALID" 0 "INVALID" ;
VAL_ 403 OBJ_Height_STD_V_1 1 "VALID" 0 "INVALID" ;
VAL_ 403 OBJ_Abs_Long_Velocity_V_1 1 "VALID" 0 "INVALID" ;
VAL_ 403 OBJ_Abs_Long_Vel_STD_V_1 1 "VALID" 0 "INVALID" ;
VAL_ 403 OBJ_Abs_Lat_Velocity_V_1 1 "VALID" 0 "INVALID" ;
VAL_ 403 OBJ_Abs_Lat_Vel_STD_V_1 1 "VALID" 0 "INVALID" ;
VAL_ 403 OBJ_Abs_Long_Acc_V_1 1 "VALID" 0 "INVALID" ;
VAL_ 403 OBJ_Abs_Long_Acc_STD_V_1 1 "VALID" 0 "INVALID" ;
VAL_ 403 OBJ_Abs_Lat_Acc_V_1 1 "VALID" 0 "INVALID" ;
VAL_ 403 OBJ_Abs_Lat_Acc_STD_V_1 1 "VALID" 0 "INVALID" ;
VAL_ 403 OBJ_Abs_Acceleration_V_1 1 "VALID" 0 "INVALID" ;
VAL_ 403 OBJ_Abs_Acc_STD_V_1 1 "VALID" 0 "INVALID" ;
VAL_ 403 OBJ_Inv_TTC_V_1 1 "VALID" 0 "INVALID" ;
VAL_ 403 OBJ_Inv_TTC_STD_V_1 1 "VALID" 0 "INVALID" ;
VAL_ 403 OBJ_Relative_Long_Acc_V_1 1 "VALID" 0 "INVALID" ;
VAL_ 403 OBJ_Rel_Long_Acc_STD_V_1 1 "VALID" 0 "INVALID" ;
VAL_ 403 OBJ_Relative_Long_Velocity_V_1 1 "VALID" 0 "INVALID" ;
VAL_ 403 OBJ_Rel_Long_Vel_STD_V_1 1 "VALID" 0 "INVALID" ;
VAL_ 404 OBJ_Relative_Lat_Velocity_V_1 1 "VALID" 0 "INVALID" ;
VAL_ 404 OBJ_Rel_Lat_Vel_STD_V_1 1 "VALID" 0 "INVALID" ;
VAL_ 404 OBJ_Long_Distance_V_1 1 "VALID" 0 "INVALID" ;
VAL_ 404 OBJ_Long_Distance_STD_V_1 1 "VALID" 0 "INVALID" ;
VAL_ 404 OBJ_Lat_Distance_V_1 1 "VALID" 0 "INVALID" ;
VAL_ 404 OBJ_Lat_Distance_STD_V_1 1 "VALID" 0 "INVALID" ;
VAL_ 404 OBJ_Absolute_Speed_V_1 1 "VALID" 0 "INVALID" ;
VAL_ 404 OBJ_Absolute_Speed_STD_V_1 1 "VALID" 0 "INVALID" ;
VAL_ 404 OBJ_Heading_V_1 1 "VALID" 0 "INVALID" ;
VAL_ 404 OBJ_Heading_STD_V_1 1 "VALID" 0 "INVALID" ;
VAL_ 404 OBJ_Angle_Rate_STD_V_1 1 "VALID" 0 "INVALID" ;
VAL_ 404 OBJ_Angle_Rate_V_1 1 "VALID" 0 "INVALID" ;
VAL_ 404 OBJ_Angle_Right_V_1 1 "VALID" 0 "INVALID" ;
VAL_ 404 OBJ_Angle_Right_STD_V_1 1 "VALID" 0 "INVALID" ;
VAL_ 404 OBJ_Angle_Left_V_1 1 "VALID" 0 "INVALID" ;
VAL_ 404 OBJ_Angle_Left_STD_V_1 1 "VALID" 0 "INVALID" ;
VAL_ 404 OBJ_Angle_Side_V_1 1 "VALID" 0 "INVALID" ;
VAL_ 404 OBJ_Angle_Side_STD_V_1 1 "VALID" 0 "INVALID" ;
VAL_ 404 OBJ_Angle_Mid_V_1 1 "VALID" 0 "INVALID" ;
VAL_ 404 OBJ_Angle_Mid_STD_V_1 1 "VALID" 0 "INVALID" ;
VAL_ 404 OBJ_Angle_Bottom_V_1 1 "VALID" 0 "INVALID" ;
VAL_ 404 OBJ_Angle_Bottom_STD_V_1 1 "VALID" 0 "INVALID" ;
VAL_ 404 OBJ_Visibility_Side_V_1 1 "VALID" 0 "INVALID" ;
VAL_ 404 OBJ_Visibility_Side_1 2 "REAR" 1 "FRONT" 0 "NOT_VISIBLE" ;
VAL_ 404 OBJ_Is_In_Drivable_Area_1 1 "TRUE" 0 "FALSE" ;
VAL_ 404 OBJ_Is_In_Drivable_Area_V_1 1 "VALID" 0 "INVALID" ;
VAL_ 404 OBJ_Is_VeryClose_V_1 1 "VALID" 0 "INVALID" ;
VAL_ 404 OBJ_Is_VeryClose_1 1 "TRUE" 0 "FALSE" ;
VAL_ 404 OBJ_Is_EMERGENCY_VCL_1 1 "TRUE" 0 "FALSE" ;
VAL_ 404 OBJ_EMERGENCY_LIGHT_COLOR_1 3 "(1000)ORANGE" 2 "(0100)BLUE" 1 "(0010)RED" 0 "(0001)OTHER" ;
VAL_ 404 OBJ_EMERGENCY_V_1 1 "TRUE" 0 "FALSE" ;
VAL_ 405 OBJ_Motion_Category_2 13 "ONCOMING" 12 "PRECEEDING" 11 "MOVING" 10 "RTAP" 9 "LTAP" 8 "CROSSING" 7 "MOVING_OUT" 6 "MOVING_IN" 5 "CLOSE_CUT_IN" 4 "PASSING_OUT" 3 "PASSING_IN" 2 "PASSING" 1 "UNDEFINED" 0 "UNFILLED" ;
VAL_ 405 OBJ_Measuring_Status_2 2 "(BIT_2)NOT_VALID_OR_VALID" 1 "(BIT_1)PREDICTED_OR_MEASURED" 0 "(BIT_0)OLD_OR_NEW" ;
VAL_ 405 OBJ_Object_Class_2 8 "UNCERTAIN_VCL" 7 "ANIMAL" 6 "GENERAL_OBJECT" 5 "PEDESTRIAN" 4 "BICYCLE" 3 "MOTORBIKE" 2 "TRUCK" 1 "CAR" 0 "UNFILLED" ;
VAL_ 405 OBJ_Motion_Status_2 5 "MOVING_SLOWLY" 4 "STOPPED" 3 "STATIONARY" 2 "MOVING" 1 "UNKNOWN" 0 "INVALID" ;
VAL_ 405 OBJ_Motion_Orientation_2 13 "INVALID" 12 "NORTH" 11 "NORTH_WEST" 9 "WEST" 7 "SOUTH_WEST" 6 "SOUTH" 5 "SOUTH_EAST" 3 "EAST" 1 "NORTH_EAST" 0 "UNKNOWN" ;
VAL_ 405 OBJ_Has_Cut_Lane_2 1 "TRUE" 0 "FALSE" ;
VAL_ 405 OBJ_Has_Cut_Path_2 1 "TRUE" 0 "FALSE" ;
VAL_ 405 OBJ_Brake_Light_2 1 "TRUE" 0 "FALSE" ;
VAL_ 405 OBJ_Turn_Indicator_Right_2 1 "TRUE" 0 "FALSE" ;
VAL_ 405 OBJ_Turn_Indicator_Left_2 1 "TRUE" 0 "FALSE" ;
VAL_ 405 OBJ_Light_Indicator_Validity_2 1 "TRUE" 0 "FALSE" ;
VAL_ 405 OBJ_Right_Out_Of_Image_2 1 "TRUE" 0 "FALSE" ;
VAL_ 405 OBJ_Left_Out_Of_Image_2 1 "TRUE" 0 "FALSE" ;
VAL_ 405 OBJ_Right_Out_Of_Image_V_2 1 "TRUE" 0 "FALSE" ;
VAL_ 405 OBJ_Left_Out_Of_Image_V_2 1 "TRUE" 0 "FALSE" ;
VAL_ 405 OBJ_Top_Out_Of_Image_2 1 "TRUE" 0 "FALSE" ;
VAL_ 405 OBJ_Bottom_Out_Of_Image_2 1 "TRUE" 0 "FALSE" ;
VAL_ 405 OBJ_Top_Out_Of_Image_V_2 1 "VALID" 0 "INVALID" ;
VAL_ 405 OBJ_Bottom_Out_Of_Image_V_2 1 "VALID" 0 "INVALID" ;
VAL_ 405 OBJ_Lane_Assignment_2 5 "RIGHT_RIGHT" 4 "RIGHT" 3 "HOST" 2 "LEFT" 1 "LEFT_LEFT" 0 "UNKNOWN" ;
VAL_ 405 OBJ_Lane_Assignment_V_2 1 "VALID" 0 "INVALID" ;
VAL_ 405 OBJ_Age_Seconds_V_2 1 "VALID" 0 "INVALID" ;
VAL_ 405 OBJ_Width_V_2 1 "VALID" 0 "INVALID" ;
VAL_ 405 OBJ_Width_STD_V_2 1 "VALID" 0 "INVALID" ;
VAL_ 405 OBJ_Length_V_2 1 "VALID" 0 "INVALID" ;
VAL_ 405 OBJ_Length_STD_V_2 1 "VALID" 0 "INVALID" ;
VAL_ 405 OBJ_Height_V_2 1 "VALID" 0 "INVALID" ;
VAL_ 405 OBJ_Height_STD_V_2 1 "VALID" 0 "INVALID" ;
VAL_ 405 OBJ_Abs_Long_Velocity_V_2 1 "VALID" 0 "INVALID" ;
VAL_ 405 OBJ_Abs_Long_Vel_STD_V_2 1 "VALID" 0 "INVALID" ;
VAL_ 405 OBJ_Abs_Lat_Velocity_V_2 1 "VALID" 0 "INVALID" ;
VAL_ 405 OBJ_Abs_Lat_Vel_STD_V_2 1 "VALID" 0 "INVALID" ;
VAL_ 405 OBJ_Abs_Long_Acc_V_2 1 "VALID" 0 "INVALID" ;
VAL_ 405 OBJ_Abs_Long_Acc_STD_V_2 1 "VALID" 0 "INVALID" ;
VAL_ 405 OBJ_Abs_Lat_Acc_V_2 1 "VALID" 0 "INVALID" ;
VAL_ 405 OBJ_Abs_Lat_Acc_STD_V_2 1 "VALID" 0 "INVALID" ;
VAL_ 405 OBJ_Abs_Acceleration_V_2 1 "VALID" 0 "INVALID" ;
VAL_ 405 OBJ_Abs_Acc_STD_V_2 1 "VALID" 0 "INVALID" ;
VAL_ 405 OBJ_Inv_TTC_V_2 1 "VALID" 0 "INVALID" ;
VAL_ 405 OBJ_Inv_TTC_STD_V_2 1 "VALID" 0 "INVALID" ;
VAL_ 405 OBJ_Relative_Long_Acc_V_2 1 "VALID" 0 "INVALID" ;
VAL_ 405 OBJ_Rel_Long_Acc_STD_V_2 1 "VALID" 0 "INVALID" ;
VAL_ 405 OBJ_Relative_Long_Velocity_V_2 1 "VALID" 0 "INVALID" ;
VAL_ 405 OBJ_Rel_Long_Vel_STD_V_2 1 "VALID" 0 "INVALID" ;
SIG_VALTYPE_ 396 LA_Line_C3_0 : 1;
SIG_VALTYPE_ 396 LA_Line_C2_0 : 1;
SIG_VALTYPE_ 396 LA_Line_C1_0 : 1;
SIG_VALTYPE_ 396 LA_Line_C0_0 : 1;
SIG_VALTYPE_ 397 LA_Line_C3_1 : 1;
SIG_VALTYPE_ 397 LA_Line_C2_1 : 1;
SIG_VALTYPE_ 397 LA_Line_C1_1 : 1;
SIG_VALTYPE_ 397 LA_Line_C0_1 : 1;
SIG_VALTYPE_ 398 LH_Line_First_C0_0 : 1;
SIG_VALTYPE_ 398 LH_Line_First_C1_0 : 1;
SIG_VALTYPE_ 398 LH_Line_First_C2_0 : 1;
SIG_VALTYPE_ 398 LH_Line_First_C3_0 : 2;
SIG_VALTYPE_ 398 LH_Line_Second_C0_0 : 1;
SIG_VALTYPE_ 398 LH_Line_Second_C1_0 : 1;
SIG_VALTYPE_ 398 LH_Line_Second_C2_0 : 1;
SIG_VALTYPE_ 398 LH_Line_Second_C3_0 : 1;
SIG_VALTYPE_ 399 LH_Line_First_C0_1 : 1;
SIG_VALTYPE_ 399 LH_Line_First_C1_1 : 1;
SIG_VALTYPE_ 399 LH_Line_First_C2_1 : 1;
SIG_VALTYPE_ 399 LH_Line_First_C3_1 : 1;
SIG_VALTYPE_ 399 LH_Line_Second_C0_1 : 1;
SIG_VALTYPE_ 399 LH_Line_Second_C1_1 : 1;
SIG_VALTYPE_ 399 LH_Line_Second_C2_1 : 1;
SIG_VALTYPE_ 399 LH_Line_Second_C3_1 : 1;
SIG_VALTYPE_ 394 LRE_Line_C3_0 : 1;
SIG_VALTYPE_ 394 LRE_Line_C2_0 : 1;
SIG_VALTYPE_ 394 LRE_Line_C1_0 : 1;
SIG_VALTYPE_ 394 LRE_Line_C0_0 : 1;
SIG_VALTYPE_ 395 LRE_Line_C3_1 : 1;
SIG_VALTYPE_ 395 LRE_Line_C2_1 : 1;
SIG_VALTYPE_ 395 LRE_Line_C1_1 : 1;
SIG_VALTYPE_ 395 LRE_Line_C0_1 : 1;

VERSION ""

NS_ :

BS_:

BU_: Traj

BO_ 259 planning_trajectory_01: 64 Traj
 SG_ traj_y_16 : 496|16@1- (0.1,0) [-3276.8|3276.7] "" Vector__XXX
 SG_ traj_y_15 : 480|16@1- (0.1,0) [-3276.8|3276.7] "" Vector__XXX
 SG_ traj_y_14 : 464|16@1- (0.1,0) [-3276.8|3276.7] "" Vector__XXX
 SG_ traj_y_13 : 448|16@1- (0.1,0) [-3276.8|3276.7] "" Vector__XXX
 SG_ traj_y_12 : 432|16@1- (0.1,0) [-3276.8|3276.7] "" Vector__XXX
 SG_ traj_y_11 : 416|16@1- (0.1,0) [-3276.8|3276.7] "" Vector__XXX
 SG_ traj_y_10 : 400|16@1- (0.1,0) [-3276.8|3276.7] "" Vector__XXX
 SG_ traj_y_09 : 384|16@1- (0.1,0) [-3276.8|3276.7] "" Vector__XXX
 SG_ traj_y_08 : 368|16@1- (0.1,0) [-3276.8|3276.7] "" Vector__XXX
 SG_ traj_y_07 : 352|16@1- (0.1,0) [-3276.8|3276.7] "" Vector__XXX
 SG_ traj_y_06 : 336|16@1- (0.1,0) [-3276.8|3276.7] "" Vector__XXX
 SG_ traj_y_05 : 320|16@1- (0.1,0) [-3276.8|3276.7] "" Vector__XXX
 SG_ traj_y_04 : 304|16@1- (0.1,0) [-3276.8|3276.7] "" Vector__XXX
 SG_ traj_y_03 : 288|16@1- (0.1,0) [-3276.8|3276.7] "" Vector__XXX
 SG_ traj_y_02 : 272|16@1- (0.1,0) [-3276.8|3276.7] "" Vector__XXX
 SG_ traj_y_01 : 256|16@1- (0.1,0) [-3276.8|3276.7] "" Vector__XXX
 SG_ traj_x_16 : 240|16@1- (0.1,0) [-3276.8|3276.7] "" Vector__XXX
 SG_ traj_x_15 : 224|16@1- (0.1,0) [-3276.8|3276.7] "" Vector__XXX
 SG_ traj_x_14 : 208|16@1- (0.1,0) [-3276.8|3276.7] "" Vector__XXX
 SG_ traj_x_13 : 192|16@1- (0.1,0) [-3276.8|3276.7] "" Vector__XXX
 SG_ traj_x_12 : 176|16@1- (0.1,0) [-3276.8|3276.7] "" Vector__XXX
 SG_ traj_x_11 : 160|16@1- (0.1,0) [-3276.8|3276.7] "" Vector__XXX
 SG_ traj_x_10 : 144|16@1- (0.1,0) [-3276.8|3276.7] "" Vector__XXX
 SG_ traj_x_09 : 128|16@1- (0.1,0) [-3276.8|3276.7] "" Vector__XXX
 SG_ traj_x_08 : 112|16@1- (0.1,0) [-3276.8|3276.7] "" Vector__XXX
 SG_ traj_x_07 : 96|16@1- (0.1,0) [-3276.8|3276.7] "" Vector__XXX
 SG_ traj_x_06 : 80|16@1- (0.1,0) [-3276.8|3276.7] "" Vector__XXX
 SG_ traj_x_05 : 64|16@1- (0.1,0) [-3276.8|3276.7] "" Vector__XXX
 SG_ traj_x_04 : 48|16@1- (0.1,0) [-3276.8|3276.7] "" Vector__XXX
 SG_ traj_x_03 : 32|16@1- (0.1,0) [-3276.8|3276.7] "" Vector__XXX
 SG_ traj_x_02 : 16|16@1- (0.1,0) [-3276.8|3276.7] "" Vector__XXX
 SG_ traj_x_01 : 0|16@1- (0.1,0) [-3276.8|3276.7] "" Vector__XXX

BO_ 261 control_points: 64 Traj
 SG_ control_y_12 : 368|16@1- (0.1,0) [-3276.8|3276.7] "" Vector__XXX
 SG_ control_y_11 : 352|16@1- (0.1,0) [-3276.8|3276.7] "" Vector__XXX
 SG_ control_y_10 : 336|16@1- (0.1,0) [-3276.8|3276.7] "" Vector__XXX
 SG_ control_y_09 : 320|16@1- (0.1,0) [-3276.8|3276.7] "" Vector__XXX
 SG_ control_y_08 : 304|16@1- (0.1,0) [-3276.8|3276.7] "" Vector__XXX
 SG_ control_y_07 : 288|16@1- (0.1,0) [-3276.8|3276.7] "" Vector__XXX
 SG_ control_y_06 : 272|16@1- (0.1,0) [-3276.8|3276.7] "" Vector__XXX
 SG_ control_y_05 : 256|16@1- (0.1,0) [-3276.8|3276.7] "" Vector__XXX
 SG_ control_y_04 : 240|16@1- (0.1,0) [-3276.8|3276.7] "" Vector__XXX
 SG_ control_y_03 : 224|16@1- (0.1,0) [-3276.8|3276.7] "" Vector__XXX
 SG_ control_y_02 : 208|16@1- (0.1,0) [-3276.8|3276.7] "" Vector__XXX
 SG_ control_y_01 : 192|16@1- (0.1,0) [-3276.8|3276.7] "" Vector__XXX
 SG_ control_x_12 : 176|16@1- (0.1,0) [-3276.8|3276.7] "" Vector__XXX
 SG_ control_x_11 : 160|16@1- (0.1,0) [-3276.8|3276.7] "" Vector__XXX
 SG_ control_x_10 : 144|16@1- (0.1,0) [-3276.8|3276.7] "" Vector__XXX
 SG_ control_x_09 : 128|16@1- (0.1,0) [-3276.8|3276.7] "" Vector__XXX
 SG_ control_x_08 : 112|16@1- (0.1,0) [-3276.8|3276.7] "" Vector__XXX
 SG_ control_x_07 : 96|16@1- (0.1,0) [-3276.8|3276.7] "" Vector__XXX
 SG_ control_x_06 : 80|16@1- (0.1,0) [-3276.8|3276.7] "" Vector__XXX
 SG_ control_x_05 : 64|16@1- (0.1,0) [-3276.8|3276.7] "" Vector__XXX
 SG_ control_x_04 : 48|16@1- (0.1,0) [-3276.8|3276.7] "" Vector__XXX
 SG_ control_x_03 : 32|16@1- (0.1,0) [-3276.8|3276.7] "" Vector__XXX
 SG_ control_x_02 : 16|16@1- (0.1,0) [-3276.8|3276.7] "" Vector__XXX
 SG_ control_x_01 : 0|16@1- (0.1,0) [-3276.8|3276.7] "" Vector__XXX

BO_ 260 planning_trajectory_02: 64 Traj

BO_ 258 map_points_02: 64 Traj

BO_ 257 map_points_01: 64 Traj
 SG_ map_y_16 : 496|16@1- (0.1,0) [-3276.8|3276.7] "" Vector__XXX
 SG_ map_y_15 : 480|16@1- (0.1,0) [-3276.8|3276.7] "" Vector__XXX
 SG_ map_y_14 : 464|16@1- (0.1,0) [-3276.8|3276.7] "" Vector__XXX
 SG_ map_y_13 : 448|16@1- (0.1,0) [-3276.8|3276.7] "" Vector__XXX
 SG_ map_y_12 : 432|16@1- (0.1,0) [-3276.8|3276.7] "" Vector__XXX
 SG_ map_y_11 : 416|16@1- (0.1,0) [-3276.8|3276.7] "" Vector__XXX
 SG_ map_y_10 : 400|16@1- (0.1,0) [-3276.8|3276.7] "" Vector__XXX
 SG_ map_y_09 : 384|16@1- (0.1,0) [-3276.8|3276.7] "" Vector__XXX
 SG_ map_y_08 : 368|16@1- (0.1,0) [-3276.8|3276.7] "" Vector__XXX
 SG_ map_y_07 : 352|16@1- (0.1,0) [-3276.8|3276.7] "" Vector__XXX
 SG_ map_y_06 : 336|16@1- (0.1,0) [-3276.8|3276.7] "" Vector__XXX
 SG_ map_y_05 : 320|16@1- (0.1,0) [-3276.8|3276.7] "" Vector__XXX
 SG_ map_y_04 : 304|16@1- (0.1,0) [-3276.8|3276.7] "" Vector__XXX
 SG_ map_y_03 : 288|16@1- (0.1,0) [-3276.8|3276.7] "" Vector__XXX
 SG_ map_y_02 : 272|16@1- (0.1,0) [-3276.8|3276.7] "" Vector__XXX
 SG_ map_y_01 : 256|16@1- (0.1,0) [-3276.8|3276.7] "" Vector__XXX
 SG_ map_x_16 : 240|16@1- (0.1,0) [-3276.8|3276.7] "" Vector__XXX
 SG_ map_x_15 : 224|16@1- (0.1,0) [-3276.8|3276.7] "" Vector__XXX
 SG_ map_x_14 : 208|16@1- (0.1,0) [-3276.8|3276.7] "" Vector__XXX
 SG_ map_x_13 : 192|16@1- (0.1,0) [-3276.8|3276.7] "" Vector__XXX
 SG_ map_x_12 : 176|16@1- (0.1,0) [-3276.8|3276.7] "" Vector__XXX
 SG_ map_x_11 : 160|16@1- (0.1,0) [-3276.8|3276.7] "" Vector__XXX
 SG_ map_x_10 : 144|16@1- (0.1,0) [-3276.8|3276.7] "" Vector__XXX
 SG_ map_x_09 : 128|16@1- (0.1,0) [-3276.8|3276.7] "" Vector__XXX
 SG_ map_x_08 : 112|16@1- (0.1,0) [-3276.8|3276.7] "" Vector__XXX
 SG_ map_x_07 : 96|16@1- (0.1,0) [-3276.8|3276.7] "" Vector__XXX
 SG_ map_x_06 : 80|16@1- (0.1,0) [-3276.8|3276.7] "" Vector__XXX
 SG_ map_x_05 : 64|16@1- (0.1,0) [-3276.8|3276.7] "" Vector__XXX
 SG_ map_x_04 : 48|16@1- (0.1,0) [-3276.8|3276.7] "" Vector__XXX
 SG_ map_x_03 : 32|16@1- (0.1,0) [-3276.8|3276.7] "" Vector__XXX
 SG_ map_x_02 : 16|16@1- (0.1,0) [-3276.8|3276.7] "" Vector__XXX
 SG_ map_x_01 : 0|16@1- (0.1,0) [-3276.8|3276.7] "" Vector__XXX

BA_DEF_ BO_  "GenMsgCycleTime" INT 0 65535;
BA_DEF_ BO_  "CANFD_BRS" ENUM  "0","1";
BA_DEF_  "DBName" STRING ;
BA_DEF_  "BusType" STRING ;
BA_DEF_ BO_  "VFrameFormat" ENUM  "StandardCAN","ExtendedCAN","reserved","reserved","reserved","reserved","reserved","reserved","reserved","reserved","reserved","reserved","reserved","reserved","StandardCAN_FD","ExtendedCAN_FD";
BA_DEF_DEF_  "GenMsgCycleTime" 0;
BA_DEF_DEF_  "CANFD_BRS" "1";
BA_DEF_DEF_  "DBName" "";
BA_DEF_DEF_  "BusType" "";
BA_DEF_DEF_  "VFrameFormat" "StandardCAN";
BA_ "BusType" "CAN FD";
BA_ "DBName" "TrajPoints";
BA_ "GenMsgCycleTime" BO_ 259 20;
BA_ "VFrameFormat" BO_ 259 14;
BA_ "GenMsgCycleTime" BO_ 261 20;
BA_ "VFrameFormat" BO_ 261 14;
BA_ "GenMsgCycleTime" BO_ 260 20;
BA_ "VFrameFormat" BO_ 260 14;
BA_ "GenMsgCycleTime" BO_ 258 20;
BA_ "VFrameFormat" BO_ 258 14;
BA_ "GenMsgCycleTime" BO_ 257 20;
BA_ "VFrameFormat" BO_ 257 14;
